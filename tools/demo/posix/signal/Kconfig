## tools/demo/posix/signal/Kconfig
```kconfig
#
# System Call: signal
#

menu "signal      signal handling"

config DEBUG_SYSCALL_SIGNAL
	bool "signal(): signal handling"
	help
	  Debug signal system Call Mechanism on X86 Architecture.

if DEBUG_SYSCALL_SIGNAL

config DEBUG_SYSCALL_SIGNAL0
	bool "System CALL: signal (linux0.11.1 MINIXFS)"
	help
	  Signal system call on linux0.11.1.

endif

endmenu
```

## tools/demo/posix/stat/Kconfig
```kconfig
#
# System Call: stat
#

menu "stat        -- unknow system call"

config DEBUG_SYSCALL_STAT
	bool "stat(): unknow system call"
	help
	  Debug stat system Call Mechanism on X86 Architecture.

if DEBUG_SYSCALL_STAT

config DEBUG_SYSCALL_STAT0
	bool "System CALL: stat (linux0.11.1 MINIXFS)"
	help
	  Stat system call on linux0.11.1.

endif

endmenu
```

## tools/demo/posix/umask/Kconfig
```kconfig
#
# System Call: umask
#

menu "umask       get current task umask"

config DEBUG_SYSCALL_UMASK
	bool "umask(): get current task umask"
	help
	  Debug umask system Call Mechanism on X86 Architecture.

if DEBUG_SYSCALL_UMASK

config DEBUG_SYSCALL_UMASK0
	bool "System CALL: umask (linux0.11.1 MINIXFS)"
	help
	  Umask system call on linux0.11.1.

endif

endmenu
```

## tools/demo/posix/umount/Kconfig
```kconfig
#
# System Call: umount
#

menu "umount      unmount filesystems"

config DEBUG_SYSCALL_UMOUNT
	bool "umount(): unmount filesystems"
	help
	  Debug mount system Call Mechanism on X86 Architecture.

if DEBUG_SYSCALL_UMOUNT

config DEBUG_SYSCALL_UMOUNT0
	bool "System CALL: uount (linux0.11.1 MINIXFS)"
	help
	  Umount system call on linux0.11.1.

endif

endmenu
```

## tools/demo/posix/write/Kconfig
```kconfig
#
# POSIX: write
#

menu "write       Write data to a file/directory/socket/pipe etc"

config DEBUG_POSIX_WRITE
	bool "write(): Write data to a file/directory/socket/pipe etc"
	help
	  Debug Write system Call Mechanism on X86 Architecture.

if DEBUG_POSIX_WRITE

config DEBUG_WRITE_ORIG
	bool "write(): original write data into file"
	help
	  Debug original write().

config DEBUG_WRITE_ROOTFS
	bool "write(): write operation on speical rootfs"
	help
	  Write on special rootfs.

endif

endmenu
```

## tools/demo/vfs/core/Kconfig
```kconfig
#
# VFS core Architecture and Mechanism
#
menu "VFS core Architecture and Mechanism"

config DEBUG_VFS_CORE
        bool "VfS core Architecture and Mechanism"
        help
          A virtual file system (VFS) or virtual filesystem switch is 
          an abstraction layer on top of a more concrete file system. 
          The purpose of a VFS is to allow client applications to access
          different types of concrete file systems in a uniform way. 
          A VFS can, for example, be used to access local and network
          storage devices transparently without the client application
          noticing the difference.

if DEBUG_VFS_CORE

# Inode
source "tools/demo/vfs/core/inode/Kconfig"

# File table
source "tools/demo/vfs/core/file_table/Kconfig"

endif

endmenu
```

## tools/demo/vfs/core/buffer/Kconfig
```kconfig
#
# Buffer: Filesystem Buffer
#
menu "Buffer:   Virtual Filesystem Buffer"

config DEBUG_VFS_BUFFER
        bool "Buffer: Virtual Filesystem buffer."
        help
	  Virtual Filesystem Buffer.

if DEBUG_VFS_BUFFER

config DEBUG_BUFFER_INIT
	bool "Initialize VFS buffer"
	help
	  initialize VFS buffer.

config DEBUG_BUFFER_GET
	bool "get a speical block into buffer"
	select DEBUG_BUFFER_INIT
	help
	  Obtain a special block into buffer.

endif

endmenu
```

## tools/demo/vfs/core/file_table/Kconfig
```kconfig
#
# file table:
#
menu "File table:  File descriptor table"

config DEBUG_VFS_FILE_TABLE
        bool "File Table: file descriptor table"
        help
	  The inode is a data structure in a Unix-style file system 

if DEBUG_VFS_FILE_TABLE

config DEBUG_FILE_TABLE_INIT
	bool "Iniitialize all file_table structure."
	help
	  Initialize all file_table structure.

config DEBUG_FILE_GET
	bool "Get an empty file descriptor or grow file table"
	select DEBUG_FILE_TABLE_INIT
	help
	  Get an empty file descriptor. If subsytem can not get
	  a file descriptor on first time, it will grow file_table.

endif

endmenu
```

## tools/demo/vfs/core/inode/Kconfig
```kconfig
#
# Inode: Filesystem object file or dirent
#
menu "Inode:    Describe a Filesystem object file or dirent"

config DEBUG_VFS_INODE
        bool "Inode: Describe a Filesystem object file or dirent"
        help
	  The inode is a data structure in a Unix-style file system 
	  that describes a filesystem object such as a file or a 
	  directory. Each inode stores the attributes and disk block 
	  location(s) of the object's data. Filesystem object 
	  attributes may include metadata (times of last change,
	  access, modification), as well as owner and permission data

if DEBUG_VFS_INODE

config DEBUG_INODE_INIT
	bool "Iniitialize all inode structure."
	help
	  Initialize all inode structure.

config DEBUG_INODE_IGET
	bool "iget(): get an inode with speical name"
	help
	  Debug main routine for iget().

config DEBUG_INODE_IGET_HASH
	bool "iget(): get an inode from Inode-hash"
	help
	  Debug main routine for iget() with hash table.

config DEBUG_INODE_IPUT
	bool "iput(): put an inode to VFS"
	help
	  Debug core routine for iput();

config DEBUG_INODE_IPUT_ROOTFS
	bool "put a inode in special rootfs"
	select DEBUG_INODE_IPUT
	help
	  Debug core routine for iput on special rootfs.

config DEBUG_INODE_READ_SPECIAL
	bool "Read inode from special Rootfs"
	help
	  Read inode structure from special Rootfs.

config DEBUG_INODE_WRITE_SPECIAL
	bool "write inode to special Rootfs"
	help
	  Write inode structure to special Rootfs.

endif

endmenu
```

## tools/demo/vfs/core/namei/Kconfig
```kconfig
#
# Name to Inode
#
menu "Namei: name to special inode"

config DEBUG_VFS_NAMEI
        bool "namei: cover name to inode"
        help

if DEBUG_VFS_NAMEI

config DEBUG_NAMEI_FROM_USER
	bool "Obtian and verify name string from userland."
	help
	  Obtain data from userland.

config DEBUG_INODE_LOOKUP
	bool "Lookup inode with special name"
	help
	  Lookup inode with special name.

config DEBUG_INODE_LOOKUP_ROOTFS
	bool "Lookup inode in special rootfs"
	select DEBUG_INODE_LOOKUP
	help
	  Lookup inode in special rootfs.

config DEBUG_OPEN_NAMEI
	bool "Obtain inode while open_namei() routine."
	help
	  Debug main routinue for open_namei().

config DEBUG_INODE_SYMLINK
	bool "Verify symlink for inode"
	help
	  Verify symlink for inode.

config DEBUG_INODE_SYMLINK_ROOTFS
	bool "Verify symlink on special rootfs"
	help
	  Verify symlink for inode on special rootfs.

endif

endmenu
```

## tools/demo/vfs/core/super/Kconfig
```kconfig
#
# Super block
#
menu "Super block: Fileystem Super block Read/Write."

config DEBUG_VFS_SUPER
        bool "Super block: Filesystem super block Read/Write"
        help

if DEBUG_VFS_SUPER

config DEBUG_MOUNT_ROOTFS
	bool "Mount rootfs on init."
	help
	  Mount rootfs.

endif

endmenu
```

## tools/demo/vfs/ext2/Kconfig
```kconfig
#
# Debug Filesystem: EXT2 filesystem
#
menu "Ext2     Second extended file system"

config DEBUG_VFS_EXT2
        bool "ext2-fs: second extended file system"
        help
	  EXT2 File system.

if DEBUG_VFS_EXT2

config DEBUG_EXT2_SUPERBLOCK
	bool "ext2-fs: super block on disk"
	help
	  Parse the value from super block on Ext2-FS.

config DEBUG_EXT2_SUPERBLOCK_VFS
	bool "ext2-fs: super block on VFS"
	help
	  Parse the value from super block on VFS

config DEBUG_EXT2_GROUP_DESC
	bool "ext2-fs: groups descriptor"
	help
	  Parse the value from group descriptor.

config DEBUG_EXT2_INODE
	bool "ext2-fs: inode (index node)"
	help
	  Parse the value from inode.

endif

endmenu
```

## tools/demo/vfs/minixfs/Kconfig
```kconfig
#
# Debug Filesystem: MINIX filesystem
#
menu "MINIX Filesystem"

config DEBUG_VFS_MINIXFS
        bool "MINIX Filesystem: A Unix Filesystem"
        help
	  Minix File system.

if DEBUG_VFS_MINIXFS

config DEBUG_BOOT_BLOCK
	bool "Layout: boot block(boot code, partition table)"
	help
	  Boot block on MINIX Filesystem.

config DEBUG_SUPER_BLOCK
	bool "Layout: super block(inode,zone,BitMap)"
	help
	  Super block on MINX Filesystem.

config DEBUG_INODE_BITMAP
	bool "Layout: Inode-BitMap (manage unused/used Inode)"
	help
	  Inode-BitMap on Minix-fs.

config DEBUG_ZONE_BITMAP
	bool "Layout: Zone-BitMap (manage unused/used Zone)"
        help
	  Zone-BitMap on Minix-fs.

config DEBUG_INODE_TABLE
	bool "Layout: Inode-Table (manage minix inode)"
	help
	  Inode-Table on Minix-fs.

config DEBUG_DATA_ZONE
	bool "Layout: Data Zone (Store file/directory)"
	help
	  Data Zone on MINIX-fs.

config DEBUG_MINIX_INODE
	bool "minix_inode: a inode on minix-fs"
	help
	  Sturcture of minix_inode.

config DEBUG_MINIX_DIR_ENTRY
	bool "minix_dir_entry: a direntory on minix-fs"
	help
	  Structure of minix_dir_entry

endif

endmenu
```

## tools/testcase/Kconfig
```kconfig
#
# Debug tools configuration
# 

menu "TestCase configuration"

config TESTCASE
	bool "Testcase for kernel function"
	select DEBUG_DEBUGCALL
	help
	  Test basic kernel function on specify envirnoment

if TESTCASE

config DEBUG_DEBUGCALL
	bool "Debug call in different stage."
	help
	  Debug call in different stage. see include/test/init.h

source "tools/testcase/interrupt/Kconfig"

source "tools/testcase/block/Kconfig"

source "tools/testcase/assembly/Kconfig"

source "tools/testcase/scheduler/Kconfig"

source "tools/testcase/mmu/Kconfig"

source "tools/testcase/timer/Kconfig"

source "tools/testcase/ioports/Kconfig"

source "tools/testcase/systemcall/Kconfig"

source "tools/testcase/vfs/Kconfig"

source "tools/testcase/binary/Kconfig"

source "tools/testcase/segment/Kconfig"

endif

endmenu
```

## tools/testcase/assembly/Kconfig
```kconfig
#
# Assembly and inline assembly
#

menu "Assembly and inline Assembly"

config TESTCASE_ASSEMBLY
	bool "Test assembly or inline assembly"
	help
	  Test assembly or inline assembly on kernel space.

endmenu
```

## tools/testcase/binary/Kconfig
```kconfig
#
# Execute format file mechanism on X86 architecture
#
menu "Execute-Link format file Mechanism on X86 Architecture"

config DEBUG_BINARY
        bool "Execute-Link format file  mechanism on X86 Architecture"
        help
	  a.out and ELF format file.

if DEBUG_BINARY


source tools/testcase/binary/a.out/Kconfig

source tools/testcase/binary/elf/Kconfig

endif # End of DEBUG_BINARY

endmenu
```

## tools/testcase/binary/a.out/Kconfig
```kconfig
#
# Execute-Link format file: a.out
#

menu "a.out: Assembler output format file"

config DEBUG_BINARY_AOUT
	bool "a.out: Assembler output format file"
	help
	  a.out is a file format used in older versions of Unix-like 
	  computer operating systems for executables, object code, and, 
	  in later systems, shared libraries. This is an abbreviated 
	  form of "assembler output", the filename of the output of Ken 
	  Thompson's PDP-7 assembler.[1] The term was subsequently 
	  applied to the format of the resulting file to contrast with 
	  other formats for object code.

if DEBUG_BINARY_AOUT

config DEBUG_AOUT_EXEC
	bool "Execute a.out format file on Linux0.11"
	help
	  Execute a a.out format file on MINIXFS-linux0.11

config DEBUG_AOUT_FORMAT
	bool "Format for a.out (Assembly output)"
	help
	  Parse foramt for a.out (Assembly output).

endif

endmenu
```

## tools/testcase/binary/elf/Kconfig
```kconfig
#
# Execute-Link format file: ELF
#

menu "ELF: Executable and Linkable Format"

config DEBUG_BINARY_ELF
	bool "ELF: Executable and Linkable Format"
	help
	  Executable and Linkable Format (ELF, formerly named Extensible 
	  Linking Format), is a common standard file format for executable
	  files, object code, shared libraries, and core dumps. 

if DEBUG_BINARY_ELF

config DEBUG_ELF_FORMAT
	bool "Format for ELF (Executable and Linkable Format)"
	help
	  Parse foramt for ELF (Executable and Linkable Format).

choice
	prompt "ELF Format File"
	default ELF_RELOCATABLE_FILE

config ELF_RELOCATABLE_FILE
	bool "Parse ELF Relocatable file"
	select DEBUG_ELF_FORMAT
	help
	  Parse formt for Relocable file.

config ELF_EXECUTE_FILE
	bool "Parse ELF Executable file"
	select DEBUG_ELF_FORMAT
	help
	  Parse formt for executable file.

config ELF_SHARELIB_FILE
	bool "Parse ELF Shared object file"
	select DEBUG_ELF_FORMAT
	help
	  Parse formt for Shared object file.

endchoice

config PARSE_ELF_HEADER
	bool "Parse Header for ELF"
	select DEBUG_ELF_FORMAT
	help
	  Parse ELF header.

config ELF_PRIVATE_SECTION_DATA
	bool "Add and Parse a data into ELF section '.bis.data'"
	select DEBUG_ELF_FORMAT
	help
	  Add and parse a new data into ELF section '.bis.data'.

config ELF_PRIVATE_SECTION_FUNC
	bool "Add and parse a function into ELF section '.bis.text'"
	select DEBUG_ELF_FORMAT
	help
	  Add and parse a new function into ELF section '.bis.text'

config ELF_SPECIAL_SYMBOL
	bool "ELF special link symbol."
	select DEBUG_ELF_FORMAT
	help
	  ELF special link symbol. such as __edata.

config ELF_SECTION_TABLE
	bool "ELF Section Table"
	select DEBUG_ELF_FORMAT
	help
	  ELF Section Table.

if ELF_SECTION_TABLE

config ELF_SECTION_CODE
	bool ".text or .code      Code Section"
	help
	  ELF Code Section point '.text' or '.code'
	
config ELF_SECTION_DATA
	bool ".data               Data Section"
	help
	  ELF Data Section point '.data'.
	
config ELF_SECTION_STRTAB
	bool ".strtab             String Table Section"
	help
	  ELF String Table section '.strtab'.
	
config ELF_SECTION_SHSTRTAB
	bool ".shstrtab           Section String Table section"
	help
	  ELF Section string table '.shstrtab'.

config ELF_SECTION_BSS
	bool ".bss                Block Started by Symbol: BSS"
	help
	  ELF BSS: Block Started by Symbol.

config ELF_SECTION_RODATA
	bool ".rodata             Read-only Data section"
	help
	  ELF Read-Only Data section.

config ELF_SECTION_COMMENT
	bool ".comment            Comment section"
	help
	  ELF Comment section.

config ELF_SECTION_SYMTAB
	bool ".symtab             Symbol table section"
	help
	  ELF Symbol table section.

config ELF_SECTION_RELTEXT
	bool ".rel.text           Relocation Table section"
	help
	  ELF Relocation table section.

endif # ELF_SECTION_TABLE

endif

endmenu
```

## tools/testcase/block/CHS/Kconfig
```kconfig
#
# Debug Disk: Sector, Cylinder, head, track, etc
#
menu "Disk (Sector, Cylinder, Head, Track, etc)"


config DEBUG_DISK_CHS
	bool "Cylinder, Head, Sector, Track, Platter, Boom and Spindle"
	help
	  Debug Disk metadata of Cylinder, Head, Sector, Track, Platter,
	  Boom and Spindle.

endmenu
```

## tools/testcase/block/Kconfig
```kconfig
#
# Debug block device driver
#
menu "Block device driver: HD, Floppy, Ramdisk etc"

config DEBUG_BLOCK_DEV
        bool "Debug block device driver mechanism"
        help
          Debug block device driver on X86

if DEBUG_BLOCK_DEV

source tools/testcase/block/hard-disk/Kconfig

source tools/testcase/block/CHS/Kconfig

source tools/testcase/block/partition/Kconfig

endif # End of DEBUG_BLOCK_DEV

endmenu
```

## tools/testcase/block/disk/Kconfig
```kconfig
#
# Debug Disk: Sector, Cylinder, head, track, MBR, etc
#
menu "Disk (Sector, Cylinder, Head, Track, Partition, MBR, etc)"

config DEBUG_BLOCK_DISK
        bool "Debug Disk (Sector, Cylinder, Head, Track, Partition, etc)"
        help
          Debug Disk mechanism

if DEBUG_BLOCK_DISK

config DEBUG_PARTITION_MBR
	bool "Main Boot Record (MBR) on Disk partition"
	help
	  Debug MBR partition Table.

config DEBUG_DISK_CHS
	bool "Cylinder, Head, Sector, Track, Platter, Boom and Spindle"
	help
	  Debug Disk metadata of Cylinder, Head, Sector, Track, Platter,
	  Boom and Spindle.

endif

endmenu
```
