## tools/testcase/block/hard-disk/Kconfig
```kconfig
#
# Debug Hard Disk
#
menu "Hard-Disk device driver and HD-interrupt"

config DEBUG_BLOCK_HD
	select DEBUG_BLOCK_HD_INT
        bool "Hard-Disk mechanism on X86 Architecture"
        help
          Debug Hard-Disk block device driver on X86

if DEBUG_BLOCK_HD

config DEBUG_BLOCK_HD_DEV
	bool "Hard-Disk Controller and Driver 0, 1"
	help
	  Debug Hard-Disk Controller and Driver 0, 1

config DEBUG_BLOCK_HD_INT
	select DEBUG_BLOCK_HD_DEV
	bool "Hard-Disk Interrupt handler for Read/Write request"
	help
	  Debug Hard-Disk Interrupt handler for Read/Write request.

config DEBUG_BLOCK_HD_USAGE
	depends on DEBUG_BLOCK_HD_DEV && DEBUG_BLOCK_HD_DEV
	bool "Usage for Common Hard-Disk operation"
	help
	  Optional Hard-Disk operation.

endif

endmenu
```

## tools/testcase/block/partition/Kconfig
```kconfig
#
# Debug Disk Partition: MBR
#
menu "Disk Partition (MBR, VBR, GPT etc)"


config DEBUG_DISK_PARTITION
	bool "Disk Partition usage (MBR, VBR, GPT)"
	help
	  Debug Disk Partition on legacy Hard-disk

if DEBUG_DISK_PARTITION

config DEBUG_PARTITION_MBR
	bool "MBR (Master boot record)"
	help
	  MBR

endif

endmenu
```

## tools/testcase/harddisk/Kconfig
```kconfig
#
# Testcase for Hard-disk
#
menu "Hard disk"

comment "Debug Hard-disk on Kernel space"

config TESTCASE_HARDDISK
	default n
        bool "Test Hard-disk function"
        help
          Test full function for hard-disk.

if TESTCASE_HARDDISK

config TESTCASE_HARDDISK_INT
	bool "Test interrupt for hard-disk"
	help
	  Test interrupt function for hard-disk

endif # End of TESTCASE_HARDDISK

endmenu
```

## tools/testcase/interrupt/Kconfig
```kconfig
#
# Debug interrupt machanism on X86 architecture
#
menu "Interrupt Machanism on X86 Architecture"

config DEBUG_INTERRUPT
	depends on X86
        bool "Debug Interrupt Machanism on X86 Architecture"
        help
	  In system programming, an interrupt is a signal to the processor
	  emitted by hardware or software indicating an event that needs
	  immediate attention. An interrupt alerts the processor to a 
	  high-priority condition requiring the interruption of the current
	  code the processor is executing. The processor responds by 
	  suspending its current activities, saving its state, and executing
	  a function called an interrupt handler (or an interrupt service
	  routine, ISR) to deal with the event.

if DEBUG_INTERRUPT

config DEBUG_IDT
	bool "Interrupt Descriptors Table (IDT)"
	help 
	  The Interrupt Descriptor Table (IDT) is a data structure used 
	  by the x86 architecture to implement an interrupt vector table. 
	  The IDT is used by the processor to determine the correct response
	  to interrupts and exceptions.

config DEBUG_INT_USAGE
	bool "Establish and Trigger an interrupt or exception"
	help
	  The usage of establishing an interrupt or a exception that
	  contains interrupt descriptor on IDT and interrupt- or
	  exception-handler. And then trigger specific interrupt or
	  exception.


source tools/testcase/interrupt/interrupt0/Kconfig

source tools/testcase/interrupt/interrupt1/Kconfig

source tools/testcase/interrupt/interrupt2/Kconfig

source tools/testcase/interrupt/interrupt3/Kconfig

source tools/testcase/interrupt/interrupt4/Kconfig

source tools/testcase/interrupt/interrupt5/Kconfig

source tools/testcase/interrupt/interrupt6/Kconfig

source tools/testcase/interrupt/interrupt7/Kconfig

source tools/testcase/interrupt/interrupt8/Kconfig

source tools/testcase/interrupt/interrupt9/Kconfig

source tools/testcase/interrupt/interrupt10/Kconfig

source tools/testcase/interrupt/interrupt11/Kconfig

source tools/testcase/interrupt/interrupt12/Kconfig

source tools/testcase/interrupt/interrupt13/Kconfig

source tools/testcase/interrupt/interrupt14/Kconfig

source tools/testcase/interrupt/interrupt16/Kconfig

source tools/testcase/interrupt/interrupt32/Kconfig

source tools/testcase/interrupt/interrupt39/Kconfig

source tools/testcase/interrupt/interrupt45/Kconfig

source tools/testcase/interrupt/interrupt46/Kconfig

source tools/testcase/interrupt/interrupt128/Kconfig

endif # End of DEBUG_INTERRUPT

endmenu
```
