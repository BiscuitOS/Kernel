## tools/demo/mmu/storage/ioports/Kconfig
```kconfig
#
# XT, AT and PS/2 I/O port addresses
#

menu "I/O:      I/O port on X86 Architecture"

config DEBUG_IOPORT
	bool "Input/Output Port memory"
	help
	  

if DEBUG_IOPORT

# 0x70: CMOS
source "tools/demo/mmu/storage/ioports/cmos/Kconfig"


endif

endmenu
```

## tools/demo/mmu/storage/ioports/cmos/Kconfig
```kconfig
#
# 0x70: CMOS
#

menu "0x70:     CMOS"

config DEBUG_IOPORT_CMOS
	bool "CMOS "
	help
	  
endmenu
```

## tools/demo/mmu/storage/register/CR0/Kconfig
```kconfig
menu "CR0:      Control Register 0"

config DEBUG_REGISTER_CR0
	bool "CR0: Control Register 0"
	help
	  CR0: Control Register.

if DEBUG_REGISTER_CR0

config DEBUG_CR0_BITMAP
	bool "Bitmap of CR0"
	help
	  Bitmap of CR0.

if DEBUG_CR0_BITMAP

comment "CR0 BitMap"

config DEBUG_CR0_PG
	bool "Paging flag (bit 31)"
	help
	  Paging flag of CR0.

config DEBUG_CR0_CD
	bool "Cache Disable (bit 30)"
	help
	  Cache Disable flag of CR0.

config DEBUG_CR0_NW
	bool "Not Write-through (bit 29)"
	help
	  Not write-through.

config DEBUG_CR0_AM
	bool "Alignment Mask (bit 18 of CR0)"
	help
	  Enables automatic alignment checking.

config DEBUG_CR0_WP
	bool "Write Protect (bit 16 of CR0)"
	help
	  Enable write protect.

config DEBUG_CR0_PE
	bool "Protection Enable(bit 0 of CR0)"
	help
	  Enable Protection Enable.

endif # DEBUG_CR0_BITMAP

endif # DEBUG_REGISTER_CR0

endmenu
```

## tools/demo/mmu/storage/register/CR2/Kconfig
```kconfig
menu "CR2:      Control Register 2"

config DEBUG_REGISTER_CR2
	bool "CR2: Control Register 2"
	help
	  CR2: Control Register 2.

endmenu
```

## tools/demo/mmu/storage/register/CR3/Kconfig
```kconfig
menu "CR3:      Control Register 3"

config DEBUG_REGISTER_CR3
	bool "CR3: Control Register 3"
	help
	  CR3: Control Register 3.

if DEBUG_REGISTER_CR3

config DEBUG_CR3_BITMAP
	bool "CR3 bitmap: flag and field"
	help
	  CR3 bitmap.

if DEBUG_CR3_BITMAP

comment "CR3 BitMap"

config DEBUG_CR3_BASE
	bool "Base physical address field (bit 12 through 31)"
	help
	  Base physical address of paging-structure.

config DEBUG_CR3_PCD
	bool "Page-level Cache Disable (bit 4 of CR3)"
	help
	  Page-level cache disable.

config DEBUG_CR3_PWT
	bool "Page-level Write-Through (bit 3 of CR3)"
	help
	  Page-level Write-Through.

endif # DEBUG_CR3_BITMAP


endif # DEBUG_REGISTER_CR3


endmenu
```

## tools/demo/mmu/storage/register/CR4/Kconfig
```kconfig
menu "CR4:      Control Register 4"

config DEBUG_REGISTER_CR4
	bool "CR4: Control Register 4"
	help
	  CR4: Control Register 4.

if DEBUG_REGISTER_CR4

config DEBUG_CR4_BITMAP
	bool "Bitmap of CR4"
	help
	  Bitmap of CR4.

if DEBUG_CR4_BITMAP

comment "CR4 BitMap"

config DEBUG_CR4_PSE
	bool "Page Size Extensions (bit 4 of CR4)"
	help
	  Page Size Extensions.

config DEBUG_CR4_PAE
	bool "Physical Address Extension (bit 5 of CR4)"
	help
	  Physcial Address extension.

config DEBUG_CR4_PGE
	bool "Page Global Enbale (bit 7 of CR4)"
	help
	  Page Global Enable.

config DEBUG_CR4_PCID
	bool "PCID-Enable Bite (bit 17 of CR4)"
	help
	  Enables process-context identifiers.

config DEBUG_CR4_SMEP
	bool "SMEP-Enable Bit (bit 20 of CR4)"
	help
	  Enables supervisor-mode execution prevention (SMEP).

config DEBUG_CR4_SMAP
	bool "SMAP-Enable Bit (bit 21 of CR4)"
	help
	  Enables supervisor-mode access prevention (SMAP).

config DEBUG_CR4_PKE
	bool "Protection-Key-Enable Bit (bit 22 of CR4)"
	help
	  Enables 4-level paging to associate each linear address.

endif # DEBUG_CR4_BITMAP

endif # DEBUG_REGISTER_CR4

endmenu
```

## tools/demo/mmu/storage/register/CS/Kconfig
```kconfig
#
# CS: Code selector Register
#

menu "CS:       Code selector Register"

config DEBUG_REGISTER_CS
	bool "CS: Code selector Register"
	help
	  Debug Code selector Register.

endmenu
```

## tools/demo/mmu/storage/register/DS/Kconfig
```kconfig
#
# DS: Data selector Register
#

menu "DS:       Data selector Register"

config DEBUG_REGISTER_DS
	bool "DS: Data selector Register"
	help
	  Debug Data selector Register.

endmenu
```

## tools/demo/mmu/storage/register/EAX/Kconfig
```kconfig
#
# EAX: Accumulator for operands and result data
#

menu "EAX:      Accumulator for operands and result data"

config DEBUG_REGISTER_EAX
	bool "EAX: Accumulator for operands and result data"
	help
	  Debug EAX Register.

endmenu
```

## tools/demo/mmu/storage/register/EBP/Kconfig
```kconfig
#
# EBP: Pointer to data on the stack (in the SS segment)
#

menu "EBP:      Pointer to data on the stack (in the SS segment)"

config DEBUG_REGISTER_EBP
	bool "EBP: Pointer to data on the stack (in the SS segment)"
	help
	  Debug EBP Register.

endmenu
```

## tools/demo/mmu/storage/register/EBX/Kconfig
```kconfig
#
# EBX: Pointer to data in the DS segment
#

menu "EBX:      Pointer to data in the DS segment"

config DEBUG_REGISTER_EBX
	bool "EBX: Pointer to data in the DS segment"
	help
	  Debug EBX Register.

endmenu
```

## tools/demo/mmu/storage/register/ECX/Kconfig
```kconfig
#
# ECX: Counter for string and loop operations
#

menu "ECX:      Counter for string and loop operations"

config DEBUG_REGISTER_ECX
	bool "ECX: Counter for string and loop operations"
	help
	  Debug ECX Register.

endmenu
```

## tools/demo/mmu/storage/register/EDI/Kconfig
```kconfig
#
# EDI: Destination pointer for string operation
#

menu "EDI:      Destination pointer for string operation"

config DEBUG_REGISTER_EDI
	bool "EDI: Destination pointer for string operations"
	help
	  Debug EDI Register.

endmenu
```

## tools/demo/mmu/storage/register/EDX/Kconfig
```kconfig
#
# EDX: I/O pointer
#

menu "EDX:      I/O pointer"

config DEBUG_REGISTER_EDX
	bool "EDX: I/O pointer"
	help
	  Debug EDX Register.

endmenu
```
