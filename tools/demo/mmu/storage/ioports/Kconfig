## tools/demo/mmu/storage/register/EFLAGS/Kconfig
```kconfig
#
# EFLAGS: Current Status register of processor
#

menu "EFLAGS:   Current status register of processor"

config DEBUG_REGISTER_EFLAGS
	bool "EFLAGS: Current status register of processor"
	help
	  Debug EFLAGS Register.

if DEBUG_REGISTER_EFLAGS

config DEBUG_EFLAGS_LAHF
	bool "LAHF    Load Status Flags into AH Register"
	help
	  Obtain EFLAGS register via "LAHF" instrcution.

config DEBUG_EFLAGS_SAHF
	bool "SAHF    Store AH into EFLAGS register"
	help
	  Store AH into EFLAGS via "SAHF" instruction.

config DEBUG_EFLAGS_PUSHF
	bool "PUSHF   Push EFLAGS Register onto the Stack"
	help
	  Push EFLAGS register onto the stack.

config DEBUG_EFLAGS_POPF
	bool "POPF    Pop Stack into EFLAGS Register"
	help
	  Push value onto the EFLAGS register.

comment "EFLAGS Register Bit Map"

config DEBUG_EFLAGS_CF
	bool "CF      Carry flag (bit 0)"
	help
	  Carry flag - bit0.

if DEBUG_EFLAGS_CF

config DEBUG_CF_AAA
	bool "AAA     Carry on unpacked BCD"
	help
	  Carry on unpacked BCD via AAA instruction.

config DEBUG_CF_AAS
	bool "AAS     Borrow on unpacked BCD"
	help
	  Borrow on unpacked BCD via AAS instruction.

config DEBUG_CF_ADC
	bool "ADC     Addition with carry bit"
	help
	  Addition with carry via ADC instruction.

config DEBUG_CF_ADCX
	bool "ADCX    Addition of two operands with Carry flag"
	help
	  Unsigned integer addition of two operands with Carry flag

config DEBUG_CF_ADD
	bool "ADD     Carry on addition"
	help
	  Debug ADD instruction for carrying on.

config DEBUG_CF_DAA
	bool "DAA     Decimal adjust AL after addition"
	help
	  Debug DAA instruction for carrying on.

config DEBUG_CF_DAS
	bool "DAS     Decimal adjust AL after subtraction"
	help
	  Debug DAS instruction for borrow from.

config DEBUG_CF_BT
	bool "BT      Test bit"
	help
	  CF will be set on bit is set.

config DEBUG_CF_BTC
	bool "BTC     Test bit and Complement special bit"
	help
	  CF will be set that bit is set and complement special bit.

config DEBUG_CF_BTR
	bool "BTR     Test bit and reset special bit"
	help
	  CF will be set that bit is set and reset special bit.

config DEBUG_CF_BTS
	bool "BTS     Test bit and set special bit"
	help
	  CF will be set that bit is set and set special bit. 

config DEBUG_CF_CLC
	bool "CLC     Clear Carry flag on EFLAGS register"
	help
	  Clears the CF flag in the EFLAGS register.

config DEBUG_CF_STC
	bool "STC     Set Carry flag on EFLAGS register"
	help
	  Set up the CF flag in the EFLAGS register.

config DEBUG_CF_MUL
	bool "MUL     Unsigned multiply"
	help
	  Unsigned multiply.

config DEBUG_CF_SUB
	bool "SUB     Integer subtraction"
	help
	  Subtraction.

config DEBUG_CF_SBB
	bool "SBB     Integer subtraction with borrow"
	help
	  Subtraction with borrow.

config DEBUG_CF_SHL
	bool "SHL     Shift logical left"
	help
	  Shift logical left.

config DEBUG_CF_SHR
	bool "SHR     Shift logical right"
	help
	  Shift logical right.

config DEBUG_CF_SAL
	bool "SAL     Shift arithmetic left"
	help
	  Shift arithmetic left.

config DEBUG_CF_SAR
	bool "SAR     Shift arithmetic right"
	help
	  Shift arithmetic right.

config DEBUG_CF_RCL
	bool "RCL     Rotate through carry left"
	help
	  Rotate through carry left.

config DEBUG_CF_RCR
	bool "RCR     Rotate through carry right"
	help
	  Rotate through carry right.

config DEBUG_CF_ROL
	bool "ROL     Rotate left"
	help
	  Rotate left.

config DEBUG_CF_ROR
	bool "ROR     Rotate right"
	help
	  Rotate right.

endif # DEBUG_EFLAGS_CF

config DEBUG_EFLAGS_PF
        bool "PF      Parity flag (bit 2)"
        help
          Parity flag - bit2.

if DEBUG_EFLAGS_PF

config DEBUG_PF_AAD
	bool "AAD     ASCII adjust AX before division"
	help
	  ASCII adjust AX before division.

config DEBUG_PF_AAM
	bool "AAM     ASCII adjust AX after multiply"
	help
	  ASCII adjust AX after multiply

config DEBUG_PF_ADC
	bool "ADC     Addition with carry bit"
	help
	  Addition with carry via ADC instruction.

config DEBUG_PF_ADD
	bool "ADD     Carry on addition"
	help
	  Debug ADD instruction for carrying on.

config DEBUG_PF_AND
	bool "AND     Logical AND"
	help
	  Debug AND instruction for Parity Bit.

config DEBUG_PF_CMP
	bool "CMP     Compare two operands"
	help
	  Debug CMP instruction for Parity Bit.

config DEBUG_PF_CMPSB
	bool "CMPSB   Compare string operands in byte"
	help
	  Debug CMPSB instruction for Parity Bit.

config DEBUG_PF_CMPSW
	bool "CMPSW   Compare string operands in word"
	help
	  Debug CMPSW instruction for Parity Bit.

config DEBUG_PF_CMPSD
	bool "CMPSD   Compare string operands in double-word"
	help
	  Debug CMPSD instruction for Parity Bit.

config DEBUG_PF_DAA
	bool "DAA     Decimal adjust AL after addition"
	help
	  Debug DAA instruction for Parity Bit.

config DEBUG_PF_DAS
	bool "DAS     Decimal adjust AL after subtraction"
	help
	  Debug DAS instruction for Parity Bit.

config DEBUG_PF_DEC
	bool "DEC     Decrement by 1"
	help
	  Debug DEC instrcution for Parity Bit.

config DEBUG_PF_INC
	bool "INC     Increment by 1"
	help
	  Debug INC instruction for Parity Bit.

config DEBUG_PF_JP
	bool "JP      Jump short if parity"
	help
	  Debug JP instruction for Parity Bit.

config DEBUG_PF_JPE
	bool "JPE     Jump short if parity even (PF = 1)"
	help
	  Debug JPE instruction for Parity Bit.

config DEBUG_PF_JPO
	bool "JPO     Jump short if parity odd (PF = 0)"
	help
	  Debug JPO instruction for Parity Bit.

config DEBUG_PF_JNP
	bool "JNP     Jump short if not parity"
	help
	  Debug JNP instruction for Parity Bit.

config DEBUG_PF_NEG
	bool "NEG     Two's complement negation"
	help
	  Debug NEG instruction for Parity Bit.

config DEBUG_PF_OR
	bool "OR      Logical Inclusive OR"
	help
	  Debug OR instruction for Parity Bit.

config DEBUG_PF_SAL
	bool "SAL     Shift arithmetic left"
	help
	  Shift arithmetic left for Parity Bit.

config DEBUG_PF_SAR
	bool "SAR     Shift arithmetic right"
	help
	  Shift arithmetic right for Parity Bit.

config DEBUG_PF_SHR
	bool "SHR     Shift logical right"
	help
	  Shift logical right for Parity Bit.

config DEBUG_PF_SHL
	bool "SHL     Shift logical left"
	help
	  Shift logical left for Parity Bit.

config DEBUG_PF_SBB
	bool "SBB     Integer subtraction with borrow"
	help
	  Subtraction with borrow for Parity Bit.

config DEBUG_PF_SCASB
	bool "SCASB   Scan string in byte"
	help
	  Scanning string in byte for Parity Bit.

config DEBUG_PF_SCASW
	bool "SCASW   Scan string in word"
	help
	  Scanning string in word for Parity Bit.

config DEBUG_PF_SUB
	bool "SUB     Subtract"
	help
	  Subtract for Parity Bit.

config DEBUG_PF_TEST
	bool "TEST    Logical Compare"
	help
	  Logical compare for Parity Bit.

endif # DEBUG_EFLAGS_PF

config DEBUG_EFLAGS_AF
	bool "AF      Auxiliary Carry flag (bit 4)"
	help
	  Bit 3 carry or borrow.

if DEBUG_EFLAGS_AF

config DEBUG_AF_AAA
	bool "AAA     ASCII adjust after addition"
	help
	  AAA instruction for Auxiliary Carry flag.

config DEBUG_AF_AAS
	bool "AAS     ASCII adjust AL after subtraction."
	help
	  AAS instruction for Auxiliary Carry flag.

config DEBUG_AF_ADC
	bool "ADC     ADD with Carry"
	help
	  ADC instruction for Auxiliary Carry flag.

config DEBUG_AF_ADD
	bool "ADD     Add"
	help
	  ADD instruction for Auxiliary Carry flag.

config DEBUG_AF_CMP
	bool "CMP     Compare two operands"
	help
	  CMP instruction for Auxiliary Carry flag.

config DEBUG_AF_CMPSB
	bool "CMPSB   Compare string operands in byte"
	help
	  CMPSB instruction for Auxiliary Carry flag.

config DEBUG_AF_CMPSW
	bool "CMPSW   Compare string operands in word"
	help
	  CMPSW instruction for Auxiliary Carry flag.

config DEBUG_AF_CMPSD
	bool "CMPSD   Compare string operands in Double-word"
	help
	  CMPSD instruction for Auxiliary Carry flag.

config DEBUG_AF_CMPXCHG
	bool "CMPXCHG Compare and Exchange Byte"
	help
	  AAA instruction for Auxiliary Carry flag.

config DEBUG_AF_DAA
	bool "DAA     Decimal adjust AL after addition"
	help
	  DAA instruction for Auxiliary Carry flag.

config DEBUG_AF_DAS
	bool "DAS     Decimal adjust AL after subtraction"
	help
	  DAS instruction for Auxiliary Carry flag.

config DEBUG_AF_DEC
	bool "DEC     Decrement by 1"
	help
	  DEC instruction for Auxiliary Carry flag.

config DEBUG_AF_INC
	bool "INC     Increment by 1"
	help
	  INC instruction for Auxiliary Carry flag.

config DEBUG_AF_NEG
	bool "NEG     Two's complement negation"
	help
	  NEG instruction for Auxiliary Carry flag.

config DEBUG_AF_SBB
	bool "SBB     Integer subtraction with borrow"
	help
	  SBB instruction for Auxiliary Carry flag.

config DEBUG_AF_SCASB
	bool "SCASB   Scan string in byte"
	help
	  AAA instruction for Auxiliary Carry flag.

config DEBUG_AF_SCASW
	bool "SCASW   Scan string in word"
	help
	  SCASW instruction for Auxiliary Carry flag.

config DEBUG_AF_SUB
	bool "SUB     Subtract"
	help
	  SUB instruction for Auxiliary Carry flag.

config DEBUG_AF_XADD
	bool "XADD    Exchange and add"
	help
	  XADD instruction for Auxiliary Carry flag.

endif # DEBUG_EFLAGS_AF

config DEBUG_EFLAGS_ZF
	bool "ZF      Zero flag (bit 6)"
	help
	  Carry flag - bit0.

if DEBUG_EFLAGS_ZF

config DEBUG_ZF_AAD
	bool "AAD     ASCII adjust AX before division"
	help
	  AAD instruction for Zero flag.

config DEBUG_ZF_AAM
	bool "AAM     ASCII adjust AX after multiply"
	help
	  AAM instruction for Zero flag.

config DEBUG_ZF_ADC
	bool "ADC     Addition with carry bit"
	help
	  ADC instruction for Zero flag.

config DEBUG_ZF_ADD
	bool "ADD     Carry on addition"
	help
	  ADD instruction for Zero flag.

config DEBUG_ZF_AND
	bool "AND     Logical AND"
	help
	  AND instruction for Zero flag.

config DEBUG_ZF_ARPL
	bool "ARPL    Adjust PRL Field of segment selector"
	help
	  ARPL instruction for Zero flag.

config DEBUG_ZF_BSF
	bool "BSF     Bit scan forward"
	help
	  BSF instruction for Zero flag.

config DEBUG_ZF_BSR
	bool "BSR     Bit scan reverse"
	help
	  BSR instruction for Zero flag.

config DEBUG_ZF_CMP
	bool "CMP     Compare two operands"
	help
	  CMP instruction for Zero flag.

config DEBUG_ZF_CMPSB
	bool "CMPSB   Compare string operands in byte"
	help
	  CMPSB instruction for Zero flag.

config DEBUG_ZF_CMPSW
	bool "CMPSW   Compare string operands in word"
	help
	  CMPSW instruction for Zero flag.

config DEBUG_ZF_CMPSD
	bool "CMPSD   Compare string operands in Double-word"
	help
	  CMPSD instruction for Zero flag.

config DEBUG_ZF_CMPXCHG
	bool "CMPXCHG     Compare and exchange"
	help
	  CMPXCHG instruction for Zero flag.

config DEBUG_ZF_CMPXCHG8B
	bool "CMPXCHG8B   Compare and exchange 64bit"
	help
	  CMPXCHGBB instruction for Zero flag.

config DEBUG_ZF_CMPXCHG16B
	bool "CMPXCHG16B  Compare and exchange 128bit"
	help
	  CMPXCHGBB instruction for Zero flag.

config DEBUG_ZF_DAA
	bool "DAA     Decimal adjust AL after addition"
	help
	  DAA instruction for Zero flag.

config DEBUG_ZF_DAS
	bool "DAS     Decimal adjust AL after subtraction"
	help
	  DAS instruction for Zero flag.

config DEBUG_ZF_DEC
	bool "DEC     Decrement by 1"
	help
	  DEC instruction for Zero flag.

config DEBUG_ZF_INC
	bool "INC     Increment by 1"
	help
	  INC instruction for Zero flag.

config DEBUG_ZF_JE
	bool "JE      Jump short if equal"
	help
	  JE instruction for Zero flag.

config DEBUG_ZF_JNE
	bool "JNE     Jump short if not equal"
	help
	  JNE instruction for Zero flag.

config DEBUG_ZF_JLE
	bool "JLE     Jump short if less or equal"
	help
	  JLE instruction for Zero flag.

config DEBUG_ZF_JA
	bool "JA      Jump short if above"
	help
	  JNA instruction for Zero flag.

config DEBUG_ZF_JNA
	bool "JNA     Jump short if not above"
	help
	  JNA instruction for Zero flag.

config DEBUG_ZF_JG
	bool "JG      Jump short if greater"
	help
	  JNG instruction for Zero flag.

config DEBUG_ZF_JNG
	bool "JNG     Jump short if not greater or equal"
	help
	  JNG instruction for Zero flag.

config DEBUG_ZF_JBE
	bool "JBE     Jump near if below or equal"
	help
	  JBE instruction for Zero flag.

config DEBUG_ZF_JZ
	bool "JZ      Jump short if zero"
	help
	  JZ instruction for Zero flag.

config DEBUG_ZF_JNZ
	bool "JNZ     Jump short if not zero"
	help
	  JNZ instruction for Zero flag.

config DEBUG_ZF_LAR
	bool "LAR     Load effective address"
	help
	  LAR instruction for Zero flag.

config DEBUG_ZF_LSL
	bool "LSL     Load segment limit"
	help
	  LSL instruction for Zero flag.

config DEBUG_ZF_NEG
	bool "NEG     Two's complement negation"
	help
	  NEG instruction for Zero flag.

config DEBUG_ZF_OR
	bool "OR      Logical inclusive OR"
	help
	  OR instruction for Zero flag.

config DEBUG_ZF_REPZ
	bool "REPZ    Repeat while zero"
	help
	  REPZ instruction for Zero flag.

config DEBUG_ZF_REPNZ
	bool "REPNZ   Repeat while no zero"
	help
	  REPNZ instruction for Zero flag.

config DEBUG_ZF_RSM
	bool "RSM     Decimal adjust AL after subtraction"
	help
	  RSM instruction for Zero flag.

config DEBUG_ZF_SAL
	bool "SAL     Shift arithmetic left"
	help
	  SAL instruction for Zero flag.

config DEBUG_ZF_SAR
	bool "SAR     Shift arithmetic right"
	help
	  SAR instruction for Zero flag.

config DEBUG_ZF_SHL
	bool "SHL     Shift logical left"
	help
	  SHL instruction for Zero flag.

config DEBUG_ZF_SHR
	bool "SHR     Shift logical right"
	help
	  SHR instruction for Zero flag.

config DEBUG_ZF_SBB
	bool "SBB     Integer subtraction with borrow"
	help
	  SBB instruction for Zero flag.

config DEBUG_ZF_SCASB
	bool "SCASB   Scan string in byte"
	help
	  SCASB instruction for Zero flag.

config DEBUG_ZF_SCASW
	bool "SCASW   Scan string in word"
	help
	  SCASW instruction for Zero flag.

config DEBUG_ZF_SETZ
	bool "SETZ    Set byte if equal"
	help
	  SETZ instruction for Zero flag.

config DEBUG_ZF_SUB
	bool "SUB     Subtract"
	help
	  SUB instruction for Zero flag.

config DEBUG_ZF_TEST
	bool "TEST    Logical compare"
	help
	  TEST instruction for Zero flag.

config DEBUG_ZF_XADD
	bool "XADD    Echanged and add"
	help
	  XADD instruction for Zero flag.

config DEBUG_ZF_XOR
	bool "XOR     Logical exclusive OR"
	help
	  XOR instruction for Zero flag.

endif # DEBUG_EFLAGS_ZF

config DEBUG_EFLAGS_SF
        bool "SF      Sign flag (bit 7)"
        help
          Sign flag - bit7.

if DEBUG_EFLAGS_SF

config DEBUG_SF_AAD
	bool "AAD     ASCII Adjust Before Division"
	help
	  AAD instruction for Sign flag.

config DEBUG_SF_AAM
	bool "AAM     ASCII Adjust After Multiply"
	help
	  AAM instruction for Sign flag.

config DEBUG_SF_ADC
	bool "ADC     Add with Carry"
	help
	  ADC instruction for Sign flag.

config DEBUG_SF_ADD
	bool "ADD     Add"
	help
	  ADD instruction for Sign flag.

config DEBUG_SF_AND
	bool "AND     Logical AND"
	help
	  AND instruction for Sign flag.

config DEBUG_SF_CMP
	bool "CMP     Compare two operands"
	help
	  CMP instruction for Sign flag.

config DEBUG_SF_CMPSB
	bool "CMPSB   Compare string with Byte"
	help
	  CMPSB instruction for Sign flag.

config DEBUG_SF_CMPSW
	bool "CMPSW   Compare string with word"
	help
	  CMPSW instruction for Sign flag.

config DEBUG_SF_CMPSD
	bool "CMPSD   Compare string with double-word"
	help
	  CMPSD instruction for Sign flag.

config DEBUG_SF_DAA
	bool "DAA     Decimal Adjust AL after Addition"
	help
	  DAA instruction for Sign flag.

config DEBUG_SF_DAS
	bool "DAS     Decimal Adjust AL after Subtraction"
	help
	  DAS instruction for Sign flag.

config DEBUG_SF_DEC
	bool "DEC     Decrement by 1"
	help
	  DEC instruction for Sign flag.

config DEBUG_SF_INC
	bool "INC     Increament by 1"
	help
	  INC instruction for Sign flag.

config DEBUG_SF_JS
	bool "JS      Jump short if sign (SF = 1)"
	help
	  JS instruction for Sign flag.

config DEBUG_SF_JNS
	bool "JNS     Jump short if not sign (SF = 0)"
	help
	  JNS instruction for Sign flag.

config DEBUG_SF_NEG
	bool "NEG     Two's Complement Negation"
	help
	  NEG instruction for Sign flag.

config DEBUG_SF_OR
	bool "OR      Logical inclusive OR"
	help
	  OR instruction for Sign flag.

config DEBUG_SF_RSM
	bool "RSM     Resume from System Management Mode"
	help
	  RSM instruction for Sign flag.

config DEBUG_SF_SAL
	bool "SAL     Shift arithmetic left"
	help
	  SAL instruction for Sign flag.

config DEBUG_SF_SAR
	bool "SAR     Shift arithmetic right"
	help
	  SAR instruction for Sign flag.

config DEBUG_SF_SHL
	bool "SAL     Shift logical left"
	help
	  SHL instruction for Sign flag.

config DEBUG_SF_SHR
	bool "SHR     Shift arithmetic right"
	help
	  SHR instruction for Sign flag.

config DEBUG_SF_SBB
	bool "SBB     Integer Subtraction with Borrow"
	help
	  SBB instruction for Sign flag.

config DEBUG_SF_SCASB
	bool "SCASB   Scan string with byte"
	help
	  SCASB instruction for Sign flag.

config DEBUG_SF_SCASW
	bool "SCASW   Scan string with word"
	help
	  SCASW instruction for Sign flag.

config DEBUG_SF_SETS
	bool "SETS    Set byte if sign (SF = 1)"
	help
	  SETS instruction for Sign flag.

config DEBUG_SF_SETNS
	bool "SETNS   Set byte if not sign (SF = 0)"
	help
	  SETNS instruction for Sign flag.

config DEBUG_SF_SHLD
	bool "SHLD    Double precision shift left"
	help
	  SHLD instruction for Sign flag.

config DEBUG_SF_SHRD
	bool "SHRD    Double precision shift right"
	help
	  SHRD instruction for Sign flag.

config DEBUG_SF_SUB
	bool "SUB     Subtract"
	help
	  SUB instruction for Sign flag.

config DEBUG_SF_TEST
	bool "TEST    Logical Compare"
	help
	  TEST instruction for Sign flag.

config DEBUG_SF_XADD
	bool "XADD    Exchange and Add"
	help
	  XADD instruction for Sign flag.

config DEBUG_SF_XOR
	bool "XOR     Logical Exclusive OR"
	help
	  XOR instruction for Sign flag.


endif # DEBUG_EFLAGS_SF

config DEBUG_EFLAGS_TF
	bool "TF      Trap flag (bit 8)"
	help
	  Trap flag - bit8.

config DEBUG_EFLAGS_IF
	bool "IF      Interrupt enable flag (bit 9)"
	help
	  Interrupt enable flag - bit9.

config DEBUG_EFLAGS_DF
	bool "DF      Direction flag (bit 10)"
	help
	  Direction flag - bit10.

config DEBUG_EFLAGS_OF
	bool "OF      Overflow flag (bit 11)"
	help
	  Overflow flag - bit11.

config DEBUG_EFLAGS_IOPL
	bool "IOPL    I/O privilege level (bit 12 - 13)"
	help
	  I/O privilege level - bit12-13.

config DEBUG_EFLAGS_NT
	bool "NT      Nested Task (bit 14)"
	help
	  Nested Task - bit14.

config DEBUG_EFLAGS_RF
	bool "RF      Resume flag (bit 16)"
	help
	  Resume flag - bit16.

config DEBUG_EFLAGS_VM
	bool "VM      Virtual-8086 Mode (bit 17)"
	help
	  Virtual-8086 mode - bit17.

config DEBUG_EFLAGS_AC
	bool "AC      Alignment Check/Access Control (bit 18)"
	help
	  Alignment Check/ Access control - bit18.

config DEBUG_EFLAGS_VIF
	bool "VIF     Virtual interrupt flag (bit 19)"
	help
	  Virtual interrupt flag - bit19.

config DEBUG_EFLAGS_VIP
	bool "VIP     Virtual interrupt pending (bit 20)"
	help
	  Virtual interrupt pending - bit20.

config DEBUG_EFLAGS_ID
	bool "ID      ID flag (bit 21)"
	help
	  ID flag - bit10.

endif # DEBUG_REGISTER_EFLAGS

endmenu
```
