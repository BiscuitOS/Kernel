## tools/demo/mmu/storage/register/ES/Kconfig
```kconfig
#
# ES: Data selector Register
#

menu "ES:       Data selector Register for dynamically created data structure"

config DEBUG_REGISTER_ES
	bool "ES: Data selecotr register for dynamically created data structure"
	help
	  Debug ES Data selector Register.

endmenu
```

## tools/demo/mmu/storage/register/ESI/Kconfig
```kconfig
#
# ESI: Pointer to data in the segment pointer to by the DS register
#

menu "ESI:      Source pointer for string operations"

config DEBUG_REGISTER_ESI
	bool "ESI: Source pointer for string operations"
	help
	  Debug ESI Register.

endmenu
```

## tools/demo/mmu/storage/register/ESP/Kconfig
```kconfig
#
# ESP: Stack pointer (in the SS segment)
#

menu "ESP:      Stack pointer (in the SS segment)"

config DEBUG_REGISTER_ESP
	bool "ESP: Stack pointer (in the SS segment)"
	help
	  Debug ESP Register.

endmenu
```

## tools/demo/mmu/storage/register/FS/Kconfig
```kconfig
#
# FS: Data selector Register for exporting from a higher-level module
#

menu "FS:       Data selector Register for exporting from a higher-level module"

config DEBUG_REGISTER_FS
	bool "FS: Data selecotr register for exporting from a higher-level module"
	help
	  Debug FS Data selector Register.

endmenu
```

## tools/demo/mmu/storage/register/GDTR/Kconfig
```kconfig
#
# GDTR: Global Descriptor Table Register
#

menu "GDTR:     Global Descriptor Table Register"

config DEBUG_REGISTER_GDTR
	bool "GDTR: Global Descriptor table regsiter"
	help
	  Debug GDTR Register.

if DEBUG_REGISTER_GDTR

config DEBUG_GDTR_SGDT
	bool "SGDT: Store Global Descriptor Table Register"
	help
	  Store GDTR into linear address.

config DEBUG_GDTR_LGDT
	bool "LGDT: Load  Global Descriptor Table Register"
	help
	  Load linear address into GDTR.

endif

endmenu
```

## tools/demo/mmu/storage/register/GS/Kconfig
```kconfig
#
# GS: Data selector Register for sharing with another program
#

menu "GS:       Data selector Register for sharing with another program"

config DEBUG_REGISTER_GS
	bool "GS: Data selecotr register for sharing with another program"
	help
	  Debug GS Data selector Register.

endmenu
```

## tools/demo/mmu/storage/register/IDTR/Kconfig
```kconfig
#
# IDTR: Interrupt Descriptor Table Register
#

menu "IDTR:     Interrupt Descriptor Table Register"

config DEBUG_REGISTER_IDTR
	bool "IDTR: Interrupt descriptor Table Register"
	help
	  Debug IDTR Register.

if DEBUG_REGISTER_IDTR

config DEBUG_IDTR_SIDT
	bool "SIDT: Store Interrupt Descriptor Table Register"
	help
	  Store IDTR into linear address.

config DEBUG_IDTR_LIDT
	bool "LIDT: Load  Interrupt Descriptor Table Register"
	help
	  Load linear address into IDTR.

endif

endmenu
```

## tools/demo/mmu/storage/register/Kconfig
```kconfig
#
# Register
#

menu "Register: X86 Common Register mechanism"

config DEBUG_REGISTER
	bool "Common Register Descriptor for X86 Architecture"
	help

if DEBUG_REGISTER

# GDTR Register
source "tools/demo/mmu/storage/register/GDTR/Kconfig"

# LDTR Register
source "tools/demo/mmu/storage/register/LDTR/Kconfig"

# IDTR Register
source "tools/demo/mmu/storage/register/IDTR/Kconfig"

# TR Register
source "tools/demo/mmu/storage/register/TR/Kconfig"

# EAX Register
source "tools/demo/mmu/storage/register/EAX/Kconfig"

# EBX Register
source "tools/demo/mmu/storage/register/EBX/Kconfig"

# ECX Register
source "tools/demo/mmu/storage/register/ECX/Kconfig"

# EDX Register
source "tools/demo/mmu/storage/register/EDX/Kconfig"

# ESI Register
source "tools/demo/mmu/storage/register/ESI/Kconfig"

# EDI Register
source "tools/demo/mmu/storage/register/EDI/Kconfig"

# ESP Register
source "tools/demo/mmu/storage/register/ESP/Kconfig"

# EBP Register
source "tools/demo/mmu/storage/register/EBP/Kconfig"

# CS Register
source "tools/demo/mmu/storage/register/CS/Kconfig"

endif

endmenu
```

## tools/demo/mmu/storage/register/LDTR/Kconfig
```kconfig
#
# LDTR: Local Descriptor Table Register (LDTR)
#

menu "LDTR:     Local Descriptor Table Register"

config DEBUG_REGISTER_LDTR
	bool "LDTR: Local Descriptor table regsiter"
	help
	  Debug LDTR Register.

if DEBUG_REGISTER_LDTR

config DEBUG_LDTR_SLDT
	bool "SLDT: Store Local Descriptor Table Register"
	help
	  Store LDTR into linear address.

config DEBUG_LDTR_LLDT
	bool "LLDT: Load  Local Descriptor Table Register"
	help
	  Load linear address into LDTR.

endif

endmenu
```

## tools/demo/mmu/storage/register/SS/Kconfig
```kconfig
#
# SS: Stack selector Register
#

menu "SS:       Stack selector Register"

config DEBUG_REGISTER_SS
	bool "SS: Stack selector Register"
	help
	  Debug Stack selector Register.

endmenu
```
