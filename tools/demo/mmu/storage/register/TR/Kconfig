## tools/demo/mmu/storage/register/TR/Kconfig
```kconfig
#
# TR: Task Register
#

menu "TR:       Task Register"

config DEBUG_REGISTER_TR
	bool "TR: Task Register"
	help
	  Debug TR Register.

if DEBUG_REGISTER_TR

config DEBUG_TR_STR
	bool "STR: Store Task Register"
	help
	  Store TR into linear address.

config DEBUG_TR_LTR
	bool "LTR: Load  Task Register"
	help
	  Load linear address into TR.

endif

endmenu
```

## tools/demo/mmu/storage/stack/Kconfig
```kconfig
#
# Stack
#

menu "Stack:    An execution stack, program stack, control stack"

config DEBUG_STACK
	bool "An execution stack, program stack, control stack"
	help
	  An execution stack, program stack, control stack, run-time 
	  stack, or machine stack

if DEBUG_STACK

config DEBUG_CALL_INSTR
	bool "CALL: Branch to the called procedure."
	help
	  Saves procedure linking information on the stack and branches
	  to the called procedure specified using the target operand.

if DEBUG_CALL_INSTR

config DEBUG_NEAR_CALL
	bool "near call: Invoke procedure on same segment."
	help
	  A call to a procedure in the current code segment (the
	  segment currently pointed to by the CS register), sometime 
	  referred to as an intra-segment call.


endif

endif

endmenu
```

## tools/demo/posix/Kconfig
```kconfig
#
# POSIX System Call
#

menu "Portable Operating System Interface of UNIX (POSIX)"

config DEBUG_POSIX
	bool "Debug POSIX System Call Mechanism on X86 Architecture"
	help
	  Debug System Call Mechanism on X86 Architecture.

config DEBUG_SYSCALL
	bool "Private POSIX system call on int $0x81"
	select DEBUG_POSIX
	help
	  Debug Private system call mechanism on 'int $0x81'

if DEBUG_POSIX

# setup
source tools/demo/posix/setup/Kconfig

# open
source tools/demo/posix/open/Kconfig

# read
source tools/demo/posix/read/Kconfig

# write
source tools/demo/posix/write/Kconfig

# close
source tools/demo/posix/close/Kconfig

# fork
source tools/demo/posix/fork/Kconfig

# creat
source tools/demo/posix/creat/Kconfig

endif

endmenu
```

## tools/demo/posix/alarm/Kconfig
```kconfig
#
# System Call: alarm
#

menu "alarm       schedule an alarm signal - SIGALRM"

config DEBUG_SYSCALL_ALARM
	bool "alarm(): schedule an alarm signal - SIGALRM"
	help
	  Debug alarm system Call Mechanism on X86 Architecture.

if DEBUG_SYSCALL_ALARM

config DEBUG_SYSCALL_ALARM0
	bool "System CALL: alarm (linux0.11.1 MINIXFS)"
	help
	  Alarm system call on linux0.11.1.

endif

endmenu
```

## tools/demo/posix/brk/Kconfig
```kconfig
#
# System Call: brk
#

menu "brk         allocates memory right behind application image in memory"

config DEBUG_SYSCALL_BRK
	bool "brk(): allocates memory right behind application image in memory"
	help
	  Debug brk system Call Mechanism on X86 Architecture.

if DEBUG_SYSCALL_BRK

config DEBUG_SYSCALL_BRK0
	bool "System CALL: brk (linux0.11.1 MINIXFS)"
	help
	  BRK system call on linux0.11.1.

endif

endmenu
```

## tools/demo/posix/chdir/Kconfig
```kconfig
#
# POSIX: chdir
#

menu "chdir       change working directory"

config DEBUG_POSIX_CHDIR
	bool "chdir(): change current working directory"
	help
	  Debug chdir system Call Mechanism on X86 Architecture.

if DEBUG_POSIX_CHDIR

config DEBUG_CHDIR_ORIG
	bool "chdir(): original change current working directory"
	help
	  Debug original chdir().

config DEBUG_CHDIR_ROOTFS
	bool "chdir(): chdir operation on speical rootfs"
	help
	  Chdir on special rootfs.

endif

endmenu
```

## tools/demo/posix/close/Kconfig
```kconfig
#
# POSIX: close
#

menu "close       Close file/Directory/socket/pipe etc"

config DEBUG_POSIX_CLOSE
	bool "close(): Close file/Directory/socket/pipe etc"
	help
	  Debug close system Call Mechanism on X86 Architecture.

if DEBUG_POSIX_CLOSE

config DEBUG_CLOSE_ORIG
	bool "close(): original clsoe an opened file"
	help
	  Debug original close().

config DEBUG_CLOSE_ROOTFS
	bool "close(): close operation on speical rootfs"
	help
	  Close on special rootfs.

endif

endmenu
```

## tools/demo/posix/creat/Kconfig
```kconfig
#
# POSIX: creat
#

menu "creat       create a new file or rewrite an existing one"

config DEBUG_POSIX_CREAT
	bool "creat(): create a new file or rewrite an existing one"
	help
	  Debug creat system Call Mechanism on X86 Architecture.

if DEBUG_POSIX_CREAT

config DEBUG_CREAT_ORIG
	bool "creat(): original creat an nonexist file"
	help
	  Debug original creat().

config DEBUG_CREAT_ROOTFS
	bool "creat(): creat operation on speical rootfs"
	help
	  Close on special rootfs.

endif

endmenu
```

## tools/demo/posix/dup2/Kconfig
```kconfig
#
# System Call: dup2
#

menu "dup2        duplicate a file descriptor"

config DEBUG_SYSCALL_DUP2
	bool "dup2(): duplicate a file descriptor"
	help
	  Debug dup2 system Call Mechanism on X86 Architecture.

if DEBUG_SYSCALL_DUP2

config DEBUG_SYSCALL_DUP20
	bool "System CALL: dup2 (linux0.11.1 MINIXFS)"
	help
	  Dup2 system call on linux0.11.1.

endif

endmenu
```

## tools/demo/posix/exit/Kconfig
```kconfig
#
# POSIX: exit
#

menu "exit        exit current process"

config DEBUG_POSIX_EXIT
	bool "exit(): exit current process"
	help
	  Debug exit system Call Mechanism on X86 Architecture.

if DEBUG_POSIX_EXIT

config DEBUG_EXIT_ORIG
	bool "exit(): original exit current process"
	help
	  Debug original chdir().

config DEBUG_EXIT_ROOTFS
	bool "exit(): exit current process"
	help
	  Exit on special rootfs.

endif

endmenu
```

## tools/demo/posix/fcntl/Kconfig
```kconfig
#
# System Call: fcntl
#

menu "fcntl       manipulate file descriptor"

config DEBUG_SYSCALL_FCNTL
	bool "fcntl(): manipulate file descriptor"
	help
	  Debug fcntl system Call Mechanism on X86 Architecture.

if DEBUG_SYSCALL_FCNTL

config DEBUG_SYSCALL_FCNTL0
	bool "System CALL: fcntl (linux0.11.1 MINIXFS)"
	help
	  Fcntl system call on linux0.11.1.

endif

endmenu
```

## tools/demo/posix/fork/Kconfig
```kconfig
#
# POSIX: fork
#

menu "fork        create a new process"

config DEBUG_POSIX_FORK
	bool "fork(): create a new process"
	help
	  Debug fork system Call Mechanism on X86 Architecture.

if DEBUG_POSIX_FORK

config DEBUG_FORK_ORIG
	bool "fork(): original fork a new process"
	help
	  Debug original fork().

config DEBUG_FORK_ROOTFS
	bool "fork(): fork operation on speical rootfs"
	help
	  Fork on special rootfs.

endif

endmenu
```

## tools/demo/posix/fstat/Kconfig
```kconfig
#
# System Call: fstat
#

menu "fstat       -- unknow system call"

config DEBUG_SYSCALL_FSTAT
	bool "fstat(): unknow system call"
	help
	  Debug fstat system Call Mechanism on X86 Architecture.

if DEBUG_SYSCALL_FSTAT

config DEBUG_SYSCALL_FSTAT0
	bool "System CALL: fstat (linux0.11.1 MINIXFS)"
	help
	  Fstat system call on linux0.11.1.

endif

endmenu
```

## tools/demo/posix/ftime/Kconfig
```kconfig
#
# System Call: ftime
#

menu "ftime       get date and time (LEGACY)"

config DEBUG_SYSCALL_FTIME
	bool "ftime(): get date and time (LEGACY)"
	help
	  Debug ftime system Call Mechanism on X86 Architecture.

if DEBUG_SYSCALL_FTIME

config DEBUG_SYSCALL_FTIME0
	bool "System CALL: ftime (linux0.11.1 MINIXFS)"
	help
	  Ftime system call on linux0.11.1.

endif

endmenu
```

## tools/demo/posix/getpgrp/Kconfig
```kconfig
#
# System Call: getpgrp
#

menu "getpgrp     get pgrp of current task"

config DEBUG_SYSCALL_GETPGRP
	bool "getpgrp(): get pgrp of current task"
	help
	  Debug getpgrp system Call Mechanism on X86 Architecture.

if DEBUG_SYSCALL_GETPGRP

config DEBUG_SYSCALL_GETPGRP0
	bool "System CALL: getpgrp (linux0.11.1 MINIXFS)"
	help
	  Getpgrp system call on linux0.11.1.

endif

endmenu
```

## tools/demo/posix/getppid/Kconfig
```kconfig
#
# System Call: getppid
#

menu "getppid     get the parent process ID"

config DEBUG_SYSCALL_GETPPID
	bool "getppid(): get the parent process ID"
	help
	  Debug getppid system Call Mechanism on X86 Architecture.

if DEBUG_SYSCALL_GETPPID

config DEBUG_SYSCALL_GETPPID0
	bool "System CALL: getppid (linux0.11.1 MINIXFS)"
	help
	  Getppid system call on linux0.11.1.

endif

endmenu
```

## tools/demo/posix/lock/Kconfig
```kconfig
#
# System Call: lock
#

menu "lock        -- unknown system call --"

config DEBUG_SYSCALL_LOCK
	bool "lock(): -- unknown system call --"
	help
	  Debug lock system Call Mechanism on X86 Architecture.

if DEBUG_SYSCALL_LOCK

config DEBUG_SYSCALL_LOCK0
	bool "System CALL: lock (linux0.11.1 MINIXFS)"
	help
	  Lock system call on linux0.11.1.

endif

endmenu
```

## tools/demo/posix/mknod/Kconfig
```kconfig
#
# System Call: mknod
#

menu "mknod       make a directory, a special file, or a regular file"

config DEBUG_SYSCALL_MKNOD
	bool "mknod() : make a directory, a special file, or a regular file"
	help
	  Debug mknod system Call Mechanism on X86 Architecture.

if DEBUG_SYSCALL_MKNOD

config DEBUG_SYSCALL_MKNOD0
	bool "System CALL: mknod (linux0.11.1 MINIXFS)"
	help
	  mknod system call on linux0.11.1.

endif

endmenu
```

## tools/demo/posix/open/Kconfig
```kconfig
#
# POSIX system call: open
#

menu "open        Open file/Directory/socket/pipe etc"

config DEBUG_POSIX_OPEN
	bool "Main routine for opening file/Directory/socket/pipe etc"
	help
	  Debug open() main routine.

if DEBUG_POSIX_OPEN

config DEBUG_OPEN_ORIG
	bool "open(): original posix open()"

config DEBUG_OPEN_FILE
	bool "open(): To open a regular file"
	help
	  Debug main routine for opening regular file.

config DEBUG_CREAT_FILE
	bool "open(): create a non-exist file"
	select DEBUG_OPEN_NAMEI
	help
	  Create a non-exist file on sys_open.

config DEBUG_CREAT_ROOTFS
	bool "open(): create a file on special rootfs"
	select DEBUG_CREAT_FILE

config DEBUG_FILE_DESCRIBE
	bool "open(): parse structure -- file descriptor"
	help
	  Parse file descriptor.

config DEBUG_OPEN_NAMEI
	bool "open_namei(): open a inode on special rootfs"
	help
	  Parse open routinue with special Filesystem.

config DEBUG_LOOKUP_ROOTFS
	bool "open_dir(): lookup special inode of directory."
	select DEBUG_OPEN_NAMEI
	help
	  Lookup a special inode of directory on rootfs.

endif

endmenu
```

## tools/demo/posix/pause/Kconfig
```kconfig
#
# System Call: pause
#

menu "pause       suspend the thread until a signal is received"

config DEBUG_SYSCALL_PAUSE
	bool "pause(): suspend the thread until a signal is received"
	help
	  Debug pause system Call Mechanism on X86 Architecture.

if DEBUG_SYSCALL_PAUSE

config DEBUG_SYSCALL_PAUSE0
	bool "System CALL: pause (linux0.11.1 MINIXFS)"
	help
	  Pause system call on linux0.11.1.

endif

endmenu
```

## tools/demo/posix/read/Kconfig
```kconfig
#
# POSIX system call: read
#

menu "Read        Read data from a file/directory/socket/pipe etc"

config DEBUG_POSIX_READ
	bool "Main routine for reading file/Directory/socket/pipe etc"
	help
	  Debug read() main routine.

if DEBUG_POSIX_READ

config DEBUG_READ_ORIG
	bool "read(): original read operation"
	help
	  Debug original read operation.

config DEBUG_READ_ROOTFS
	bool "read(): read operation on special rootfs"
	help
	  Debug routine on special rootfs.

endif

endmenu
```

## tools/demo/posix/rmdir/Kconfig
```kconfig
#
# System Call: rmkdir
#

menu "rmdir       remove a existed directory"

config DEBUG_SYSCALL_RMDIR
	bool "rmdir() : remove a existed directory"
	help
	  Debug rmdir system Call Mechanism on X86 Architecture.

if DEBUG_SYSCALL_RMDIR

config DEBUG_SYSCALL_RMDIR0
	bool "System CALL: rmdir (linux0.11.1 MINIXFS)"
	help
	  Rmdir system call on linux0.11.1.

endif

endmenu
```

## tools/demo/posix/setreuid/Kconfig
```kconfig
#
# System Call: setreuid
#

menu "setreuid    set real and/or effective user or group ID "

config DEBUG_SYSCALL_SETREUID
	bool "setreuid(): set real and/or effective user or group ID "
	help
	  Debug setuid system Call Mechanism on X86 Architecture.

if DEBUG_SYSCALL_SETREUID

config DEBUG_SYSCALL_SETREUID0
	bool "System CALL: setreuid (linux0.11.1 MINIXFS)"
	help
	  Setreuid system call on linux0.11.1.

endif

endmenu
```

## tools/demo/posix/setuid/Kconfig
```kconfig
#
# System Call: setuid
#

menu "setuid      set user identity"

config DEBUG_SYSCALL_SETUID
	bool "setuid(): set user identity"
	help
	  Debug setuid system Call Mechanism on X86 Architecture.

if DEBUG_SYSCALL_SETUID

config DEBUG_SYSCALL_SETUID0
	bool "System CALL: setuid (linux0.11.1 MINIXFS)"
	help
	  Setuid system call on linux0.11.1.

endif

endmenu
```

## tools/demo/posix/setup/Kconfig
```kconfig
#
# POSIX system call: setup
#

menu "setup       Mount and initialize Rootfs"

config DEBUG_POSIX_SETUP
	bool "Mount and setup Rootfs"
	help
	  Debug setup() main routine.

endmenu
```
