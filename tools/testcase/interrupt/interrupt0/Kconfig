## tools/testcase/interrupt/interrupt5/Kconfig
```kconfig
#
# Interrupt 5 - BOUND Range Exceeded Exception (#BR)
#
menu "Interrupt 5 - BOUND Range Exceeded Exception (#BR)"

config DEBUG_INTERRUPT5
        bool "Interrupt 5 - BOUND Range Exceeded Exception (#BR)"
        help
	  Indicates that a BOUND-range-exceeded fault occurred when
	  a BOUND instruction was executed. The BOUND instruction 
	  checks that a signed array index is within the upper and 
	  lower bounds of an array located in memory. If the array 
	  index is not within the bounds of the array, a 
	  BOUND-range-exceeded fault is generated.

if DEBUG_INTERRUPT5

config DEBUG_SOFT_INT5
	bool "Trigger #BR by soft-interrupt 'int $0x05'"
	help
	  Trigger #BR by soft interrupt 'int $0x5'

config DEBUG_INT5_BOUND
	bool "Tirgger #BR by invoke index over BOUND"
	help
	  The BOUND instruction checks that a signed array index is 
	  within the upper and lower bounds of an array located
  	  in memory. If the array index is not within the bounds of 
	  the array, a BOUND-range-exceeded fault is generated.

config DEBUG_INT5_BNDCL
	bool "Trigger #BR by inovke BNDCL: index lower bound"
	help
	  Compare the address in the second operand with the lower 
	  bound in bnd. The second operand can be either a register 
	  or memory operand. If the address is lower than the lower 
	  bound in bnd.LD, it will set BNDSTATUS to 01H and signal 
	  a #BR exception.

config DEBUG_INT5_BNDCU
	bool "Trigger #BR by invoke BNDCU: index higher bound"
	help
	  Compare the address in the second operand with the upper 
	  bound in bnd. The second operand can be either a register 
	  or a memory operand. If the address is higher than the upper 
	  bound in bnd.UB, it will set BNDSTATUS to 01H and signal a 
	  #BR exception.

endif # End of DEBUG_INTERRUPT

endmenu
```

## tools/testcase/interrupt/interrupt6/Kconfig
```kconfig
#
# Interrupt 6 - Invalid Opcode Exception (#UD)
#
menu "Interrupt 6 - Invalid Opcode Exception (#UD)"

config DEBUG_INTERRUPT6
        bool "Interrupt 6 - Invalid Opcode Exception (#UD)"
        help
	  Indicate that the processor did one of the following things:
	  * Attempted to execute an invalid or reserved opcode.
	  * Attempted to execute an instruction with an operand type 
	    that is invalid for its accompanying opcode. for example, 
	    the source operand for a LES instruction is not a memory 
	    location.
	  * Detected a LOCK prefix that precedure an instruction that 
	    may not be locked or one that may be locked but the destination
	    operand is not a memory location.
	  * Attempted to execute an LLDT, SLDT, LTR, STR, LSL, LAR, VERR,
	    VERW, or ARPL instruction while in read-address or virtual-8086 
	    mode.

if DEBUG_INTERRUPT6

config DEBUG_SOFT_INT6
	bool "Trigger #UD by soft-interrupt 'int $0x06'"
	help
	  Trigger #UD by soft interrupt 'int $0x6'

config DEBUG_INT6_BOUND
	bool "Trigger #UD on BOUND instruction"
	help
	  If second operand is not a memory location.

endif # End of DEBUG_INTERRUPT

endmenu
```

## tools/testcase/interrupt/interrupt7/Kconfig
```kconfig
#
# Interrupt 7 - Device Not Available Exception (#NM)
#
menu "Interrupt 7 - Device Not Available Exception (#NM)"

config DEBUG_INTERRUPT7
        bool "Interrupt 7 - Device Not Available Exception (#NM)"
        help
	  The device-not-available exception is generated by either of 
	  thress conditions:
	  * The processor executed an X87 FPU floating-point instruction
	    while the EM flag in control register CR0 was set.
	  * The processor executed a WAIT/FWAIT instruction while the MP
	    and TS flags os register CR0 were set, regardless of the 
	    setting of the EM flag.

if DEBUG_INTERRUPT7

config DEBUG_SOFT_INT7
	bool "Trigger #NM by soft-interrupt 'int $0x07'"
	help
	  Trigger #NM by soft interrupt 'int $0x7'


endif # End of DEBUG_INTERRUPT

endmenu
```

## tools/testcase/interrupt/interrupt8/Kconfig
```kconfig
#
# Interrupt 8 - Double Fault Exception (#DF)
#
menu "Interrupt 8 - Double Fault Exception (#DF)"

config DEBUG_INTERRUPT8
        bool "Interrupt 8 - Double Fault Exception (#DF)"
        help
	  Indicates that the processor detected a second exception 
	  while calling an exception handler for a prior exception. 
	  Normally, when the processor detects another exception while
	  trying to call an exception handler, the two exceptions can
	  be handler serially. If, however, the processor cannot handle
	  them serially, it signals the double-fault exception. To
	  determine when two faults need to be signalled as a duble
	  fault, the processor divides the exceptions into three class.

if DEBUG_INTERRUPT8

config DEBUG_SOFT_INT8
	bool "Trigger #DF by soft-interrupt 'int $0x08'"
	help
	  Trigger #DF by soft interrupt 'int $0x8'

endif # End of DEBUG_INTERRUPT

endmenu
```

## tools/testcase/interrupt/interrupt9/Kconfig
```kconfig
#
# Interrupt 9 - Coprocessor Segment Overrun
#
menu "Interrupt 9 - Coprocessor Segment Overrun"

config DEBUG_INTERRUPT9
        bool "Interrupt 9 - Coprocessor Segment Overrun"
        help
	  Indicates that an Intel386 CPU-based system with an 
	  Intel 387 math coprocessor detected a page or segment
	  violation while transferring the middle portion of an
	  Intel 387 math coprocessor operand.

if DEBUG_INTERRUPT9

config DEBUG_SOFT_INT9
	bool "Trigger INT9 by soft-interrupt 'int $0x09'"
	help
	  Trigger INT9 by soft interrupt 'int $0x9'

endif # End of DEBUG_INTERRUPT

endmenu
```

## tools/testcase/ioports/Kconfig
```kconfig
#
# XT, AT and PS/2 I/O port addresses
#

menu "XT, AT and PS/2 I/O port addresses"

config TESTCASE_IOPORT
	bool "Test Intel, XT, AT and PS/2 IO port"
	help
	  XT, AT and PS/2 I/O port addresses

if TESTCASE_IOPORT

config TESTCASE_PORT_DMA
	bool "(0x00) first Direct Memory Access controller 8273"
	help
	  DMA 1 (first Direct Memory Access controller 8273)

config TESTCASE_PORT_CMOS
	bool "(0x70) CMOST RAM/RTC (Real Time Clock)"
	help
	  (0x70) CMOST RAM/RTC (Real Time Clock)

endif

endmenu
```

## tools/testcase/mmu/Kconfig
```kconfig
#
# Memeory Manager Unit
#

menu "MMU(Memory Manager Unit) on X86 Architecture"

config DEBUG_MMU
	bool "Debug MMU(Memory Manager Unit) machanism on X86 Architecture"
	help
	  Debug Memory Manager Unit(MMU).

if DEBUG_MMU

# Memory allocator
source "tools/testcase/mmu/allocator/Kconfig"

# Data Storage
source "tools/testcase/mmu/storage/Kconfig"

endif

endmenu
```

## tools/testcase/mmu/TLB/Kconfig
```kconfig
#
# TLB mechanism on MMU
#

menu "TLB (Cache Translation information)"

config DEBUG_MMU_TLB
	bool "Debug TLB mechanism on MMU"
	help
	  The IA-32 architecture may accelerate the address-translation
	  process by caching data from the paging structures on the
	  processor.

if DEBUG_MMU_TLB

config DEBUG_TLB
	bool "Caching address-translation information into TLB"
	help
	  Debug TLB and obtain address-translation information.

endif

endmenu
```

## tools/testcase/mmu/addressing/Kconfig
```kconfig
#
# Addressing Mechanism
#

menu "Addressing Mechanism"

config DEBUG_ADDRESSING
	bool "Memory addressing mechanism"
	help
	  Debug Memory addressing mechanism.

if DEBUG_ADDRESSING

# Paging mechanism
source "tools/testcase/mmu/addressing/paging/Kconfig"

endif

endmenu
```
