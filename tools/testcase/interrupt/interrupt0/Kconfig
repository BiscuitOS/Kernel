## tools/testcase/interrupt/interrupt0/Kconfig
```kconfig
#
# Interrupt 0 - Divide Error Exception (#DE)
#
menu "Interrupt 0 - Divide Error Exception (#DE)"

config DEBUG_INTERRUPT0
        bool "Interrupt 0 - Divide Error Exception (#DE)"
        help
	  Indicates the divisor operand for a DIV or IDIV instruction 
	  is 0 or that the result cannot be represented in the number 
	  of bits specified for the destination operand.

if DEBUG_INTERRUPT0

config DEBUG_DIVIDE_ZERO
	bool "Trigger #DE by DIV or IDIV instruction is 0"
	help 
	  Trigger #DE that indicates the divisor operand for a DIV or 
	  IDIV instruction is 0.

config DEBUG_OVERFLOW_BIT
	bool "Trigger #DE by result cannot be represented in destination"
	help
	  Trigger #DE that the result cannot be represented in the number 
          of bits specified for the destination operand.

config DEBUG_SOFT_INT0
	bool "Trigger #DE by soft-interrupt 'int $0x00'"
	help
	  Trigger #DE by soft interrupt 'int $0x0'

endif # End of DEBUG_INTERRUPT

endmenu
```

## tools/testcase/interrupt/interrupt1/Kconfig
```kconfig
#
# Interrupt 1 - Debug Exception (#DB)
#
menu "Interrupt 1 - Debug Exception (#DB)"

config DEBUG_INTERRUPT1
        bool "Interrupt 1 - Debug Exception (#DB)"
        help
	  Indicates that one or more of several debug-exception conditions 
	  has been detected. Whether the exception is a fault or a trap 
	  depends on the condition.

if DEBUG_INTERRUPT1

config DEBUG_SOFT_INT1
	bool "Trigger #DB by soft-interrupt 'int $0x01'"
	help
	  Trigger #DB by soft interrupt 'int $0x1'

config DEBUG_EFLAGS_TF
	bool "Trigger #DB by setting TF flag on EFLAGS"
	help
	  Trigger #DB by setting TF flag on EFLAGS register

endif # End of DEBUG_INTERRUPT

endmenu
```

## tools/testcase/interrupt/interrupt10/Kconfig
```kconfig
#
# Interrupt 10 - Invalid TSS Exception (#TS)
#
menu "Interrupt 10 - Invalid TSS Exception (#TS)"

config DEBUG_INTERRUPT10
        bool "Interrupt 10 - Invalid TSS Exception (#TS)"
        help
	  Indicates that there was an error related to a TSS. Such an
	  error might be detected during a task switch or during the
	  execution of instructions that use information from a TSS.
	  Table show the conditions that cause an invaild TSS exception
	  to be generated.

if DEBUG_INTERRUPT10

config DEBUG_SOFT_INT10
	bool "Trigger #TS by soft-interrupt 'int $0x0A'"
	help
	  Trigger #TS by soft interrupt 'int $0xA'

endif # End of DEBUG_INTERRUPT

endmenu
```

## tools/testcase/interrupt/interrupt11/Kconfig
```kconfig
#
# Interrupt 11 - Segment Not Present (#NP)
#
menu "Interrupt 11 - Segment Not Present (#NP)"

config DEBUG_INTERRUPT11
        bool "Interrupt 11 - Segment Not Present (#NP)"
        help
	  Indicates that the present flag of a semgnet or gate 
	  descriptor is clear. The processor can generated this 
	  exception during any of the following operations:
	  * While attempting to load CS, DS, ES, FS, or GS registers.
	    [Detection of a not-present segment while loading the 
	    SS register causes a task fault exception (#SS) to be 
	    generated.] This situation can occur while performing a
	    task switch.
	  * While attempting to load the LDTR using an LDT instruction.
	    Detection of a not-present LDT while loading the LDTR
	    during a task switch operation causes an invalid-TSS
	    exception (#TS) to be generated.
	  * When executing the LTR instruction and the TSS is marked
	    not present.
	  * While attempting to use a gate descriptor or TSS that
	    is marked segment-not-present, but is otherwise valid.
	  An operating system typically uses tht segment-not-present
	  exception to implement virtual memory at the segment level.
	  If the exception handler loads the segment and returns, the
	  interrupted program or task resumes exception.
	  A not-present indication in a gate descriptor, however, does
	  not indicate that a segment is not present (because gates
	  do not correspond to segments). The operating system may use
	  the present flag for gate descriptors to trigger exceptions
	  of specical significance to the operating system.
	  A contributory exception or page fault that subsequently 
	  referenced a not-present segment would cause a double fault
	  (#DF) to be generated instead of #NP.

if DEBUG_INTERRUPT11

config DEBUG_SOFT_INT11
	bool "Trigger #NP by soft-interrupt 'int $0x0B'"
	help
	  Trigger #NP by soft interrupt 'int $0xB'

config DEBUG_INT11_LLDT
	bool "Trigger #NP when loadding no-present LDT descriptor"
	help
	  While attempting to load the LDTR using an LDT instruction.
          Detection of a not-present LDT while loading the LDTR
          during a task switch operation causes an invalid-TSS
          exception (#TS) to be generated.

config DEBUG_INT11_LTR
	bool "Trigger #NP when loadding no-present LTR descriptor"
	help
	  While attempting to load the TSS using an LTR instruction.
          Detection of a not-present LTR while loading the TSS
          during a task switch operation causes an invalid-TSS
          exception (#TS) to be generated.

config DEBUG_INT11_MOV_DS
	bool "Trigger #NP when moving no-present into DS"
	help
	  Moving a no-present segment selector into DS will generate
	  #NP.

config DEBUG_INT11_MOV_ES
	bool "Trigger #NP when moving no-present into ES"
	help
	  Moving a no-present segment selector into ES will generate
	  #NP.

config DEBUG_INT11_MOV_FS
	bool "Trigger #NP when moving no-present into FS"
	help
	  Moving a no-present segment selector into FS will generate
	  #NP.

config DEBUG_INT11_MOV_GS
	bool "Trigger #NP when moving no-present into GS"
	help
	  Moving a no-present segment selector into GS will generate
	  #NP.

config DEBUG_INT11_POP_DS
	bool "Trigger #NP when poping no-present into DS"
	help
	  Poping a no-present segment selector into DS will generate
	  #NP.

config DEBUG_INT11_POP_ES
	bool "Trigger #NP when poping no-present into ES"
	help
	  Poping a no-present segment selector into ES will generate
	  #NP.

config DEBUG_INT11_POP_FS
	bool "Trigger #NP when poping no-present into FS"
	help
	  Poping a no-present segment selector into FS will generate
	  #NP.

config DEBUG_INT11_POP_GS
	bool "Trigger #NP when poping no-present into GS"
	help
	  Poping a no-present segment selector into GS will generate
	  #NP.

endif # End of DEBUG_INTERRUPT

endmenu
```

## tools/testcase/interrupt/interrupt12/Kconfig
```kconfig
#
# Interrupt 12 - Stack Fault Exception (#SS)
#
menu "Interrupt 12 - Stack Fault Exception (#SS)"

config DEBUG_INTERRUPT12
        bool "Interrupt 12 - Stack Fault Exception (#SS)"
        help
	  Indicates that one of the following stack related conditions
	  was detected:
	  * A limit violation is detected during an operation that 
	    refers to the SS register. Operations that can cause a
	    limit violation include stack-oriented instructions such
	    as POP, PUSH, CALL, RET, ENTER, and LEVE, as well as other
	    memory references which implicitly or explicitly use the
	    SS register (for example, `MOV AX, [BP+6]` or `MOV AX, 
	    SS:[EAX+6]`). The `ENTER` instruction generates this 
	    exception when there is not enough stack space for 
	    allocating local variables.
	  * A not-present stack segment is detected when attempting to
	    load the SS register. This violation can occur during the
	    exception of a stack switch, a CALL instruction to a 
	    different privilegel level, a return to a different 
	    privilege level, an LSS instruction, or a MOV or POP
	    instruction to the SS register.

if DEBUG_INTERRUPT12

config DEBUG_SOFT_INT12
	bool "Trigger #SS by soft-interrupt 'int $0x0C'"
	help
	  Trigger #SS by soft interrupt 'int $0xC'

endif # End of DEBUG_INTERRUPT

endmenu
```

## tools/testcase/interrupt/interrupt128/Kconfig
```kconfig
#
# Interrupt 128 - System Call
#
menu "Interrupt 128 - System Call"

config DEBUG_INTERRUPT128
        bool "Interrupt 128 - System Call"
        help
	  Indicates that an system Call to be generated.

if DEBUG_INTERRUPT128

config DEBUG_SOFT_INT128
	bool "Trigger System Call by soft-interrupt 'int $0x80'"
	help
	  Trigger System Call by soft interrupt 'int $0x80'

endif # End of DEBUG_INTERRUPT

endmenu
```

## tools/testcase/interrupt/interrupt13/Kconfig
```kconfig
#
# Interrupt 13 - General Protection Exception (#GP)
#
menu "Interrupt 13 - General Protection Exception (#GP)"

config DEBUG_INTERRUPT13
        bool "Interrupt 13 - General Protection Exception (#GP)"
        help
	  Indicates that the processor detector one of a class of 
	  protection violations called `general-protection violations`.
	  The conditions that cause this exception to be generated
	  comprise all the protection violations that do not cause
	  other exception to be generated (such as, invalid-TSS, 
	  segment-not-present, stack-fault, or page-fault exceptions).

if DEBUG_INTERRUPT13

config DEBUG_SOFT_INT13
	bool "Trigger #GP by soft-interrupt 'int $0x0D'"
	help
	  Trigger #GP by soft interrupt 'int $0xD'

endif # End of DEBUG_INTERRUPT

endmenu
```

## tools/testcase/interrupt/interrupt14/Kconfig
```kconfig
#
# Interrupt 14 - Page-Fault Exception (#PF)
#
menu "Interrupt 14 - Page-Fault Exception (#PF)"

config DEBUG_INTERRUPT14
        bool "Interrupt 14 - Page-Fault Exception (#PF)"
        help
	  Indicates that, with paging enable (the PG flag in the CR0
	  register is set), the processor detected one of the following
	  conditions while using the page-translation mechanism to
	  translate a linear address to a physical address

if DEBUG_INTERRUPT14

config DEBUG_SOFT_INT14
	bool "Trigger #PF by soft-interrupt 'int $0x0E'"
	help
	  Trigger #PF by soft interrupt 'int $0xE'

endif # End of DEBUG_INTERRUPT

endmenu
```

## tools/testcase/interrupt/interrupt16/Kconfig
```kconfig
#
# Interrupt 16 - X87 FPU Floating-Point Error (#MF)
#
menu "Interrupt 16 - X87 PFU Floating-Point Error (#MF)"

config DEBUG_INTERRUPT16
        bool "Interrupt 16 - X87 FPU Floating-Point Error (#MF)"
        help
	  Indicates that the X87 FPU has detected a floating-point
	  error. The NE flag in the reigster CR0 must be set for an
	  interrupt 16 (floating-point error exception) to be generated.

if DEBUG_INTERRUPT16

config DEBUG_SOFT_INT16
	bool "Trigger #MF by soft-interrupt 'int $0x10'"
	help
	  Trigger #MF by soft interrupt 'int $0x10'

endif # End of DEBUG_INTERRUPT

endmenu
```

## tools/testcase/interrupt/interrupt2/Kconfig
```kconfig
#
# Interrupt 2 - NMI Interrupt
#
menu "Interrupt 2 - Non-Maskable Interrupt (NMI)"

config DEBUG_INTERRUPT2
        bool "Interrupt 2 - Non-Maskable Interrupt (NMI)"
        help
	  In computing, a non-maskable interrupt (NMI) is a hardware 
	  interrupt that standard interrupt-masking techniques in the 
	  system cannot ignore. It typically occurs to signal attention 
	  for non-recoverable hardware errors. (Some NMIs may be masked, 
	  but only by using proprietary methods specific to the particular
	  NMI.)

if DEBUG_INTERRUPT2

config DEBUG_SOFT_INT2
	bool "Trigger NMI by soft-interrupt 'int $0x02'"
	help
	  Trigger NMI by soft interrupt 'int $0x2'

endif # End of DEBUG_INTERRUPT

endmenu
```

## tools/testcase/interrupt/interrupt3/Kconfig
```kconfig
#
# Interrupt 3 - Breakpoint Exception (#BP)
#
menu "Interrupt 3 - Breakpoint Exception (#BP)"

config DEBUG_INTERRUPT3
        bool "Interrupt 3 - Breakpoint Exception (#BP)"
        help
	  Indicates that a breakpoint instruction (INT 3, opcode CCH) was 
	  executed, causing a breakpoint trap to be generated. Typically, 
	  a debugger sets a breakpoint by replacing the first opcode byte 
	  of an instruction with the opcode for the INT 3 instruction. (
	  The INT 3 instruction is one byte long, which makes it easy to 
	  replace an opcode in a code segment in RAM with the breakpoint 
	  opcode). The operating system or a debugging tool can use a data 
	  segment mapped to the same physical address space as the code 
	  segment to place an INT 3 instruction in place where it is 
	  desired to call the debugger.

if DEBUG_INTERRUPT3

config DEBUG_SOFT_INT3
	bool "Trigger #BP by soft-interrupt 'int $0x03'"
	help
	  Trigger #BP by soft interrupt 'int $0x3'

config DEBUG_INT3_TF
	bool "Tirgger #BP by setting TF flag on EFLAGS"
	help
	  Trigger #BP by setting TF flag. When TF on EFLAGS is set,
	  the system will trigger interrupt 3.

endif # End of DEBUG_INTERRUPT

endmenu
```

## tools/testcase/interrupt/interrupt32/Kconfig
```kconfig
#
# Interrupt 32 - Timer Interrupt
#
menu "Interrupt 32 - Timer Interrupt"

config DEBUG_INTERRUPT32
        bool "Interrupt 32 - Timer Interrupt"
        help
	  Indicates timeout for Timer.

if DEBUG_INTERRUPT32

config DEBUG_SOFT_INT32
	bool "Trigger Timer Interrupt by soft-interrupt 'int $0x20'"
	help
	  Trigger Timer Interrupt by soft interrupt 'int $0x20'

endif # End of DEBUG_INTERRUPT

endmenu
```

## tools/testcase/interrupt/interrupt39/Kconfig
```kconfig
#
# Interrupt 39 - Parallel Interrupt
#
menu "Interrupt 39 - Parallel Interrupt"

config DEBUG_INTERRUPT39
        bool "Interrupt 39 - Parallel Interrupt"
        help
	  Indicates that a parallel interrupt to be generated.

if DEBUG_INTERRUPT39

config DEBUG_SOFT_INT39
	bool "Trigger Parallel Interrupt by soft-interrupt 'int $0x27'"
	help
	  Trigger Parallel Interrupt by soft interrupt 'int $0x27'

endif # End of DEBUG_INTERRUPT

endmenu
```

## tools/testcase/interrupt/interrupt4/Kconfig
```kconfig
#
# Interrupt 4 - Overflow Exception (#OF)
#
menu "Interrupt 4 - Overflow Exception (#OF)"

config DEBUG_INTERRUPT4
        bool "Interrupt 4 - Overflow Exception (#OF)"
        help
	  Indicates that an overflow trap occurred when an INTO 
	  instruction was executed. The INTO instruction checks 
	  the state of the OF flag in the EFLAGS register. If 
	  the OF flag is set, an overflow trap is generated.

if DEBUG_INTERRUPT4

config DEBUG_SOFT_INT4
	bool "Trigger #OF by soft-interrupt 'int $0x04'"
	help
	  Trigger #OF by soft interrupt 'int $0x4'

config DEBUG_INT4_INTO
	bool "Tirgger #OF by invoke INTO"
	help
	  Some arithmetic instructions (such as the ADD and SUB) 
	  perform both signed and unsigned signed arithmetic. These 
	  instructions set the OF and CF flags in the EFLAGS register
	  to indicate signed overflow and unsigned overflow, 
	  respectively. When performing arithmetic on signed operands,
 	  the OF flag can be tested directly or the INTO instruction
	  can be used. The benefit of using the INTO instruction is 
	  that if the overflow exception is detected, an exception 
	  handler can be called automatically to handler the overflow
	  condition.

endif # End of DEBUG_INTERRUPT

endmenu
```

## tools/testcase/interrupt/interrupt45/Kconfig
```kconfig
#
# Interrupt 45 - irq13
#
menu "Interrupt 45 - irq13"

config DEBUG_INTERRUPT45
        bool "Interrupt 45 - irq13"
        help
	  Indicates that an irq13 to be generated.

if DEBUG_INTERRUPT45

config DEBUG_SOFT_INT45
	bool "Trigger irq13 by soft-interrupt 'int $0x2D'"
	help
	  Trigger irq13 by soft interrupt 'int $0x2D'

endif # End of DEBUG_INTERRUPT

endmenu
```

## tools/testcase/interrupt/interrupt46/Kconfig
```kconfig
#
# Interrupt 46 - Hard-Disk interrupt
#
menu "Interrupt 46 - Hard-Disk interrupt"

config DEBUG_INTERRUPT46
        bool "Interrupt 46 - Hard-Disk interrupt"
        help
	  Indicates that an Hard-Disk interrupt to be generated.

if DEBUG_INTERRUPT46

config DEBUG_SOFT_INT46
	bool "Trigger Hard-Disk interrupt by soft-interrupt 'int $0x2E'"
	help
	  Trigger Hard-Disk interrupt by soft interrupt 'int $0x2E'

endif # End of DEBUG_INTERRUPT

endmenu
```
