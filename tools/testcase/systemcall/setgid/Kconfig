## tools/testcase/systemcall/setgid/Kconfig
```kconfig
#
# System Call: setgid
#

menu "setgid      Set the numerical group id"

config DEBUG_SYSCALL_SETGID
	bool "setgid(): Set the numerical group id"
	help
	  Debug setgid system Call Mechanism on X86 Architecture.

if DEBUG_SYSCALL_SETGID

config DEBUG_SYSCALL_SETGID0
	bool "System CALL: setgid (linux0.11.1 MINIXFS)"
	help
	  Setgid system call on linux0.11.1.

endif

endmenu
```

## tools/testcase/systemcall/setpgid/Kconfig
```kconfig
#
# System Call: setpgid
#

menu "setpgid     simplify pid/ns interaction"

config DEBUG_SYSCALL_SETPGID
	bool "setpgid(): simplify pid/ns interaction"
	help
	  Debug setpgid system Call Mechanism on X86 Architecture.

if DEBUG_SYSCALL_SETPGID

config DEBUG_SYSCALL_SETPGID0
	bool "System CALL: setpgid (linux0.11.1 MINIXFS)"
	help
	  Setpgid system call on linux0.11.1.

endif

endmenu
```

## tools/testcase/systemcall/setregid/Kconfig
```kconfig
#
# System Call: setregid
#

menu "setregid    Set the numerical group id"

config DEBUG_SYSCALL_SETREGID
	bool "setgreid(): Set the numerical group id"
	help
	  Debug setregid system Call Mechanism on X86 Architecture.

if DEBUG_SYSCALL_SETREGID

config DEBUG_SYSCALL_SETREGID0
	bool "System CALL: setregid (linux0.11.1 MINIXFS)"
	help
	  Setregid system call on linux0.11.1.

endif

endmenu
```

## tools/testcase/systemcall/setsid/Kconfig
```kconfig
#
# System Call: setsid
#

menu "setsid      creates a session and sets the process group ID"

config DEBUG_SYSCALL_SETSID
	bool "setsid(): creates a session and sets the process group ID"
	help
	  Debug setsid system Call Mechanism on X86 Architecture.

if DEBUG_SYSCALL_SETSID

config DEBUG_SYSCALL_SETSID0
	bool "System CALL: setsid (linux0.11.1 MINIXFS)"
	help
	  Setsid system call on linux0.11.1.

endif

endmenu
```

## tools/testcase/systemcall/stime/Kconfig
```kconfig
#
# System Call: stime
#

menu "stime       set time in seconds"

config DEBUG_SYSCALL_STIME
	bool "stime(): set time in seconds"
	help
	  Debug stime system Call Mechanism on X86 Architecture.

if DEBUG_SYSCALL_STIME

config DEBUG_SYSCALL_STIME0
	bool "System CALL: stime (linux0.11.1 MINIXFS)"
	help
	  Stime system call on linux0.11.1.

endif

endmenu
```

## tools/testcase/systemcall/stty/Kconfig
```kconfig
#
# System Call: stty
#

menu "stty        set mode of typewriter"

config DEBUG_SYSCALL_STTY
	bool "stty(): set mode of typewriter"
	help
	  Debug stty system Call Mechanism on X86 Architecture.

if DEBUG_SYSCALL_STTY

config DEBUG_SYSCALL_STTY0
	bool "System CALL: stty (linux0.11.1 MINIXFS)"
	help
	  Stty system call on linux0.11.1.

endif

endmenu
```

## tools/testcase/systemcall/time/Kconfig
```kconfig
#
# System Call: time
#

menu "time        get time in seconds"

config DEBUG_SYSCALL_TIME
	bool "time(): get time in seconds"
	help
	  Debug time system Call Mechanism on X86 Architecture.

if DEBUG_SYSCALL_TIME

config DEBUG_SYSCALL_TIME0
	bool "System CALL: time (linux0.11.1 MINIXFS)"
	help
	  Time system call on linux0.11.1.

endif

endmenu
```

## tools/testcase/systemcall/times/Kconfig
```kconfig
#
# System Call: times
#

menu "times       file access and modification times structure"

config DEBUG_SYSCALL_TIMES
	bool "times(): file access and modification times structure"
	help
	  Debug times system Call Mechanism on X86 Architecture.

if DEBUG_SYSCALL_TIMES

config DEBUG_SYSCALL_TIMES0
	bool "System CALL: times (linux0.11.1 MINIXFS)"
	help
	  Times system call on linux0.11.1.

endif

endmenu
```

## tools/testcase/systemcall/ulimit/Kconfig
```kconfig
#
# System Call: ulimit
#

menu "ulimit      get and set process limits"

config DEBUG_SYSCALL_ULIMIT
	bool "ulimit(): get and set process limits"
	help
	  Debug ftime system Call Mechanism on X86 Architecture.

if DEBUG_SYSCALL_ULIMIT

config DEBUG_SYSCALL_ULIMIT0
	bool "System CALL: ulimit (linux0.11.1 MINIXFS)"
	help
	  Ulimit system call on linux0.11.1.

endif

endmenu
```

## tools/testcase/systemcall/uname/Kconfig
```kconfig
#
# System Call: uname
#

menu "uname       get name and information about current kernel"

config DEBUG_SYSCALL_UNAME
	bool "uname(): get name and information about current kernel"
	help
	  Debug uname system Call Mechanism on X86 Architecture.

if DEBUG_SYSCALL_UNAME

config DEBUG_SYSCALL_UNAME0
	bool "System CALL: uname (linux0.11.1 MINIXFS)"
	help
	  Uname system call on linux0.11.1.

endif

endmenu
```

## tools/testcase/systemcall/unlink/Kconfig
```kconfig
#
# System Call: unlink
#

menu "unlink(): remove a symbolic link or a hard link to an existing file"

config DEBUG_SYSCALL_UNLINK
	bool "unlink() : remove a symbolic link or a hard link to an file"
	help
	  Debug unlink system Call Mechanism on X86 Architecture.

if DEBUG_SYSCALL_UNLINK

config DEBUG_SYSCALL_UNLINK0
	bool "System CALL: unlink (linux0.11.1 MINIXFS)"
	help
	  Unink system call on linux0.11.1.

endif

endmenu
```

## tools/testcase/systemcall/ustat/Kconfig
```kconfig
#
# System Call: ustat
#

menu "ustat:      -- unknow system call"

config DEBUG_SYSCALL_USTAT
	bool "ustat(): unknow system call"
	help
	  Debug ustat system Call Mechanism on X86 Architecture.

if DEBUG_SYSCALL_USTAT

config DEBUG_SYSCALL_USTAT0
	bool "System CALL: ustat (linux0.11.1 MINIXFS)"
	help
	  Ustat system call on linux0.11.1.

endif

endmenu
```

## tools/testcase/systemcall/utime/Kconfig
```kconfig
#
# System Call: utime
#

menu "utime       set file access and modification times"

config DEBUG_SYSCALL_UTIME
	bool "utime(): set file access and modification times"
	help
	  Debug utime system Call Mechanism on X86 Architecture.

if DEBUG_SYSCALL_UTIME

config DEBUG_SYSCALL_UTIME0
	bool "System CALL: utime (linux0.11.1 MINIXFS)"
	help
	  Utime system call on linux0.11.1.

endif

endmenu
```

## tools/testcase/timer/Kconfig
```kconfig
#
# Common Timer
#

menu "Timer and CMOS clock"

config TESTCASE_TIMER
	bool "Test Timer and CMOS clock"
	help
	  Timer and Timer Interrupt -- CMOS clock

if TESTCASE_TIMER

config TESTCASE_CMOS_CLK
	bool "CMOS Clock"
	help
	  Debug CMOS Clock.

config TESTCASE_8253
	bool "Intel 8253 Timer"
	help
	  Debug Intel 8253 Timer

endif

endmenu
```

## tools/testcase/vfs/Kconfig
```kconfig
#
# Debug VFS machanism on X86 architecture
#
menu "VFS Machanism on X86 Architecture"

config DEBUG_VFS
        bool "Debug VFS Machanism on X86 Architecture"
        help
          A virtual file system (VFS) or virtual filesystem switch is 
          an abstraction layer on top of a more concrete file system. 
          The purpose of a VFS is to allow client applications to access
          different types of concrete file systems in a uniform way. 
          A VFS can, for example, be used to access local and network
          storage devices transparently without the client application
          noticing the difference.

if DEBUG_VFS


source tools/testcase/vfs/buffer/Kconfig

endif # End of DEBUG_INTERRUPT

endmenu
```

## tools/testcase/vfs/buffer/Kconfig
```kconfig
#
# Debug Filesystem Buffer machanism on VFS
#
menu "Filesystem Buffer Machanism on VFS"

config DEBUG_VFS_BUFFER
        bool "Debug Filesystem Buffer Machanism on VFS"
        help
	  Filesystem buffer on VFS.

if DEBUG_VFS_BUFFER

config DEBUG_BUFFER_FREELIST
	bool "Debug free list of buffer head on Buffer"
	help
	  Debug free_list structure of buffer_head on Buffer.

endif # End of DEBUG_INTERRUPT

endmenu
```

## tools/testcase/vfs/minixfs/Kconfig
```kconfig
#
# Debug Filesystem: MINIX filesystem
#
menu "MINIX Filesystem"

config DEBUG_VFS_MINIXFS
        bool "Debug MINIX Filesystem"
        help
	  MINIXFS

if DEBUG_VFS_MINIXFS

config DEBUG_MINIXFS_BLOCK
	bool "Debug MINIXFS boot, super, inode, and zone block"
	help
	  MINIXFS boot block, super block, inode bit map, and zone bit map

endif # End of DEBUG_VFS_MINIXFS

endmenu
```
