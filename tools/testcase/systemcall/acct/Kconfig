## tools/testcase/systemcall/acct/Kconfig
```kconfig
#
# System Call: acct -- enable/disable process accounting
#

menu "acct(): enable/disable process accounting"

config DEBUG_SYSCALL_ACCT
	bool "acct(): enable/disable process accounting"
	help
	  Debug acct system Call Mechanism on X86 Architecture.

if DEBUG_SYSCALL_ACCT

config DEBUG_SYSCALL_ACCT0
	bool "System CALL: acct (linux0.11.1 MINIXFS)"
	help
	  Acct system call on linux0.11.1.

endif

endmenu
```

## tools/testcase/systemcall/break/Kconfig
```kconfig
#
# System Call: break
#

menu "break       call exists only for compatibility"

config DEBUG_SYSCALL_BREAK
	bool "break(): call exists only for compatibility"
	help
	  Debug break system Call Mechanism on X86 Architecture.

if DEBUG_SYSCALL_BREAK

config DEBUG_SYSCALL_BREAK0
	bool "System CALL: break (linux0.11.1 MINIXFS)"
	help
	  Break system call on linux0.11.1.

endif

endmenu
```

## tools/testcase/systemcall/chmod/Kconfig
```kconfig
#
# System Call: chmod
#

menu "chmod(): change permissions of a file"

config DEBUG_SYSCALL_CHMOD
	bool "chmod(): change permissions of a file"
	help
	  Debug chmod system Call Mechanism on X86 Architecture.

if DEBUG_SYSCALL_CHMOD

config DEBUG_SYSCALL_CHMOD0
	bool "System CALL: chmod (linux0.11.1 MINIXFS)"
	help
	  Chmod system call on linux0.11.1.

endif

endmenu
```

## tools/testcase/systemcall/chown/Kconfig
```kconfig
#
# System Call: chown
#

menu "chown(): change owner and group of a file"

config DEBUG_SYSCALL_CHOWN
	bool "chown(): change owner and group of a file"
	help
	  Debug chown system Call Mechanism on X86 Architecture.

if DEBUG_SYSCALL_CHOWN

config DEBUG_SYSCALL_CHOWN0
	bool "System CALL: chown (linux0.11.1 MINIXFS)"
	help
	  Chown system call on linux0.11.1.

endif

endmenu
```

## tools/testcase/systemcall/chroot/Kconfig
```kconfig
#
# System Call: chroot
#

menu "chroot      change root directory"

config DEBUG_SYSCALL_CHROOT
	bool "chroot(): change root directory"
	help
	  Debug chroot system Call Mechanism on X86 Architecture.

if DEBUG_SYSCALL_CHROOT

config DEBUG_SYSCALL_CHROOT0
	bool "System CALL: chroot (linux0.11.1 MINIXFS)"
	help
	  Chroot system call on linux0.11.1.

endif

endmenu
```

## tools/testcase/systemcall/close/Kconfig
```kconfig
#
# System Call: close
#

menu "close(): Close file/Directory/socket/pipe etc"

config DEBUG_SYSCALL_CLOSE
	bool "close(): Close file/Directory/socket/pipe etc"
	help
	  Debug System Call Machanism on X86 Architecture.

if DEBUG_SYSCALL_CLOSE

config DEBUG_SYSCALL_CLOSE0
	bool "System CALL: Close (linux0.11.1 MINIXFS)"
	help
	  Close system call on linux0.11.1.

endif

endmenu
```

## tools/testcase/systemcall/dup/Kconfig
```kconfig
#
# System Call: dup
#

menu "dup         duplicate an open file descriptor"

config DEBUG_SYSCALL_DUP
	bool "dup(): duplicate an open file descriptor"
	help
	  Debug dup system Call Machanism on X86 Architecture.

if DEBUG_SYSCALL_DUP

config DEBUG_SYSCALL_DUP0
	bool "System CALL: dup (linux0.11.1 MINIXFS)"
	help
	  Dup system call on linux0.11.1.

endif

endmenu
```

## tools/testcase/systemcall/execve/Kconfig
```kconfig
#
# System Call: execve
#

menu "execve      execute a executable file"

config DEBUG_SYSCALL_EXECVE
	bool "execve(): execute a executable file"
	help
	  Debug execve system Call Machanism on X86 Architecture.

if DEBUG_SYSCALL_EXECVE

config DEBUG_SYSCALL_EXECVE0
	bool "System CALL: execve (linux0.11.1 MINIXFS)"
	help
	  Execve system call on linux0.11.1.

endif

endmenu
```

## tools/testcase/systemcall/fork/Kconfig
```kconfig
#
# System Call: fork
#

menu "fork(): create a new process"

config DEBUG_SYSCALL_FORK
	bool "dup(): create a new process"
	help
	  Debug fork system Call Mechanism on X86 Architecture.

if DEBUG_SYSCALL_FORK

config DEBUG_SYSCALL_FORK0
	bool "System CALL: fork (linux0.11.1 MINIXFS)"
	help
	  Fork system call on linux0.11.1.

endif

endmenu
```

## tools/testcase/systemcall/geteuid/Kconfig
```kconfig
#
# System Call: geteuid
#

menu "geteuid     get the effective user ID"

config DEBUG_SYSCALL_GETEUID
	bool "geteuid(): get the effective user ID"
	help
	  Debug geteuid system Call Mechanism on X86 Architecture.

if DEBUG_SYSCALL_GETEUID

config DEBUG_SYSCALL_GETEUID0
	bool "System CALL: geteuid (linux0.11.1 MINIXFS)"
	help
	  Geteuid system call on linux0.11.1.

endif

endmenu
```

## tools/testcase/systemcall/getgid/Kconfig
```kconfig
#
# System Call: getgid
#

menu "getgid      get the real group ID"

config DEBUG_SYSCALL_GETGID
	bool "getgid(): get the real group ID"
	help
	  Debug getgid system Call Mechanism on X86 Architecture.

if DEBUG_SYSCALL_GETGID

config DEBUG_SYSCALL_GETGID0
	bool "System CALL: getgid (linux0.11.1 MINIXFS)"
	help
	  Getgid system call on linux0.11.1.

endif

endmenu
```

## tools/testcase/systemcall/getpid/Kconfig
```kconfig
#
# System Call: getpid
#

menu "getpid      get the process ID"

config DEBUG_SYSCALL_GETPID
	bool "getpid(): get the process ID"
	help
	  Debug getpid system Call Mechanism on X86 Architecture.

if DEBUG_SYSCALL_GETPID

config DEBUG_SYSCALL_GETPID0
	bool "System CALL: getpid (linux0.11.1 MINIXFS)"
	help
	  Getpid system call on linux0.11.1.

endif

endmenu
```

## tools/testcase/systemcall/getuid/Kconfig
```kconfig
#
# System Call: getuid
#

menu "getuid      get a real user ID"

config DEBUG_SYSCALL_GETUID
	bool "getuid(): get a real user ID"
	help
	  Debug getuid system Call Mechanism on X86 Architecture.

if DEBUG_SYSCALL_GETUID

config DEBUG_SYSCALL_GETUID0
	bool "System CALL: getuid (linux0.11.1 MINIXFS)"
	help
	  Getuid system call on linux0.11.1.

endif

endmenu
```

## tools/testcase/systemcall/gtty/Kconfig
```kconfig
#
# System Call: gtty
#

menu "gtty        get typewriter status"

config DEBUG_SYSCALL_GTTY
	bool "gtty(): get typewriter status"
	help
	  Debug gtty system Call Mechanism on X86 Architecture.

if DEBUG_SYSCALL_GTTY

config DEBUG_SYSCALL_GTTY0
	bool "System CALL: gtty (linux0.11.1 MINIXFS)"
	help
	  Gtty system call on linux0.11.1.

endif

endmenu
```

## tools/testcase/systemcall/link/Kconfig
```kconfig
#
# System Call: link
#

menu "link        create a symbolic link or a hard link to an existing file"

config DEBUG_SYSCALL_LINK
	bool "link() : create a symbolic link or a hard link to an file"
	help
	  Debug link system Call Machanism on X86 Architecture.

if DEBUG_SYSCALL_LINK

config DEBUG_SYSCALL_LINK0
	bool "System CALL: link (linux0.11.1 MINIXFS)"
	help
	  Link system call on linux0.11.1.

endif

endmenu
```

## tools/testcase/systemcall/lseek/Kconfig
```kconfig
#
# System Call: lseek
#

menu "lseek       reposition read/write file offset"

config DEBUG_SYSCALL_LSEEK
	bool "lseek(): reposition read/write file offset"
	help
	  Debug lseek system Call Mechanism on X86 Architecture.

if DEBUG_SYSCALL_LSEEK

config DEBUG_SYSCALL_LSEEK0
	bool "System CALL: lseek (linux0.11.1 MINIXFS)"
	help
	  Lseek system call on linux0.11.1.

endif

endmenu
```

## tools/testcase/systemcall/mkdir/Kconfig
```kconfig
#
# System Call: mkdir
#

menu "mkdir(): create a directory and specify access mode"

config DEBUG_SYSCALL_MKDIR
	bool "mkdir() : create a new directory and specify access mode"
	help
	  Debug mkdir system Call Mechanism on X86 Architecture.

if DEBUG_SYSCALL_MKDIR

config DEBUG_SYSCALL_MKDIR0
	bool "System CALL: mkdir (linux0.11.1 MINIXFS)"
	help
	  Mkdir system call on linux0.11.1.

endif

endmenu
```

## tools/testcase/systemcall/mount/Kconfig
```kconfig
#
# System Call: mount
#

menu "mount       mount filesystems"

config DEBUG_SYSCALL_MOUNT
	bool "mount(): mount filesystems"
	help
	  Debug mount system Call Mechanism on X86 Architecture.

if DEBUG_SYSCALL_MOUNT

config DEBUG_SYSCALL_MOUNT0
	bool "System CALL: mount (linux0.11.1 MINIXFS)"
	help
	  Mount system call on linux0.11.1.

endif

endmenu
```

## tools/testcase/systemcall/mpx/Kconfig
```kconfig
#
# System Call: mpx
#

menu "mpx         -- unknown legacy system call --"

config DEBUG_SYSCALL_MPX
	bool "mpx(): -- unknown legacy system call --"
	help
	  Debug mpx system Call Mechanism on X86 Architecture.

if DEBUG_SYSCALL_MPX

config DEBUG_SYSCALL_MPX0
	bool "System CALL: mpx (linux0.11.1 MINIXFS)"
	help
	  Mpx system call on linux0.11.1.

endif

endmenu
```

## tools/testcase/systemcall/nice/Kconfig
```kconfig
#
# System Call: nice
#

menu "nice        change the nice value of a process"

config DEBUG_SYSCALL_NICE
	bool "nice(): change the nice value of a process"
	help
	  Debug nice system Call Mechanism on X86 Architecture.

if DEBUG_SYSCALL_NICE

config DEBUG_SYSCALL_NICE0
	bool "System CALL: nice (linux0.11.1 MINIXFS)"
	help
	  Nice system call on linux0.11.1.

endif

endmenu
```

## tools/testcase/systemcall/open/Kconfig
```kconfig
#
# System Call: open
#

menu "open        Open file/Directory/socket/pipe etc"

config DEBUG_SYSCALL_OPEN
	bool "open(): Open file/Directory/socket/pipe etc"
	help
	  Debug System Call Machanism on X86 Architecture.

if DEBUG_SYSCALL_OPEN

config DEBUG_SYSCALL_OPEN0
	bool "System CALL: Open (linux0.11.1)"
	help
	  Open system call on linux0.11.1.

endif

endmenu
```

## tools/testcase/systemcall/phys/Kconfig
```kconfig
#
# System Call: phys
#

menu "phys        -- unknown system call --"

config DEBUG_SYSCALL_PHYS
	bool "phys(): -- unknown system call --"
	help
	  Debug phys system Call Mechanism on X86 Architecture.

if DEBUG_SYSCALL_PHYS

config DEBUG_SYSCALL_PHYS0
	bool "System CALL: phys (linux0.11.1 MINIXFS)"
	help
	  Phys system call on linux0.11.1.

endif

endmenu
```

## tools/testcase/systemcall/prof/Kconfig
```kconfig
#
# System Call: prof
#

menu "prof        -- unknown system call --"

config DEBUG_SYSCALL_PROF
	bool "prof(): -- unknown system call --"
	help
	  Debug prof system Call Mechanism on X86 Architecture.

if DEBUG_SYSCALL_PROF

config DEBUG_SYSCALL_PROF0
	bool "System CALL: prof (linux0.11.1 MINIXFS)"
	help
	  Prof system call on linux0.11.1.

endif

endmenu
```

## tools/testcase/systemcall/ptrace/Kconfig
```kconfig
#
# System Call: ptrace
#

menu "ptrace      process trace"

config DEBUG_SYSCALL_PTRACE
	bool "ptrace(): process trace"
	help
	  Debug ptrace system Call Mechanism on X86 Architecture.

if DEBUG_SYSCALL_PTRACE

config DEBUG_SYSCALL_PTRACE0
	bool "System CALL: ptrace (linux0.11.1 MINIXFS)"
	help
	  Ptrace system call on linux0.11.1.

endif

endmenu
```

## tools/testcase/systemcall/rename/Kconfig
```kconfig
#
# System Call: rename
#

menu "rename      Renames a specified file"

config DEBUG_SYSCALL_RENAME
	bool "rename(): Renames a specified file"
	help
	  Debug rename system Call Mechanism on X86 Architecture.

if DEBUG_SYSCALL_RENAME

config DEBUG_SYSCALL_RENAME0
	bool "System CALL: rename (linux0.11.1 MINIXFS)"
	help
	  Rename system call on linux0.11.1.

endif

endmenu
```
