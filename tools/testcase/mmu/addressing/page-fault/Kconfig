## tools/testcase/systemcall/Kconfig
```kconfig
#
# Common System Call
#

menu "System CAll Mechanism"

config DEBUG_SYSCALL
	bool "Debug System CAll Mechanism on X86 Architecture"
	help
	  Debug System Call Machanism on X86 Architecture.

if DEBUG_SYSCALL

config DEBUG_SYSCALL_ROUTINE
	bool "System CAll common routine from IDT"
	help
	  The routine of system call on IDT, GDT and LDT.

config DEBUG_SYSCALL_STACK
	bool "Stack map on trigger system call"
	help
	  The stack map on trigger system call.

source tools/testcase/systemcall/open/Kconfig

source tools/testcase/systemcall/close/Kconfig

source tools/testcase/systemcall/read/Kconfig

source tools/testcase/systemcall/write/Kconfig

source tools/testcase/systemcall/dup/Kconfig

source tools/testcase/systemcall/fork/Kconfig

source tools/testcase/systemcall/execve/Kconfig

source tools/testcase/systemcall/creat/Kconfig

source tools/testcase/systemcall/link/Kconfig

source tools/testcase/systemcall/unlink/Kconfig

source tools/testcase/systemcall/mkdir/Kconfig

source tools/testcase/systemcall/rmdir/Kconfig

source tools/testcase/systemcall/mknod/Kconfig

source tools/testcase/systemcall/access/Kconfig

source tools/testcase/systemcall/acct/Kconfig

source tools/testcase/systemcall/alarm/Kconfig

source tools/testcase/systemcall/chdir/Kconfig

source tools/testcase/systemcall/chmod/Kconfig

source tools/testcase/systemcall/chown/Kconfig

source tools/testcase/systemcall/utime/Kconfig

source tools/testcase/systemcall/chroot/Kconfig

source tools/testcase/systemcall/ustat/Kconfig

source tools/testcase/systemcall/fstat/Kconfig

source tools/testcase/systemcall/stat/Kconfig

source tools/testcase/systemcall/getpid/Kconfig

source tools/testcase/systemcall/getuid/Kconfig

source tools/testcase/systemcall/pause/Kconfig

source tools/testcase/systemcall/nice/Kconfig

source tools/testcase/systemcall/getgid/Kconfig

source tools/testcase/systemcall/geteuid/Kconfig

source tools/testcase/systemcall/getppid/Kconfig

source tools/testcase/systemcall/time/Kconfig

source tools/testcase/systemcall/stime/Kconfig

source tools/testcase/systemcall/times/Kconfig

source tools/testcase/systemcall/ftime/Kconfig

source tools/testcase/systemcall/ulimit/Kconfig

source tools/testcase/systemcall/mpx/Kconfig

source tools/testcase/systemcall/lock/Kconfig

source tools/testcase/systemcall/phys/Kconfig

source tools/testcase/systemcall/prof/Kconfig

source tools/testcase/systemcall/gtty/Kconfig

source tools/testcase/systemcall/stty/Kconfig

source tools/testcase/systemcall/ptrace/Kconfig

source tools/testcase/systemcall/getpgrp/Kconfig

source tools/testcase/systemcall/setsid/Kconfig

source tools/testcase/systemcall/umask/Kconfig

source tools/testcase/systemcall/uname/Kconfig

source tools/testcase/systemcall/setpgid/Kconfig

source tools/testcase/systemcall/setgid/Kconfig

source tools/testcase/systemcall/setregid/Kconfig

source tools/testcase/systemcall/brk/Kconfig

source tools/testcase/systemcall/setuid/Kconfig

endif

endmenu
```

## tools/testcase/systemcall/access/Kconfig
```kconfig
#
# System Call: access
#

menu "access      determine accessibility of a file"

config DEBUG_SYSCALL_ACCESS
	bool "access(): determine accessibility of a file"
	help
	  Debug access system Call Mechanism on X86 Architecture.

if DEBUG_SYSCALL_ACCESS

config DEBUG_SYSCALL_ACCESS0
	bool "System CALL: access (linux0.11.1 MINIXFS)"
	help
	  Access system call on linux0.11.1.

endif

endmenu
```
