## tools/testcase/mmu/addressing/page-fault/Kconfig
```kconfig
#
# Page-Fault Exceptions
#

menu "Page-Fault Exceptions on MMU"

config DEBUG_MMU_PAGE_FAULT
	bool "Debug Page fault on MMU"
	help
	  Accesses using linear addresses may cause page-fault exception 
	  (#PF). An linear address may cause a page-fault exception for
	  either of two reason:
	   1) There is no translation for the linear address
	   2) There is a translation for the linear address, but its access
	      rights do not permit the access.

if DEBUG_MMU_PAGE_FAULT

config DEBUG_PAGE_FAULT
	bool "Debug Page fault on paging-mode"
	help
	  Accesses using linear addresses may cause page-fault exception 
          (#PF). An linear address may cause a page-fault exception for
          either of two reason:
           1) There is no translation for the linear address
           2) There is a translation for the linear address, but its access
              rights do not permit the access.

endif

endmenu
```

## tools/testcase/mmu/addressing/paging/Kconfig
```kconfig
#
# Paging Mechanism on X86 Architecture
#

menu "Paging Mechanism on X86 Architecture"

config DEBUG_MMU_PAGING
	bool "Debug Paging mechanism on X86 Architecture."
	help
	  Debug Paging mechanism on X86 Architecture.

if DEBUG_MMU_PAGING

config DEBUG_PAGING_REGISTER
	bool "Debug all Registers on Paging Mode"
	help
	  Debug all Registerson Paging Mode.

endif

endmenu
```

## tools/testcase/mmu/allocator/Kconfig
```kconfig
#
# Memeory Manager Unit
#

menu "Common Memory Allocator"

config DEBUG_MEMORY_ALLOCATOR
	bool "Common Memory Allocator"
	help
	  Debug Memory Allocator.

if DEBUG_MEMORY_ALLOCATOR

# Kmalloc allocator
source "tools/testcase/mmu/allocator/kmalloc/Kconfig"

# Page allocator
source "tools/testcase/mmu/allocator/page/Kconfig"

# vmalloc allocator
source "tools/testcase/mmu/allocator/vmalloc/Kconfig"

endif

endmenu
```

## tools/testcase/mmu/allocator/kmalloc/Kconfig
```kconfig
#
# Kmalloc memory allocator on MMU
#

menu "Kmalloc memory allocator on MMU"

config DEBUG_MMU_KMALLOC
	bool "Debug kmalloc memory allocator on MMU"
	help
	  Debug kmalloc memory allocator on MMU.

if DEBUG_MMU_KMALLOC

config DEBUG_KMALLOC_ALLOCATOR
	bool "Extablish a kmalloc allocator."
	help
	  Extablish a kmalloc allocator.

config DEBUG_KMALLOC_USAGE
	bool "Utilize 'kmalloc' to allocate memory."
	help
	  Utilize 'kmalloc' to allocate spcial memory.

if DEBUG_KMALLOC_USAGE

config FIRST_ALLOC_MEMORY
	bool "First allocate memory for special order size."
	help
	  First allocate memory that cause the system allocate
	  new page.

config ALLOC_MORE_PAGE
	bool "Allocate memory cause allocate new page."
	help
	  Allocate memory cause the system allocate new page
	  expect first page.

config ALLOC_OVER_MAX_KMALLOC_K
	bool "Allocate memory size over MAX_KMALLOC_K"
	help
	  Allocate memory size over MAX_KMALLOC_K.

config ALLOC_WITH_GFP_BUFFER
	bool "Allocate memory with GFP_BUFFER"
	help
	  Allocate memory with GFP_BUFFER.

config ALLOC_WITH_GFP_ATOMIC
	bool "Allocate memory with GFP_ATOMIC"
	help
	  Allocate memory with GFP_ATOMIC.

config ALLOC_WITH_GFP_USER
	bool "Allocate memory with GFP_USER"
	help
	  Allocate memory with GFP_USER.

config ALLOC_WITH_GFP_KERNEL
	bool "Allocate memory with GFP_KERNEL"
	help
	  Allocate memory with GFP_KERNEL.

endif

endif

endmenu
```

## tools/testcase/mmu/allocator/page/Kconfig
```kconfig
#
# Get one free page
#

menu "Free page memory allocator"

config DEBUG_PAGE_ALLOCATOR
	bool "Free Page Memory Allocator"
	help
	  Debug free page memory allocator.

if DEBUG_PAGE_ALLOCATOR

config GET_FREE_ZERO_PAGE
	bool "Obtain one free zero page"
	help
	  Obtain one free zero page.

endif

endmenu
```

## tools/testcase/mmu/allocator/vmalloc/Kconfig
```kconfig
#
# Vmalloc memory allocator on MMU
#

menu "Vmalloc memory allocator on MMU"

config DEBUG_MMU_VMALLOC
	bool "Debug vmalloc memory allocator on MMU"
	help
	  Debug vmalloc memory allocator on MMU.

endmenu
```

## tools/testcase/mmu/kmalloc/Kconfig
```kconfig
#
# Kmalloc memory allocator on MMU
#

menu "Kmalloc memory allocator on MMU"

config DEBUG_MMU_KMALLOC
	bool "Debug kmalloc memory allocator on MMU"
	help
	  Debug kmalloc memory allocator on MMU.

if DEBUG_MMU_KMALLOC

config DEBUG_KMALLOC_ALLOCATOR
	bool "Extablish a kmalloc allocator."
	help
	  Extablish a kmalloc allocator.

config DEBUG_KMALLOC_USAGE
	bool "Utilize 'kmalloc' to allocate memory."
	help
	  Utilize 'kmalloc' to allocate spcial memory.

endif

endmenu
```

## tools/testcase/mmu/logic/Kconfig
```kconfig
#
# Logical Address Machanism on MMU
#

menu "Logical Address Machanism on MMU"

config DEBUG_MMU_LOGIC
	bool "Debug Logical Address machanism on MMU"
	help
	  Debug Logical Address Machanism on MMU.

if DEBUG_MMU_LOGIC

config DEBUG_LOGIC
	bool "Debug base Logical address and convent to linear address"
	help
	  Debug Logical address convent linear address.

endif

endmenu
```

## tools/testcase/mmu/paging/Kconfig
```kconfig
#
# Paging Mechanism on X86 Architecture
#

menu "Paging Mechanism on X86 Architecture"

config DEBUG_MMU_PAGING
	bool "Debug Paging mechanism on X86 Architecture."
	help
	  Debug Paging mechanism on X86 Architecture.

if DEBUG_MMU_PAGING

config DEBUG_PAGING_CR0
	bool "Debug CR0 Control Register on Paging Mode"
	help
	  Debug Control Register CR0 on Paging Mode

endif

endmenu
```

## tools/testcase/mmu/pgtable/Kconfig
```kconfig
#
# Two-Level Page-Table Machanism on MMU
#

menu "Two-Level Page-Table Machanism on MMU"

config DEBUG_MMU_PGTABLE
	bool "Debug Two-Level Page-Table machanism on MMU"
	help
	  Debug Two-Level Page-Table Machanism on MMU.

if DEBUG_MMU_PGTABLE

config DEBUG_PGDIR
	bool "Page Dirent on Two-Level Page-Table"
	help
	  Debug Page Dirent on Two-Level Page-Table.

config DEBUG_PGTABLE
	bool "Page Table on Two-Level Page-Table"
	help
	  Debug Page Table on Two-Level Page-Table.

endif

endmenu
```

## tools/testcase/mmu/physic/Kconfig
```kconfig
#
# Physical Address Machanism on MMU
#

menu "Physic Address Machanism on MMU"

config DEBUG_MMU_PHYSIC
	bool "Debug Physic Address machanism on MMU"
	help
	  Debug Physic Address Machanism on MMU.

if DEBUG_MMU_PHYSIC


endif

endmenu
```

## tools/testcase/mmu/right/Kconfig
```kconfig
#
# Access Right Machanism on MMU
#

menu "Paging Access Right Mechanism on MMU"

config DEBUG_MMU_ACCESS
	bool "Debug Paging Access Right mechanism on MMU"
	help
	  Debug Paging Access Right Mechanism on MMU.

if DEBUG_MMU_ACCESS

config DEBUG_ACCESS_RIGHT
	bool "Debug Address Access Right on Paging"
	help
	  Debug Address Access Right on Paging.

endif

endmenu
```

## tools/testcase/mmu/segmentation/Kconfig
```kconfig
#
# The Segmentation Mechanism on X86
#

menu "The Segmentation Mechanism on X86 Architecture."

config DEBUG_MMU_SEGMENTATION
	bool "Debug Segmentation mechanism on X86 Architecture"
	help
	  Debug Segmentation mechanism on X86 Architecture.

if DEBUG_MMU_SEGMENTATION


endif

endmenu
```

## tools/testcase/mmu/storage/Kconfig
```kconfig
#
# Data storage, general recording of information
#

menu "Data storage: Main Memory, Buffer, Cache ..."

config DEBUG_STORAGE
	bool "Debug Data Storage, Memory, ROM, TLB...."
	help
	  Debug Data Storage.

if DEBUG_STORAGE

# Main Memory
source "tools/testcase/mmu/storage/memory/Kconfig"

# Filesystem Buffer
source "tools/testcase/mmu/storage/buffer/Kconfig"

# Register
source "tools/testcase/mmu/storage/register/Kconfig"

endif

endmenu
```

## tools/testcase/mmu/storage/buffer/Kconfig
```kconfig
#
# Filesystem Buffer: 
#

menu "Buffer:   Virtual Filesystem Buffer"

config DEBUG_BUFFER
	bool "Virtual Filesystem Data Buffer"
	help
	  Data buffer (or just buffer) is a region of a physical 
	  memory storage used to temporarily store data while it 
	  is being moved from one place to another.

if DEBUG_BUFFER

config DEBUG_BUFFER_INIT
	bool "Initialize VFS Buffer, establish free_list"
	help
	  Initialize VFS buffer.

endif

endmenu
```

## tools/testcase/mmu/storage/memory/Kconfig
```kconfig
#
# Main Memory: 
#

menu "Primary storage (main memory or internal memory)"

config DEBUG_MAIN_MEMORY
	bool "Primary storage: main memory or internal memory"
	help
	  Primary storage (also known as main memory or internal memory), 
	  often referred to simply as memory, is the only one directly 
	  accessible to the CPU. The CPU continuously reads instructions 
	  stored there and executes them as required. Any data actively 
	  operated on is also stored there in uniform manner.

if DEBUG_MAIN_MEMORY

config DEBUG_DETECT_MEMORY
	bool "Detect system memory information"
	help
	  Detect system memory informtion from BIOS, ld and so on.

if DEBUG_DETECT_MEMORY

config MEMORY_FROM_BIOS
	bool "Detect memory information from BIOS"
	help
	  Detect memory information from BIOS

config MEMORY_FROM_LD
	bool "Detect memory information from LD"
	help
	  Detect memory information from LD scriptor.

config MEMORY_FROM_TASK
	bool "Detect memory information from task_struct"
	help
	  Detect memory information from task_struct.

config MEMORY_FROM_GLOBAL_ARGUMENT
	bool "Detect memory information from global argument"
	help
	  Detect memory information from global argument.

endif # DEBUG_DETECT_MEMORY

config DEBUG_INIT_MEMORY
	bool "Initialize main memory"
	help
	  Debug main routine for memory initialiation.

endif # DEBUG_MAIN_MEMORY

endmenu
```

## tools/testcase/mmu/storage/register/Kconfig
```kconfig
#
# Register
#

menu "Register: X86 Common Register mechanism"

config DEBUG_REGISTER
	bool "Common Register Descriptor for X86 Architecture"
	help

if DEBUG_REGISTER

# CS Register
source "tools/testcase/mmu/storage/register/cs/Kconfig"

endif

endmenu
```

## tools/testcase/mmu/storage/register/cs/Kconfig
```kconfig
#
# CS: Code selector Register
#

menu "CS: Code selector Register"

config DEBUG_REGISTER_CS
	bool "CS: Code selector Register"
	help
	  Debug Code selector Register.

if DEBUG_REGISTER_CS

config DEBUG_SEGMENT_SELECTOR_CS
	bool "Parse CS segment selector."
	help
	  Parse CS Segment selector.

config DEBUG_SEGMENT_DESCRIPTOR_CS
	bool "Parse segment descriptor for CS."
	help
	  Parse Segment descriptor for CS.

endif

endmenu
```

## tools/testcase/mmu/virtual/Kconfig
```kconfig
#
# Virtual Address Machanism on MMU
#

menu "Virtual Address Machanism on MMU"

config DEBUG_MMU_VIRTUAL
	bool "Debug VIRTUAL Address mechanism on MMU"
	help
	  Debug VIRTUAL Address Mechanism on MMU.

if DEBUG_MMU_VIRTUAL

config DEBUG_MMU_VIRTUAL_TABLE
	bool "virtual address to physical via page table"
	help
	  Cover virtual address to physical address via page table.

endif

endmenu
```

## tools/testcase/scheduler/Kconfig
```kconfig
#
# Common scheduler
#

menu "Task scheduler"

config DEBUG_SCHED
	bool "Debug Task scheduler machanism on X86 architecture"
	help
	  Debug Task scheduler machanism on X86 architecture.

if DEBUG_SCHED

config DEBUG_GDT
	bool "GDT,LDT,GDTR,LDTR,IDTR,TR,Segment Descriptor"
	help
	  Debug Global Descriptor Table.

config DEBUG_SEGMENT
	bool "Segment (CS, SS, DS, FS, GS, ES)"
	select TESTCASE_GDT
	help
	  Debug Segment such as CS, SS, DS, FS, GS and ES.

config DEBUG_GATE
	bool "System descriptors(TSS,Call Gate,Trap)"
	select TESTCASE_GDT
	help
	  Debug system descritpor on GDT or LDT

config DEBUG_IDT
	bool "Gate on IDT(Call Gate, Task Gate, Trap Gate)"
	help
	  Debug Call Gate, Task Gate, Trap Gate on IDT.

config DEBUG_STACK
	bool "Stack: SS, ESP, EBP, Near call, Far call and Switching Stack"
	select TESTCASE_MULT_PRIVILEGE
	help
	  The Stack is a contiguous array of memory locations. It is 
	  contained in a segment and identified by the segment selector
	  in the SS register.

config DEBUG_MULT_PRIVILEGE
	depends on DEBUG_USERLAND_EARLY || DEBUG_USERLAND_SHELL
	bool "Stack switch on different privilege level"
	help
	 Stack switch on different privilege level

source tools/testcase/scheduler/task/Kconfig

endif

endmenu
```

## tools/testcase/scheduler/task/Kconfig
```kconfig
#
# Common task struct
#

menu "The machanism of task on x86 architecture"

config DEBUG_TASK
	bool "Debug task machanism on x86 architecture"
	help
	  Debug task machanism on x86 architecture.

if DEBUG_TASK

config DEBUG_TASK_STRUCT
	bool "Debug usage and perform procedure for task_struct"
	help
	  Debug the usage and perform porcedure for task_struct.

endif

endmenu
```

## tools/testcase/segment/Kconfig
```kconfig
#
# Segment mechanism on x86 architecture.
#
menu "Segment mechanism (Segment Access, Segmentation)"

config DEBUG_SEGMENT
        bool "Segment mechanism: Access different segment"
        help
	  Exchange data between different segment.

if DEBUG_SEGMENT

source tools/testcase/segment/fs/Kconfig

endif # End of DEBUG_BINARY


endmenu
```

## tools/testcase/segment/fs/Kconfig
```kconfig
#
# Data segment: FS
#
menu "FS Segment(Common Data Segment)"


config DEBUG_SEGMENT_FS
	bool "Exchange data between kernel and userland via FS segment"
	help
	  Exchange data between kernel and userland via FS segment

config DEBUG_SEGMENT_OBTAIN_USERLAND
	select DEBUG_SEGMENT_FS
	bool "Copy data from userland space to kernel space"
	help
	  Obtain data from userland space.

config DEBUG_SEGMENT_PUSH_KERNEL
	select DEBUG_SEGMENT_FS
	bool "Copy data from kernel space to userland space"
	help
	  Copy data to userland space.

endmenu
```
