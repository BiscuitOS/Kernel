## tools/demo/mmu/addressing/segment/privilege/Kconfig
```kconfig
menu "Privilege levels Check: CPL, DPL, and RPL"

config DEBUG_PL_CHECK
	bool "Privilege levels check mechanism"
	help
	  The checking mechanism of privilegel levels.

if DEBUG_PL_CHECK

choice
        prompt "Select specify segment selector"

config SEG_CHECK_KERNEL_CS
        bool "CS: Kernel code segment selector"

config SEG_CHECK_KERNEL_DS
        bool "DS: Kernel data segment selector"

config SEG_CHECK_KERNEL_SS
        bool "SS: Kernel stack segment selector"

config SEG_CHECK_USER_CS
        bool "CS: User code segment selector"

config SEG_CHECK_USER_FS
        bool "FS: User data segment selector"

config SEG_CHECK_USER_SS
        bool "SS: User stack segment selector"

config SEG_CHECK_LDT
        bool "LDT: Local descriptor Table segment selector"

config SEG_CHECK_TSS
        bool "TSS: Task Status segment selector"

endchoice

config DEBUG_MMU_PL_CPL
	bool "CPL: Current Privilege level"
	help
	  CPL: Current privilege level.

config DEBUG_MMU_PL_DPL
	bool "DPL: Descriptor Privilege level"
	help
	  DPL: Descriptor Privilege level.

config DEBUG_MMU_PL_RPL
	bool "RPL: Requested Privilege level"
	help
	  PRL: Requested Privilege level.

config DEBUG_PL_DATA
	bool "Privilege Checking when accessing Data Segment"
	select DEBUG_PL_DATA_ESTABLISH
	help
	  Privilege checking when accessing data segment.

if DEBUG_PL_DATA

config DEBUG_PL_DATA_ESTABLISH
	bool "Establish specify Data Segment Selector and Descriptor"
	help
	  Establish a specify segment selector and segment descriptor.

config DEBUG_PL_DATA_C0
	bool "CPL == RPL == DPL"
	help
	  CPL == DPL == RPL.

if DEBUG_PL_DATA_C0

config DEBUG_PL_DATA_C0_P0
	bool "CPL == RPL == DPL == 0"
	help
	  CPL == DPL == RPL == 0

config DEBUG_PL_DATA_C0_P1
	bool "CPL == RPL == DPL == 1"
	help
	  CPL == DPL == RPL == 1

config DEBUG_PL_DATA_C0_P2
	bool "CPL == RPL == DPL == 2"
	help
	  CPL == DPL == RPL == 2

config DEBUG_PL_DATA_C0_P3
	bool "CPL == RPL == DPL == 3"
	help
	  CPL == DPL == RPL == 3

endif # DEBUG_PL_DATA_C0

config DEBUG_PL_DATA_C1
	bool "CPL == RPL > DPL"
	help
	  CPL == RPL > DPL

if DEBUG_PL_DATA_C1

config DEBUG_PL_DATA_C1_P0
	bool "CPL:0 == RPL:0 > DPL:1"
	help
	  CPL == RPL == 0; DPL == 1

config DEBUG_PL_DATA_C1_P1
	bool "CPL:0 == PRL:0 > DPL:2"
	help
	  CPL == RPL == 0; DPL == 2

config DEBUG_PL_DATA_C1_P2
	bool "CPL:0 == RPL:0 > DPL:3"
	help
	  CPL == RPL == 0; DPL == 3

config DEBUG_PL_DATA_C1_P3
	bool "CPL:1 == RPL:1 > DPL:2"
	help
	  CPL == RPL == 1; DPL == 2

config DEBUG_PL_DATA_C1_P4
	bool "CPL:1 == RPL:1 > DPL:3"
	help
	  CPL == RPL == 1; DPL == 3

config DEBUG_PL_DATA_C1_P5
	bool "CPL:2 == RPL:2 > DPL:3"
	help
	  CPL == RPL == 2; DPL == 3

endif # DEBUG_PL_DATA_C1

config DEBUG_PL_DATA_C2
	bool "CPL > RPL == DPL"
	help
	  CPL > RPL == DPL

if DEBUG_PL_DATA_C2

config DEBUG_PL_DATA_C2_P0
	bool "CPL:0 > RPL:1 == DPL:1"
	help
	  CPL:0 > RPL:1 == DPL:1

config DEBUG_PL_DATA_C2_P1
	bool "CPL:0 > RPL:2 == DPL:2"
	help
	  CPL:0 > RPL:2 == DPL:2

config DEBUG_PL_DATA_C2_P2
	bool "CPL:0 > RPL:3 == DPL:3"
	help
	  CPL:0 > RPL:3 == DPL:3

config DEBUG_PL_DATA_C2_P3
	bool "CPL:1 > RPL:2 == DPL:2"
	help
	  CPL:1 > RPL:2 == DPL:2

config DEBUG_PL_DATA_C2_P4
	bool "CPL:1 > RPL:3 == DPL:3"
	help
	  CPL:1 > RPL:3 == DPL:3

config DEBUG_PL_DATA_C2_P5
	bool "CPL:2 > RPL:3 == DPL:3"
	help
	  CPL:2 > RPL:3 == DPL:3

endif # DEBUG_PL_DATA_C2

config DEBUG_PL_DATA_C3
	bool "CPL == RPL < DPL"
	help
	  CPL == RPL < DPL

if DEBUG_PL_DATA_C3

config DEBUG_PL_DATA_C3_P0
	bool "CPL:1 == RPL:1 < DPL:0"
	help
	  CPL:1 == RPL:1 < DPL:0

config DEBUG_PL_DATA_C3_P1
	bool "CPL:2 == RPL:2 < DPL:0"
	help
	  CPL:2 == RPL:2 < DPL:0

config DEBUG_PL_DATA_C3_P2
	bool "CPL:3 == RPL:3 < DPL:0"
	help
	  CPL:3 == RPL:3 < DPL:0

config DEBUG_PL_DATA_C3_P3
	bool "CPL:2 == RPL:2 < DPL:1"
	help
	  CPL:2 == RPL:2 < DPL:1

config DEBUG_PL_DATA_C3_P4
	bool "CPL:3 == RPL:3 < DPL:1"
	help
	  CPL:3 == RPL:3 < DPL:1

config DEBUG_PL_DATA_C3_P5
	bool "CPL:3 == RPL:3 < DPL:2"
	help
	  CPL:3 == RPL:3 < DPL:2

endif # DEBUG_PL_DATA_C3

config DEBUG_PL_DATA_C4
	bool "CPL < RPL == DPL"
	help
	  CPL < RPL == DPL

if DEBUG_PL_DATA_C4

config DEBUG_PL_DATA_C4_P0
	bool "CPL:1 < RPL:0 == DPL:0"
	help
	  CPL:1 < RPL:0 == DPL:0

config DEBUG_PL_DATA_C4_P1
	bool "CPL:2 < RPL:0 == DPL:0"
	help
	  CPL:2 < RPL:0 == DPL:0

config DEBUG_PL_DATA_C4_P2
	bool "CPL:3 < RPL:0 == DPL:0"
	help
	  CPL:3 < RPL:0 == DPL:0

config DEBUG_PL_DATA_C4_P3
	bool "CPL:2 < RPL:1 == DPL:1"
	help
	  CPL:2 < RPL:1 == DPL:1

config DEBUG_PL_DATA_C4_P4
	bool "CPL:3 < RPL:1 == DPL:1"
	help
	  CPL:3 < RPL:1 == DPL:1

config DEBUG_PL_DATA_C4_P5
	bool "CPL:3 < RPL:2 == DPL:2"
	help
	  CPL:3 < RPL:2 == DPL:2

endif # DEBUG_PL_DATA_C4

config DEBUG_PL_DATA_C5
	bool "CPL < RPL && RPL > DPL (RPL > DPL > CPL)"
	help
	  CPL < RPL && RPL > DPL

if DEBUG_PL_DATA_C5

config DEBUG_PL_DATA_C5_P0
	bool "CPL:2 < RPL:0 && RPL:0 > DPL:1"
	help
	  CPL:2 < DPL:1 < RPL:0

config DEBUG_PL_DATA_C5_P1
	bool "CPL:3 < RPL:0 && RPL:0 > DPL:1"
	help
	  CPL:3 < DPL:1 < RPL:0

config DEBUG_PL_DATA_C5_P2
	bool "CPL:3 < RPL:0 && RPL:0 > DPL:2"
	help
	  CPL:3 < DPL:2 < RPL:0

config DEBUG_PL_DATA_C5_P3
	bool "CPL:3 < RPL:1 && RPL:1 > DPL:2"
	help
	  CPL:3 < DPL:2 < RPL:1

endif # DEBUG_PL_DATA_C5

config DEBUG_PL_DATA_C6
	bool "CPL > RPL && RPL < DPL (CPL > DPL > RPL)"
	help
	  CPL > DPL > RPL

if DEBUG_PL_DATA_C6

config DEBUG_PL_DATA_C6_P0
	bool "CPL:0 > RPL:2 && RPL:2 < DPL:1"
	help
	  CPL:0 > DPL:1 > RPL:2

config DEBUG_PL_DATA_C6_P1
	bool "CPL:0 > RPL:3 && RPL:3 < DPL:1"
	help
	  CPL:0 > DPL:1 > RPL:3

config DEBUG_PL_DATA_C6_P2
	bool "CPL:1 > RPL:3 && RPL:3 < DPL:2"
	help
	  CPL:1 > DPL:2 > RPL:3

endif # DEBUG_PL_DATA_C6

config DEBUG_PL_DATA_C7
	bool "CPL > RPL > DPL"
	help
	  CPL > RPL > DPL

if DEBUG_PL_DATA_C7

config DEBUG_PL_DATA_C7_P0
	bool "CPL:0 > RPL:1 > DPL:2"
	help
	  CPL:0 > RPL:1 > DPL:2

config DEBUG_PL_DATA_C7_P1
	bool "CPL:0 > RPL:1 > DPL:3"
	help
	  CPL:0 > RPL:1 > DPL:3

config DEBUG_PL_DATA_C7_P2
	bool "CPL:0 > RPL:2 > DPL:3"
	help
	  CPL:0 > RPL:2 > DPL:3

config DEBUG_PL_DATA_C7_P3
	bool "CPL:1 > RPL:2 > DPL:3"
	help
	  CPL:1 > RPL:2 > DPL:3
	
endif # DEBUG_PL_DATA_C7

endif # DEBUG_PL_DATA

config DEBUG_PL_CS_DATA
	bool "Privilege checking when access data in Code Segment"
	select DEBUG_PL_CD_ESTABLISH
	help
	  Privilege Checking when accessing data in Code Segment.

if DEBUG_PL_CS_DATA

config DEBUG_PL_CD_ESTABLISH
	bool "Establish specify Code Segment Seletor and Descriptor"
	help
	  Establish Specify Code Segment Selector and Segment Descriptor.

choice
	prompt "Select Code Segment Type"

config DEBUG_PL_CD_CFM
	bool "Conforming, readable Code Segment"
	help
	  Conforming and readable Code Segment.

config DEBUG_PL_CD_UCFM
	bool "UnConforming, readable Code Segment"
	help
	  UnConforming and readable Code Segment.

endchoice

config DEBUG_PL_CD_C0
	bool "CPL == RPL == DPL"
	help
	  CPL == RPL == DPL

if DEBUG_PL_CD_C0

config DEBUG_PL_CD_C0_P0
	bool "CPL:0 == RPL:0 == DPL:0"
	help
	  CPL:0 == RPL:0 == DPL:0

config DEBUG_PL_CD_C0_P1
	bool "CPL:1 == RPL:1 == DPL:1"
	help
	  CPL:1 == RPL:1 == DPL:1

config DEBUG_PL_CD_C0_P2
	bool "CPL:2 == RPL:2 == DPL:2"
	help
	  CPL:2 == RPL:2 == DPL:2

config DEBUG_PL_CD_C0_P3
	bool "CPL:3 == RPL:3 == DPL:3"
	help
	  CPL:3 == RPL:3 == DPL:3

endif # DEBUG_PL_CD_C0

config DEBUG_PL_CD_C1
	bool "CPL == RPL > DPL"
	help
	  CPL == RPL > DPL

if DEBUG_PL_CD_C1

config DEBUG_PL_CD_C1_P0
	bool "CPL:0 == RPL:0 > DPL:1"
	help
	  CPL == RPL == 0; DPL == 1

config DEBUG_PL_CD_C1_P1
	bool "CPL:0 == PRL:0 > DPL:2"
	help
	  CPL == RPL == 0; DPL == 2

config DEBUG_PL_CD_C1_P2
	bool "CPL:0 == RPL:0 > DPL:3"
	help
	  CPL == RPL == 0; DPL == 3

config DEBUG_PL_CD_C1_P3
	bool "CPL:1 == RPL:1 > DPL:2"
	help
	  CPL == RPL == 1; DPL == 2

config DEBUG_PL_CD_C1_P4
	bool "CPL:1 == RPL:1 > DPL:3"
	help
	  CPL == RPL == 1; DPL == 3

config DEBUG_PL_CD_C1_P5
	bool "CPL:2 == RPL:2 > DPL:3"
	help
	  CPL == RPL == 2; DPL == 3

endif # DEBUG_PL_CD_C1

config DEBUG_PL_CD_C2
	bool "CPL > RPL == DPL"
	help
	  CPL > RPL == DPL

if DEBUG_PL_CD_C2

config DEBUG_PL_CD_C2_P0
	bool "CPL:0 > RPL:1 == DPL:1"
	help
	  CPL:0 > RPL:1 == DPL:1

config DEBUG_PL_CD_C2_P1
	bool "CPL:0 > RPL:2 == DPL:2"
	help
	  CPL:0 > RPL:2 == DPL:2

config DEBUG_PL_CD_C2_P2
	bool "CPL:0 > RPL:3 == DPL:3"
	help
	  CPL:0 > RPL:3 == DPL:3

config DEBUG_PL_CD_C2_P3
	bool "CPL:1 > RPL:2 == DPL:2"
	help
	  CPL:1 > RPL:2 == DPL:2

config DEBUG_PL_CD_C2_P4
	bool "CPL:1 > RPL:3 == DPL:3"
	help
	  CPL:1 > RPL:3 == DPL:3

config DEBUG_PL_CD_C2_P5
	bool "CPL:2 > RPL:3 == DPL:3"
	help
	  CPL:2 > RPL:3 == DPL:3

endif # DEBUG_PL_CD_C2

config DEBUG_PL_CD_C3
	bool "CPL == RPL < DPL"
	help
	  CPL == RPL < DPL

if DEBUG_PL_CD_C3

config DEBUG_PL_CD_C3_P0
	bool "CPL:1 == RPL:1 < DPL:0"
	help
	  CPL:1 == RPL:1 < DPL:0

config DEBUG_PL_CD_C3_P1
	bool "CPL:2 == RPL:2 < DPL:0"
	help
	  CPL:2 == RPL:2 < DPL:0

config DEBUG_PL_CD_C3_P2
	bool "CPL:3 == RPL:3 < DPL:0"
	help
	  CPL:3 == RPL:3 < DPL:0

config DEBUG_PL_CD_C3_P3
	bool "CPL:2 == RPL:2 < DPL:1"
	help
	  CPL:2 == RPL:2 < DPL:1

config DEBUG_PL_CD_C3_P4
	bool "CPL:3 == RPL:3 < DPL:1"
	help
	  CPL:3 == RPL:3 < DPL:1

config DEBUG_PL_CD_C3_P5
	bool "CPL:3 == RPL:3 < DPL:2"
	help
	  CPL:3 == RPL:3 < DPL:2

endif # DEBUG_PL_CD_C3

config DEBUG_PL_CD_C4
	bool "CPL < RPL == DPL"
	help
	  CPL < RPL == DPL

if DEBUG_PL_CD_C4

config DEBUG_PL_CD_C4_P0
	bool "CPL:1 < RPL:0 == DPL:0"
	help
	  CPL:1 < RPL:0 == DPL:0

config DEBUG_PL_CD_C4_P1
	bool "CPL:2 < RPL:0 == DPL:0"
	help
	  CPL:2 < RPL:0 == DPL:0

config DEBUG_PL_CD_C4_P2
	bool "CPL:3 < RPL:0 == DPL:0"
	help
	  CPL:3 < RPL:0 == DPL:0

config DEBUG_PL_CD_C4_P3
	bool "CPL:2 < RPL:1 == DPL:1"
	help
	  CPL:2 < RPL:1 == DPL:1

config DEBUG_PL_CD_C4_P4
	bool "CPL:3 < RPL:1 == DPL:1"
	help
	  CPL:3 < RPL:1 == DPL:1

config DEBUG_PL_CD_C4_P5
	bool "CPL:3 < RPL:2 == DPL:2"
	help
	  CPL:3 < RPL:2 == DPL:2

endif # DEBUG_PL_CD_C4

config DEBUG_PL_CD_C5
	bool "CPL < RPL && RPL > DPL (RPL > DPL > CPL)"
	help
	  CPL < RPL && RPL > DPL

if DEBUG_PL_CD_C5

config DEBUG_PL_CD_C5_P0
	bool "CPL:2 < RPL:0 && RPL:0 > DPL:1"
	help
	  CPL:2 < DPL:1 < RPL:0

config DEBUG_PL_CD_C5_P1
	bool "CPL:3 < RPL:0 && RPL:0 > DPL:1"
	help
	  CPL:3 < DPL:1 < RPL:0

config DEBUG_PL_CD_C5_P2
	bool "CPL:3 < RPL:0 && RPL:0 > DPL:2"
	help
	  CPL:3 < DPL:2 < RPL:0

config DEBUG_PL_CD_C5_P3
	bool "CPL:3 < RPL:1 && RPL:1 > DPL:2"
	help
	  CPL:3 < DPL:2 < RPL:1

endif # DEBUG_PL_CD_C5

config DEBUG_PL_CD_C6
	bool "CPL > RPL && RPL < DPL (CPL > DPL > RPL)"
	help
	  CPL > DPL > RPL

if DEBUG_PL_CD_C6

config DEBUG_PL_CD_C6_P0
	bool "CPL:0 > RPL:2 && RPL:2 < DPL:1"
	help
	  CPL:0 > DPL:1 > RPL:2

config DEBUG_PL_CD_C6_P1
	bool "CPL:0 > RPL:3 && RPL:3 < DPL:1"
	help
	  CPL:0 > DPL:1 > RPL:3

config DEBUG_PL_CD_C6_P2
	bool "CPL:1 > RPL:3 && RPL:3 < DPL:2"
	help
	  CPL:1 > DPL:2 > RPL:3

endif # DEBUG_PL_CD_C6

config DEBUG_PL_CD_C7
	bool "CPL > RPL > DPL"
	help
	  CPL > RPL > DPL

if DEBUG_PL_CD_C7

config DEBUG_PL_CD_C7_P0
	bool "CPL:0 > RPL:1 > DPL:2"
	help
	  CPL:0 > RPL:1 > DPL:2

config DEBUG_PL_CD_C7_P1
	bool "CPL:0 > RPL:1 > DPL:3"
	help
	  CPL:0 > RPL:1 > DPL:3

config DEBUG_PL_CD_C7_P2
	bool "CPL:0 > RPL:2 > DPL:3"
	help
	  CPL:0 > RPL:2 > DPL:3

config DEBUG_PL_CD_C7_P3
	bool "CPL:1 > RPL:2 > DPL:3"
	help
	  CPL:1 > RPL:2 > DPL:3

endif # DEBUG_PL_CD_C7

endif # DEBUG_PL_CS_DATA

config DEBUG_PL_STACK
	bool "Privilege Checking when loading the SS register"
	select DEBUG_PL_STACK_ESTABLISH
	help
	  Privilege checking when accessing data segment.

if DEBUG_PL_STACK

config DEBUG_PL_STACK_ESTABLISH
	bool "Establish specify Stack Segment Seletor and Descriptor"
	help
	  Establish specify Stack Segment Selector and Descriptor.

config DEBUG_PL_STACK_C0
	bool "CPL == RPL == DPL"
	help
	  CPL == RPL == DPL

if DEBUG_PL_STACK_C0

config DEBUG_PL_STACK_C0_P0
	bool "CPL:0 == RPL:0 == DPL:0"
	help
	  CPL:0 == RPL:0 == DPL:0

config DEBUG_PL_STACK_C0_P1
	bool "CPL:1 == RPL:1 == DPL:1"
	help
	  CPL:1 == RPL:1 == DPL:1

config DEBUG_PL_STACK_C0_P2
	bool "CPL:2 == RPL:2 == DPL:2"
	help
	  CPL:2 == RPL:2 == DPL:2

config DEBUG_PL_STACK_C0_P3
	bool "CPL:3 == RPL:3 == DPL:3"
	help
	  CPL:3 == RPL:3 == DPL:3

endif # DEBUG_PL_STACK_C0

config DEBUG_PL_STACK_C1
	bool "CPL == RPL > DPL"
	help
	  CPL == RPL > DPL

if DEBUG_PL_STACK_C1

config DEBUG_PL_STACK_C1_P0
	bool "CPL:0 == RPL:0 > DPL:1"
	help
	  CPL == RPL == 0; DPL == 1

config DEBUG_PL_STACK_C1_P1
	bool "CPL:0 == PRL:0 > DPL:2"
	help
	  CPL == RPL == 0; DPL == 2

config DEBUG_PL_STACK_C1_P2
	bool "CPL:0 == RPL:0 > DPL:3"
	help
	  CPL == RPL == 0; DPL == 3

config DEBUG_PL_STACK_C1_P3
	bool "CPL:1 == RPL:1 > DPL:2"
	help
	  CPL == RPL == 1; DPL == 2

config DEBUG_PL_STACK_C1_P4
	bool "CPL:1 == RPL:1 > DPL:3"
	help
	  CPL == RPL == 1; DPL == 3

config DEBUG_PL_STACK_C1_P5
	bool "CPL:2 == RPL:2 > DPL:3"
	help
	  CPL == RPL == 2; DPL == 3

endif # DEBUG_PL_STACK_C1

config DEBUG_PL_STACK_C2
	bool "CPL > RPL == DPL"
	help
	  CPL > RPL == DPL

if DEBUG_PL_STACK_C2

config DEBUG_PL_STACK_C2_P0
	bool "CPL:0 > RPL:1 == DPL:1"
	help
	  CPL:0 > RPL:1 == DPL:1

config DEBUG_PL_STACK_C2_P1
	bool "CPL:0 > RPL:2 == DPL:2"
	help
	  CPL:0 > RPL:2 == DPL:2

config DEBUG_PL_STACK_C2_P2
	bool "CPL:0 > RPL:3 == DPL:3"
	help
	  CPL:0 > RPL:3 == DPL:3

config DEBUG_PL_STACK_C2_P3
	bool "CPL:1 > RPL:2 == DPL:2"
	help
	  CPL:1 > RPL:2 == DPL:2

config DEBUG_PL_STACK_C2_P4
	bool "CPL:1 > RPL:3 == DPL:3"
	help
	  CPL:1 > RPL:3 == DPL:3

config DEBUG_PL_STACK_C2_P5
	bool "CPL:2 > RPL:3 == DPL:3"
	help
	  CPL:2 > RPL:3 == DPL:3

endif # DEBUG_PL_STACK_C2

config DEBUG_PL_STACK_C3
	bool "CPL == RPL < DPL"
	help
	  CPL == RPL < DPL

if DEBUG_PL_STACK_C3

config DEBUG_PL_STACK_C3_P0
	bool "CPL:1 == RPL:1 < DPL:0"
	help
	  CPL:1 == RPL:1 < DPL:0

config DEBUG_PL_STACK_C3_P1
	bool "CPL:2 == RPL:2 < DPL:0"
	help
	  CPL:2 == RPL:2 < DPL:0

config DEBUG_PL_STACK_C3_P2
	bool "CPL:3 == RPL:3 < DPL:0"
	help
	  CPL:3 == RPL:3 < DPL:0

config DEBUG_PL_STACK_C3_P3
	bool "CPL:2 == RPL:2 < DPL:1"
	help
	  CPL:2 == RPL:2 < DPL:1

config DEBUG_PL_STACK_C3_P4
	bool "CPL:3 == RPL:3 < DPL:1"
	help
	  CPL:3 == RPL:3 < DPL:1

config DEBUG_PL_STACK_C3_P5
	bool "CPL:3 == RPL:3 < DPL:2"
	help
	  CPL:3 == RPL:3 < DPL:2

endif # DEBUG_PL_STACK_C3

config DEBUG_PL_STACK_C4
	bool "CPL < RPL == DPL"
	help
	  CPL < RPL == DPL

if DEBUG_PL_STACK_C4

config DEBUG_PL_STACK_C4_P0
	bool "CPL:1 < RPL:0 == DPL:0"
	help
	  CPL:1 < RPL:0 == DPL:0

config DEBUG_PL_STACK_C4_P1
	bool "CPL:2 < RPL:0 == DPL:0"
	help
	  CPL:2 < RPL:0 == DPL:0

config DEBUG_PL_STACK_C4_P2
	bool "CPL:3 < RPL:0 == DPL:0"
	help
	  CPL:3 < RPL:0 == DPL:0

config DEBUG_PL_STACK_C4_P3
	bool "CPL:2 < RPL:1 == DPL:1"
	help
	  CPL:2 < RPL:1 == DPL:1

config DEBUG_PL_STACK_C4_P4
	bool "CPL:3 < RPL:1 == DPL:1"
	help
	  CPL:3 < RPL:1 == DPL:1

config DEBUG_PL_STACK_C4_P5
	bool "CPL:3 < RPL:2 == DPL:2"
	help
	  CPL:3 < RPL:2 == DPL:2

endif # DEBUG_PL_STACK_C4

config DEBUG_PL_STACK_C5
	bool "CPL < RPL && RPL > DPL (RPL > DPL > CPL)"
	help
	  CPL < RPL && RPL > DPL

if DEBUG_PL_STACK_C5

config DEBUG_PL_STACK_C5_P0
	bool "CPL:2 < RPL:0 && RPL:0 > DPL:1"
	help
	  CPL:2 < DPL:1 < RPL:0

config DEBUG_PL_STACK_C5_P1
	bool "CPL:3 < RPL:0 && RPL:0 > DPL:1"
	help
	  CPL:3 < DPL:1 < RPL:0

config DEBUG_PL_STACK_C5_P2
	bool "CPL:3 < RPL:0 && RPL:0 > DPL:2"
	help
	  CPL:3 < DPL:2 < RPL:0

config DEBUG_PL_STACK_C5_P3
	bool "CPL:3 < RPL:1 && RPL:1 > DPL:2"
	help
	  CPL:3 < DPL:2 < RPL:1

endif # DEBUG_PL_STACK_C5

config DEBUG_PL_STACK_C6
	bool "CPL > RPL && RPL < DPL (CPL > DPL > RPL)"
	help
	  CPL > DPL > RPL

if DEBUG_PL_STACK_C6

config DEBUG_PL_STACK_C6_P0
	bool "CPL:0 > RPL:2 && RPL:2 < DPL:1"
	help
	  CPL:0 > DPL:1 > RPL:2

config DEBUG_PL_STACK_C6_P1
	bool "CPL:0 > RPL:3 && RPL:3 < DPL:1"
	help
	  CPL:0 > DPL:1 > RPL:3

config DEBUG_PL_STACK_C6_P2
	bool "CPL:1 > RPL:3 && RPL:3 < DPL:2"
	help
	  CPL:1 > DPL:2 > RPL:3

endif # DEBUG_PL_STACK_C6

config DEBUG_PL_STACK_C7
	bool "CPL > RPL > DPL"
	help
	  CPL > RPL > DPL

if DEBUG_PL_STACK_C7

config DEBUG_PL_STACK_C7_P0
	bool "CPL:0 > RPL:1 > DPL:2"
	help
	  CPL:0 > RPL:1 > DPL:2

config DEBUG_PL_STACK_C7_P1
	bool "CPL:0 > RPL:1 > DPL:3"
	help
	  CPL:0 > RPL:1 > DPL:3

config DEBUG_PL_STACK_C7_P2
	bool "CPL:0 > RPL:2 > DPL:3"
	help
	  CPL:0 > RPL:2 > DPL:3

config DEBUG_PL_STACK_C7_P3
	bool "CPL:1 > RPL:2 > DPL:3"
	help
	  CPL:1 > RPL:2 > DPL:3

endif # DEBUG_PL_STACK_C7

endif # DEBUG_PL_STACK

config DEBUG_PL_CODE
	bool "Privilege Checking when transferring program control between code segment without Gate"
	select DEBUG_PL_CODE_ESTABLISH
	help
	  Privilege checking when transferring program control between code segment without Gate.

if DEBUG_PL_CODE

config DEBUG_PL_CODE_ESTABLISH
	bool "Establish specify Code Segment Selector and Descriptor"
	help
	  Establish a specify segment selector and segment descriptor.

choice
	prompt "Select Code Segment Type"

config DEBUG_PL_CODE_CFM
	bool "Conforming, readable Code Segment"
	help
	  Conforming and readable Code Segment.

config DEBUG_PL_CODE_UCFM
	bool "UnConforming, readable Code Segment"
	help
	  UnConforming and readable Code Segment.

endchoice

config DEBUG_PL_CODE_C0
	bool "CPL == RPL == DPL"
	help
	  CPL == RPL == DPL

if DEBUG_PL_CODE_C0

config DEBUG_PL_CODE_C0_P0
	bool "CPL:0 == RPL:0 == DPL:0"
	help
	  CPL:0 == RPL:0 == DPL:0

config DEBUG_PL_CODE_C0_P1
	bool "CPL:1 == RPL:1 == DPL:1"
	help
	  CPL:1 == RPL:1 == DPL:1

config DEBUG_PL_CODE_C0_P2
	bool "CPL:2 == RPL:2 == DPL:2"
	help
	  CPL:2 == RPL:2 == DPL:2

config DEBUG_PL_CODE_C0_P3
	bool "CPL:3 == RPL:3 == DPL:3"
	help
	  CPL:3 == RPL:3 == DPL:3

endif # DEBUG_PL_CODE_C0

config DEBUG_PL_CODE_C1
	bool "CPL == RPL > DPL"
	help
	  CPL == RPL > DPL

if DEBUG_PL_CODE_C1

config DEBUG_PL_CODE_C1_P0
	bool "CPL:0 == RPL:0 > DPL:1"
	help
	  CPL == RPL == 0; DPL == 1

config DEBUG_PL_CODE_C1_P1
	bool "CPL:0 == PRL:0 > DPL:2"
	help
	  CPL == RPL == 0; DPL == 2

config DEBUG_PL_CODE_C1_P2
	bool "CPL:0 == RPL:0 > DPL:3"
	help
	  CPL == RPL == 0; DPL == 3

config DEBUG_PL_CODE_C1_P3
	bool "CPL:1 == RPL:1 > DPL:2"
	help
	  CPL == RPL == 1; DPL == 2

config DEBUG_PL_CODE_C1_P4
	bool "CPL:1 == RPL:1 > DPL:3"
	help
	  CPL == RPL == 1; DPL == 3

config DEBUG_PL_CODE_C1_P5
	bool "CPL:2 == RPL:2 > DPL:3"
	help
	  CPL == RPL == 2; DPL == 3

endif # DEBUG_PL_CODE_C1

config DEBUG_PL_CODE_C2
	bool "CPL > RPL == DPL"
	help
	  CPL > RPL == DPL

if DEBUG_PL_CODE_C2

config DEBUG_PL_CODE_C2_P0
	bool "CPL:0 > RPL:1 == DPL:1"
	help
	  CPL:0 > RPL:1 == DPL:1

config DEBUG_PL_CODE_C2_P1
	bool "CPL:0 > RPL:2 == DPL:2"
	help
	  CPL:0 > RPL:2 == DPL:2

config DEBUG_PL_CODE_C2_P2
	bool "CPL:0 > RPL:3 == DPL:3"
	help
	  CPL:0 > RPL:3 == DPL:3

config DEBUG_PL_CODE_C2_P3
	bool "CPL:1 > RPL:2 == DPL:2"
	help
	  CPL:1 > RPL:2 == DPL:2

config DEBUG_PL_CODE_C2_P4
	bool "CPL:1 > RPL:3 == DPL:3"
	help
	  CPL:1 > RPL:3 == DPL:3

config DEBUG_PL_CODE_C2_P5
	bool "CPL:2 > RPL:3 == DPL:3"
	help
	  CPL:2 > RPL:3 == DPL:3

endif # DEBUG_PL_CODE_C2

config DEBUG_PL_CODE_C3
	bool "CPL == RPL < DPL"
	help
	  CPL == RPL < DPL

if DEBUG_PL_CODE_C3

config DEBUG_PL_CODE_C3_P0
	bool "CPL:1 == RPL:1 < DPL:0"
	help
	  CPL:1 == RPL:1 < DPL:0

config DEBUG_PL_CODE_C3_P1
	bool "CPL:2 == RPL:2 < DPL:0"
	help
	  CPL:2 == RPL:2 < DPL:0

config DEBUG_PL_CODE_C3_P2
	bool "CPL:3 == RPL:3 < DPL:0"
	help
	  CPL:3 == RPL:3 < DPL:0

config DEBUG_PL_CODE_C3_P3
	bool "CPL:2 == RPL:2 < DPL:1"
	help
	  CPL:2 == RPL:2 < DPL:1

config DEBUG_PL_CODE_C3_P4
	bool "CPL:3 == RPL:3 < DPL:1"
	help
	  CPL:3 == RPL:3 < DPL:1

config DEBUG_PL_CODE_C3_P5
	bool "CPL:3 == RPL:3 < DPL:2"
	help
	  CPL:3 == RPL:3 < DPL:2

endif # DEBUG_PL_CODE_C3

config DEBUG_PL_CODE_C4
	bool "CPL < RPL == DPL"
	help
	  CPL < RPL == DPL

if DEBUG_PL_CODE_C4

config DEBUG_PL_CODE_C4_P0
	bool "CPL:1 < RPL:0 == DPL:0"
	help
	  CPL:1 < RPL:0 == DPL:0

config DEBUG_PL_CODE_C4_P1
	bool "CPL:2 < RPL:0 == DPL:0"
	help
	  CPL:2 < RPL:0 == DPL:0

config DEBUG_PL_CODE_C4_P2
	bool "CPL:3 < RPL:0 == DPL:0"
	help
	  CPL:3 < RPL:0 == DPL:0

config DEBUG_PL_CODE_C4_P3
	bool "CPL:2 < RPL:1 == DPL:1"
	help
	  CPL:2 < RPL:1 == DPL:1

config DEBUG_PL_CODE_C4_P4
	bool "CPL:3 < RPL:1 == DPL:1"
	help
	  CPL:3 < RPL:1 == DPL:1

config DEBUG_PL_CODE_C4_P5
	bool "CPL:3 < RPL:2 == DPL:2"
	help
	  CPL:3 < RPL:2 == DPL:2

endif # DEBUG_PL_CODE_C4

config DEBUG_PL_CODE_C5
	bool "CPL < RPL && RPL > DPL (RPL > DPL > CPL)"
	help
	  CPL < RPL && RPL > DPL

if DEBUG_PL_CODE_C5

config DEBUG_PL_CODE_C5_P0
	bool "CPL:2 < RPL:0 && RPL:0 > DPL:1"
	help
	  CPL:2 < DPL:1 < RPL:0

config DEBUG_PL_CODE_C5_P1
	bool "CPL:3 < RPL:0 && RPL:0 > DPL:1"
	help
	  CPL:3 < DPL:1 < RPL:0

config DEBUG_PL_CODE_C5_P2
	bool "CPL:3 < RPL:0 && RPL:0 > DPL:2"
	help
	  CPL:3 < DPL:2 < RPL:0

config DEBUG_PL_CODE_C5_P3
	bool "CPL:3 < RPL:1 && RPL:1 > DPL:2"
	help
	  CPL:3 < DPL:2 < RPL:1

endif # DEBUG_PL_CODE_C5

config DEBUG_PL_CODE_C6
	bool "CPL > RPL && RPL < DPL (CPL > DPL > RPL)"
	help
	  CPL > DPL > RPL

if DEBUG_PL_CODE_C6

config DEBUG_PL_CODE_C6_P0
	bool "CPL:0 > RPL:2 && RPL:2 < DPL:1"
	help
	  CPL:0 > DPL:1 > RPL:2

config DEBUG_PL_CODE_C6_P1
	bool "CPL:0 > RPL:3 && RPL:3 < DPL:1"
	help
	  CPL:0 > DPL:1 > RPL:3

config DEBUG_PL_CODE_C6_P2
	bool "CPL:1 > RPL:3 && RPL:3 < DPL:2"
	help
	  CPL:1 > DPL:2 > RPL:3

endif # DEBUG_PL_CODE_C6

config DEBUG_PL_CODE_C7
	bool "CPL > RPL > DPL"
	help
	  CPL > RPL > DPL

if DEBUG_PL_CODE_C7

config DEBUG_PL_CODE_C7_P0
	bool "CPL:0 > RPL:1 > DPL:2"
	help
	  CPL:0 > RPL:1 > DPL:2

config DEBUG_PL_CODE_C7_P1
	bool "CPL:0 > RPL:1 > DPL:3"
	help
	  CPL:0 > RPL:1 > DPL:3

config DEBUG_PL_CODE_C7_P2
	bool "CPL:0 > RPL:2 > DPL:3"
	help
	  CPL:0 > RPL:2 > DPL:3

config DEBUG_PL_CODE_C7_P3
	bool "CPL:1 > RPL:2 > DPL:3"
	help
	  CPL:1 > RPL:2 > DPL:3

endif # DEBUG_PL_CODE_C7

endif # DEBUG_PL_CODE

endif # DEBUG_PL_CHECK

endmenu
```
