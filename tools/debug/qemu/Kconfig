## tools/demo/mmu/addressing/paging/right/Kconfig
```kconfig
menu "Paging Access Right Control"

config DEBUG_MMU_PAGING_RIGHT
	bool "Paging access right control"
	help
	  Paging access right control

if DEBUG_MMU_PAGING_RIGHT

comment "Supervisor-/User-mode"

choice

	prompt "Choice access mode"

config DEBUG_MMU_RT_SUP
	bool "supervisor-mode access"
	help
	  For supevisor-mode access.

config DEBUG_MMU_RT_USER
	bool "user-mode access"
	help
	  For user-mode access.

endchoice

config DEBUG_MMU_RT_ESTABLISH
	bool "Establish specify supervisor-/user- mode paging structure"
	help
	  Establish specify supervisor-mode/user-mode paging structure.

if DEBUG_MMU_RT_ESTABLISH

choice
	prompt "Choice address mode"

config DEBUG_RT_EST_SUP
	bool "establish supervisor-mode address"
	help
	  Establish supervisor-mode address.

config DEBUG_RT_EST_USER
	bool "establish user-mode address"
	help
	  Establish user-mode address.

endchoice

config DEBUG_RT_EST_VA
	hex "establish virtual address"
	default 0x06400000
	help
	  Establish virtual address.

config DEBUG_RT_EST_VL
	hex "establish default value on virtual address"
	default 0x66886688
	help
	  The value of virtual address.

endif # DEBUG_MMU_RT_ESTABLISH

if DEBUG_MMU_RT_SUP

config DEBUG_RT_SUP_SUPDATA
	bool "Read data from supervisor-mode address"
	help
	  Data read from supervisor-mode address.

config DEBUG_RT_SUP_USERDATA
	bool "Read data from user-mode address"
	help
	  Data read from user-mode address.

if DEBUG_RT_SUP_USERDATA

choice
	prompt "Choice CR4.SMAP"

config DEBUG_RT_SUP_RU_SMAP0
	bool "CR4.SMAP == 0 (read any user-mode address)"
	help
	  Read any user-mode address.

config DEBUG_RT_SUP_RU_SMAP1
	bool "CR4.SMAP == 1 (read depend on EFLAGS.AC)"
	help
	  Read depend on EFLAGS.AC.

endchoice # CR4.SMAP

if DEBUG_RT_SUP_RU_SMAP1

choice
	prompt "Choice EFLAGS.AC"

config DEBUG_RT_SUP_RU_EFLAGSAC0
	bool "EFLAGS.AC == 0 Doesn't read user-mode address"
	help
	  Read any user-mode with protect key.

config DEBUG_RT_SUP_RU_EFLAGSAC1
	bool "EFLAGS.AC == 1 Read any user-mode with protect key"

endchoice # EFLAGS.AC

endif # DEBUG_RT_SUP_RU_SMAP1

endif # DEBUG_RT_SUP_USERDATA

config DEBUG_RT_WR_SUP
	bool "Write Data into supervisor-mode address"
	help
	  Write data into supervisor-mode address.

if DEBUG_RT_WR_SUP

choice 

	prompt "Choice CR0.WP"

config DEBUG_RT_WR_SUP_WP0
	bool "CR0.WP == 0 (write to any supervisor-mode address)"
	help
	  Write data into any supervisor-mode address.

config DEBUG_RT_WR_SUP_WP1
	bool "CR0.WP == 1 (write depend on W/R on paging-structure)"
	help
	  Write data into supervisor-mode address depend W/R flag
	  on paging-structure.

endchoice

if DEBUG_RT_WR_SUP_WP1

choice 

	prompt "Choice W/R on Page-Directory"

config DEBUG_RT_WR_SUP_PGD_WR
	bool "Set R/W flag on Page-Directory"
	help
	  Write and Read on Page-Table.

config DEBUG_RT_WR_SUP_PGD_NW
	bool "Clear R/W flag on Page-Directory"
	help
	  No write and read on Page-Table.

endchoice  # WR on PGD

choice 

	prompt "Choice W/R on Page-Table"

config DEBUG_RT_WR_SUP_PTE_WR
	bool "Set R/W flag on Page-Table"
	help
	  Write and Read on Page.

config DEBUG_RT_WR_SUP_PTE_NW
	bool "Clear R/W flag on Page-Table"
	help
	  No write and read on Page.

endchoice # WR on PGT

endif # DEBUG_RT_WR_SUP_WP1

endif # DEBUG_RT_WR_SUP

config DEBUG_RT_WR_USER
	bool "Write Data into user-mode address"
	help
	  Write data into user-mode address.

if DEBUG_RT_WR_USER

choice 
	prompt "Choice CR0.WP control bit"

config DEBUG_RT_WR_USER_CR0WP0
	bool "CR0.WP == 0"
	help
	  CR0.WP == 0

config DEBUG_RT_WR_USER_CR0WP1
	bool "CR0.WP == 1"
	help
	  CR0.WP == 1

endchoice # CR0.WR 

choice
	prompt "Choice CR4.SMAP control bit"

config DEBUG_RT_WR_USER_CR4SMAP0
	bool "CR4.SMAP == 0"
	help
	  CR4.SMAP == 0

config DEBUG_RT_WR_USER_CR4SMAP1
	bool "CR4.SMAP == 1"
	help
	  CR4.SMAP == 1

endchoice # CR4.SMAP

if DEBUG_RT_WR_USER_CR0WP1

choice 

	prompt "Choice Page-Direct R/W flag"

config DEBUG_RT_WR_USER_PGD_RDONLY
	bool "R/W == 0"
	help
	  R/W == 0

config DEBUG_RT_WR_USER_PGD_RW
	bool "R/W == 1"
	help
	  R/W == 1

endchoice # PGD-R/W

choice 

	prompt "Choice Page-Table R/W flag"

config DEBUG_RT_WR_USER_PGT_RDONLY
	bool "R/W == 0"
	help
	  R/W == 0

config DEBUG_RT_WR_USER_PGT_WR
	bool "R/W == 1"
	help
	  R/W == 1

endchoice # PGT-R/W

endif # DEBUG_RT_WR_USER_CR0WP1

if DEBUG_RT_WR_USER_CR4SMAP1

choice 

	prompt "Choice EFLAGS.AC flag"

config DEBUG_RT_WR_USER_EFLAGSAC0
	bool "EFLAGS.AC == 0"
	help
	  EFLAG.AC == 0

config DEBUG_RT_WR_USER_EFLAGSAC1
	bool "EFLAGS.AC == 1"
	help
	  EFLAGS.AC == 1

endchoice # EFLAGS.AC

endif # DEBUG_RT_WR_USER_CR4SMAP1

endif # DEBUG_RT_WR_USER

endif # DEBUG_MMU_RT_SUP

if DEBUG_MMU_RT_USER

endif # DEBUG_MMU_RT_USER

endif # DEBUG_MMU_PAGING_RIGHT

endmenu
```

## tools/demo/mmu/addressing/segment/Kconfig
```kconfig
menu "Segmentation mechanism: segment/selector/descriptor"

config DEBUG_MMU_SEGMENT
	bool "Segmentation mechanism on IA32"
	help
	  Debug segmentation mechanism on IA32. 


if DEBUG_MMU_SEGMENT

config DEBUG_SEG_SEL
	bool "Segment Selector: Register and Instructions"
	help
	  Segment Selector.

if DEBUG_SEG_SEL

config DEBUG_SEG_CS
	bool "Code segment selector"
	help
	  Code segment selector.

config DEBUG_SEG_DS
	bool "Data segment selector"
	help
	  Data segment selector.

config DEBUG_SEG_SS
	bool "Stack segment selector"
	help
	  Stack segment selector.

config DEBUG_SEG_FS
	bool "User data segment selector"
	help
	  User data segment selector.
	  
config DEBUG_SEG_INS_MOV
	bool "MOV instruction to loading Sel (visible)"
	help
	  MOV instruction to loading Segment selector (visible).

config DEBUG_SEG_INS_POP
	bool "POP instruction to loading Sel (visible)"
	help
	  POP instruction to loading Segment selector (visible).

config DEBUG_SEG_INS_LDS
	bool "LDS: loading a far pointer into DS segment selector"
	help
	  Loading a far pointer into DS segment selector.

config DEBUG_SEG_INS_LES
	bool "LES: loading a far pointer into ES segment selector"
	help
	  Loading a far pointer into ES segment selector.

config DEBUG_SEG_INS_LFS
	bool "LFS: loading a far pointer into FS segment selector"
	help
	  Loading a far pointer into FS segment selector.

config DEBUG_SEG_INS_LGS
	bool "LGS: loading a far pointer into GS segment selector"
	help
	  Loading a far pointer into GS segment selector.

config DEBUG_SEG_INS_LSS
	bool "LSS: loading a far pointer into SS segment selector"
	help
	  Loading a far pointer into SS segment selector.

config DEBUG_SEG_INS_LSL
	bool "LSL: loading segment limit for specify segment."
	help
	  Loading segment limit for specify segment.

config DEBUG_SEG_INS_LAR
	bool "LAR: loading segment access right byte"
	help
	  Loading segment access right byte.

endif # DEBUG_SEG_SEL

config DEBUG_MMU_GDTR
        bool "GDTR: Global Descriptor Table Register and Instruction"
        help
          Debug Global descriptor table register.

if DEBUG_MMU_GDTR

config DEBUG_GDTR_SGDT
	bool "SGDT: Store Global Descriptor Table register"
	help
	  Store Global descriptor table register.

config DEBUG_GDTR_LGDT
	bool "LGDT: Load Global Descriptor Table register"
	help
	  Load Global descriptor table register.

endif # DEBUG_MMU_GDTR

config DEBUG_MMU_LDTR
	bool "LDTR: Local Descriptor Table Register and Instructions"
	help
	  Debug Local descriptor table register.

if DEBUG_MMU_LDTR

config DEBUG_LDTR_SLDT
	bool "SLDT: Store Local Descriptor table register"
	help
	  Store Global descriptor table register.

config DEBUG_LDTR_LLDT
	bool "LLDT: Load Local Descriptor table register"
	select DEBUG_LDTR_SLDT
	help
	  Load Local descriptor table register.

endif # DEBUG_MMU_LDTR

config DEBUG_MMU_IDTR
	bool "IDTR: Interrupt Descriptor Table Register"
	help
	  Interrupt Descriptor Table register.

if DEBUG_MMU_IDTR

config DEBUG_IDTR_SIDT
	bool "SIDT: Store Interrupt Descriptor Table Register"
	help
	  Store Interrupt Descriptor Table.

config DEBUG_IDTR_LIDT
	bool "LIDT: Load Interrupt Descriptor Table Register"
	select DEBUG_IDTR_SIDT
	help
	  Load Interrupt Descriptor Table.

endif # DEBUG_MMU_IDTR

config DEBUG_MMU_TR
	bool "TR:   Task Register"
	help
	  Task Register.

if DEBUG_MMU_TR

config DEBUG_TR_STR
	bool "STR: Store Task Register"
	help
	  Store Task Register.

config DEBUG_TR_LTR
	bool "LTR: Load Task Register"
	select DEBUG_TR_STR
	help
	  Load Task Register.

endif # DEBUG_MMU_TR

config DEBUG_MMU_SEG_DESC
	bool "Segment Descriptor"
	help
	  Segment Descriptor

if DEBUG_MMU_SEG_DESC

choice
	prompt "Select specify segment selector"

config SEG_DESC_KERNEL_CS
	bool "CS: Kernel code segment selector"

config SEG_DESC_KERNEL_DS
	bool "DS: Kernel data segment selector"

config SEG_DESC_KERNEL_SS
	bool "SS: Kernel stack segment selector"

config SEG_DESC_USER_CS
	bool "CS: User code segment selector"

config SEG_DESC_USER_FS
	bool "FS: User data segment selector"

config SEG_DESC_USER_SS
	bool "SS: User stack segment selector"

config SEG_DESC_LDT
	bool "LDT: Local descriptor Table segment selector"

config SEG_DESC_TSS
	bool "TSS: Task Status segment selector"

endchoice

config DEBUG_SEG_DESC_COMMON
	bool "Common procedure to obtain a segment descriptor"
	help
	  Common procedure to obtain a segment descriptor.

comment "flags and field in segment descriptor"

config DEBUG_SEG_DESC_LIMIT
	bool "Segment limit field"
	select DEBUG_SEG_DESC_COMMON
	help
	  The limit field of segment.

config DEBUG_SEG_DESC_BASE
	bool "Base address field"
	select DEBUG_SEG_DESC_COMMON
	help
	  The base address field of segment.

config DEBUG_SEG_DESC_TYPE
	bool "Type field"
	select DEBUG_SEG_DESC_COMMON
	select DEBUG_SEG_DESC_S
	help
	  The type field of segment descriptor.

config DEBUG_SEG_DESC_S
	bool "S (Descriptor type) flag (bit 44)"
	select DEBUG_SEG_DESC_COMMON
	help
	  The descriptor type flag of segment.

config DEBUG_SEG_DESC_DPL
	bool "DPL (Descriptor Privilege Level) field"
	select DEBUG_SEG_DESC_COMMON
	help
	  Descriptor privilege level field.

config DEBUG_SEG_DESC_P
	bool "P (Descriptor-Present) flag (bit 47)"
	select DEBUG_SEG_DESC_COMMON
	help
	  Descriptor privilege level field.

config DEBUG_SEG_DESC_DB
	bool "D/B flag (bit 54)"
	select DEBUG_SEG_DESC_COMMON
	help
	  Default operation size.

config DEBUG_SEG_DESC_G
	bool "G (granularity) flag (bit 55)"
	select DEBUG_SEG_DESC_COMMON
	help
	  Granularity for segment limit.

config DEBUG_SEG_DESC_L
	bool "L (64-bit code segment) flag (bit 53)"
	select DEBUG_SEG_DESC_COMMON
	help
	  64-bit code segment.

endif # DEBUG_MMU_SEG_DESC

endif # DEBUG_MMU_SEGMENT

endmenu
```

## tools/demo/mmu/addressing/segment/gate/Kconfig
```kconfig
menu "Gate Descriptor"

config DEBUG_SEG_GATE
	bool "Gates mechanism"
	help
	  Gates mechanism.

if DEBUG_SEG_GATE

choice
	prompt "Gate Types"

config DEBUG_SEG_GATE_CALL
	select DEBUG_CALL_GATE_ESTABLISH
	bool "Call Gates"
	help
	  Call Gate.

config DEBUG_SEG_GATE_TRAP
	bool "Trap Gates"
	help
	  Trap Gates.

config DEBUG_SEG_GATE_INTERRUPT
	bool "Interrupt Gates"
	help
	  Interrupt Gates.

config DEBUG_SEG_GATE_TASK
	bool "Task Gates"
	help
	  Task Gates.

endchoice

if DEBUG_SEG_GATE_CALL

config DEBUG_CALL_GATE_ESTABLISH
	bool "Establish Call Gates segment selectors and descriptors"
	help
	  Establish Call Gates segment selectors and segment descriptors on GDT.

config DEBUG_CALL_GATE_NCF
	bool "Access Conforming code segment through call gate"
	help
	  Access Conforming code segment through call gate.

config DEBUG_CALL_GATE_SWTICH_STACK
	bool "Stack switch through Call Gate"
	help
	  Swtich Stack through CALL Gates.

endif # DEBUG_SEG_GATE_CALL

endif # DEBUG_SEG_GATE

endmenu
```
