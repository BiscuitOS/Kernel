## tools/demo/mmu/addressing/segment/tss/Kconfig
```kconfig
menu "TSS: Task status Segment"

config DEBUG_SEG_TSS
	bool "TSS: Task Status Segment"
	help
	  TSS: Task Status Segment.

if DEBUG_SEG_TSS

config DEBUG_SEG_TSS_DESC
	bool "TSS Segment Descriptor"
	help
	  TSS Segment Descriptor.

if DEBUG_SEG_TSS_DESC

comment "flags and field in TSS Descriptor"

config DEBUG_TSS_DESC_BASE
	bool "Base addres field"
	help
	  The base address field of TSS.

config DEBUG_TSS_DESC_LIMIT
	bool "TSS limit field"
	help
	  The limit field of TSS.

config DEBUG_TSS_DESC_B
	bool "B: Busy flag"
	help
	  The busy flag of TSS.

config DEBUG_TSS_DESC_DPL
	bool "DPL: Descriptor Privilege levels"
	help
	  The DPL of TSS.

config DEBUG_TSS_DESC_P
	bool "P: Present flag"
	help
	  The Present flag.

config DEBUG_TSS_DESC_G
	bool "G: Granularity flag"
	help
	  Granularity flag.

config DEBUG_TSS_DESC_AVL
	bool "AVL: Available for use by system software"
	help
	  Available for use by system software.

endif # DEBUG_SEG_TSS_DESC

config DEBUG_SEG_TSS_TR
	bool "Task Register (Register and Instructions)"
	help
	  Task Register.

if DEBUG_SEG_TSS_TR

config DEBUG_TSS_TR_STR
	bool "STR: Store Task Register"
	help
	  Store Task Register.

config DEBUG_TSS_TR_LTR
	bool "LTR: Load Task Register"
	select DEBUG_TSS_TR_STR
	help
	  Load Task Register.

endif # DEBUG_SEG_TSS_TR

config DEBUG_SEG_TSS_CONTEXT
	bool "TSS context of current task"
	help
	  TSS context of current task.

config DEBUG_SEG_TASK_GATE
	bool "Task Gates"
	select DEBUG_TASK_GATE_ESTABLISH
	help
	  TSS Gates.

if DEBUG_SEG_TASK_GATE

config DEBUG_TASK_GATE_ESTABLISH
	bool "Establish Specify Task Gates"
	help
	  Establish Specify Task Gates

config DEBUG_TASK_GATE_U2K
	bool "User access kernel through Task Gate"
	help
	  User access kernel through Task Gate.

endif # DEBUG_SEG_TASK_GATE

config DEBUG_SEG_TSS_SWITCH
	bool "Task Switch when loading new TSS"
	help
	  Task Switch when loading new TSS.

if DEBUG_SEG_TSS_SWITCH


endif # DEBUG_SEG_TSS_SWITCH

endif # DEBUG_SEG_TSS

endmenu
```

## tools/demo/mmu/addressing/virtual_address/Kconfig
```kconfig
menu "Virtual address"

config DEBUG_MMU_VA
	bool "Virtual address and Virtual space"
	help
	  Virtual address and Virtual space.

if DEBUG_MMU_VA

choice

	prompt "Choice Kernel/User Virtual Address Space"

config DEBUG_VA_KERN
	bool "Kernel Virtual Address Space"
	help
	  Kernel Virtual Address Space.

config DEBUG_VA_KERN_LEG
	bool "Legacy Kernel Virtual Address Space"
	help
	  Kernel Virtual Address Space on legacy kernel version.

config DEBUG_VA_USER
	bool "User Virtual Address Space"
	help
	  User Virtual Address Space.

config DEBUG_VA_USER_LEG
	bool "Legacy User Virtual Address Space"
	help
	  User Virtual Address Space on legacy kernel version.

endchoice


if DEBUG_VA_USER

comment "1. Choice Target Architecture"

choice

	prompt "Choice Architecture Compiler"

config DEBUG_VA_USER_I386
	bool "Intel i386 (32bit) Mechine"
	help
	  I386 32bit Mechine.

config DEBUG_VA_USER_IA64
	bool "Intel IA64 (64 bit) Mechine"
	help
	  IA64 64bit Mechine.

endchoice

endif # DEBUG_VA_USER 

config DEBUG_VA_USER_DATA
	bool ".data segment"
	help
	  Data segment.

if DEBUG_VA_USER_DATA

config DEBUG_VA_USER_DATA_GNINIT
	bool "Global Un-Initialize Data"
	help
	  Global Un-Initizlize Data.

config DEBUG_VA_USER_DATA_GINITZERO
	bool "Global Inited Zero Data"
	help
	  Global Inited Zero Data.

config DEBUG_VA_USER_DATA_GINITNZERO
	bool "Global Inited Non-Zero Data"
	help
	  Globl Inited No-Zero Data.

config DEBUG_VA_USER_DATA_SNINIT
	bool "Static Un-Initialize Data"
	help
	  Static Un-Initialize Data.

config DEBUG_VA_USER_DATA_SINITZERO
	bool "Static Inited Zero Data"
	help
	  Static Inited Zero Data.

config DEBUG_VA_USER_DATA_SINITNZERO
	bool "Static Inited Non-Zero Data"
	help
	  Static Inited Non-Zero Data.

config DEBUG_VA_USER_DATA_LSNINIT
	bool "Local Static Un-Initialize Data"
	help
	  Local Static Un-Initialize Data.

config DEBUG_VA_USER_DATA_LSINITZERO
	bool "Local Static Inited Zero Data"
	help
	  Local Static Inited Zero Data.

config DEBUG_VA_USER_DATA_LSINITNZERO
	bool "Local Static Inited Non-Zero Data"
	help
	  Local Static Inited Non-Zero Data.

config DEBUG_VA_USER_DATA_LNINIT
	bool "Local Un-Initialize Data"
	help
	  Local Un-Initizlize Data.

config DEBUG_VA_USER_DATA_LINITZERO
	bool "Local Inited Zero Data"
	help
	  Local Inited Zero Data.

config DEBUG_VA_USER_DATA_LINITNZERO
	bool "Local Inited Non-Zero Data"
	help
	  Local Inited No-Zero Data.

config DEBUG_VA_USER_DATA_HEAP
	bool "Heap Data"
	help
	  Data on Heap.

config DEBUG_VA_USER_DATA_MMAP
	bool "Mmap Data"
	help
	  Data on Mmap.

config DEBUG_VA_USER_DATA_CONST
	bool "Const Data"
	help
	  Const Data.

endif # DEBUG_VA_USER_DATA

endif # DEBUG_MMU_VA


endmenu
```

## tools/demo/mmu/allocator/Kconfig
```kconfig
#
# Memeory Manager Unit
#

menu "Common Memory Allocator"

config DEBUG_MEMORY_ALLOCATOR
	bool "Common Memory Allocator"
	help
	  Debug Memory Allocator.

if DEBUG_MEMORY_ALLOCATOR

# Kmalloc allocator
source "tools/demo/mmu/allocator/kmalloc/Kconfig"

# Page allocator
source "tools/demo/mmu/allocator/page/Kconfig"

# vmalloc allocator
source "tools/demo/mmu/allocator/vmalloc/Kconfig"

endif

endmenu
```

## tools/demo/mmu/storage/Kconfig
```kconfig
#
# Data storage, general recording of information
#

menu "Data storage: Main Memory, Buffer, Cache ..."

config DEBUG_STORAGE
	bool "Debug Data Storage, Memory, ROM, TLB...."
	help
	  Debug Data Storage.

if DEBUG_STORAGE

# Main Memory
source "tools/demo/mmu/storage/memory/Kconfig"

# Filesystem Buffer
source "tools/demo/mmu/storage/buffer/Kconfig"

# Register
source "tools/demo/mmu/storage/register/Kconfig"

# I/O Port
source "tools/demo/mmu/storage/ioports/Kconfig"

# Stack
source "tools/demo/mmu/storage/stack/Kconfig"

endif

endmenu
```
