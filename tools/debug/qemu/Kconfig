## tools/debug/qemu/Kconfig
```kconfig
#
# Qeumu configration
#

menu "Qemu configuration"

config QEMU
	bool "Support qemu to emulate different CPU"
	default y
	help
	  Utilize qemu to emulate different hardware platform.
	  Support x86(Intel i386)

if QEMU

config QEMU_BOOT_FLOPPY
	bool "Boot from floppy"
	depends on QEMU
	help
	  Support system boot from floppy disk.

config QEMU_BOOT_HARDDISK
	bool "Boot from hard disk"
	depends on QEMU
	help
	  Support system boot from hard disk.

config QEMU_MEMORY_SIZE
	int "Memory size(M)"
	depends on QEMU
	help
	  Configure running memory of qmeu.

config QEMU_RTC
	bool "RTC on qemu"
	depends on QEMU
	help
	  Configure RTC format time on qmeu.

config QEMU_SERIAL_PTY
	bool "PTY serial"
	depends on QEMU
	help
	  Support pty serial.
config QEMU_VGA
	bool "Select type of VGA card to emulate"
	depends on QEMU
	help
	  Support VGA

# VGA
if QEMU_VGA

config QEMU_VGA_CIRRUS
	bool "Cirrus Logic GD5446 Video card"
	help
	  Cirrus Logic GD5446 Video card. All Windows versions starting 
	  from Windows 95 should recognize and use this graphic card.
	  For optimal performances, use 16 bit color depth in the guest
	  and the host OS. (This card was the default before QEMU 2.2)

config QEMU_VGA_STD
	bool "Standard VGA card with Bochs VBE extensions."
	help
	  Standard VGA card with Bochs VBE extensions. If your guest OS
	  supports the VESA 2.0 VBE extensions (e.g. Windows XP) and if
	  you want to use high resolution modes (>= 1280x1024x16) then
	  you should use this option. (This card is the default since 
	  QEMU 2.2)

endif

endif

endmenu
```

## tools/demo/Data/Base/BCD/Kconfig
```kconfig
#
# BCD: Unpacked BCD and Packed BCD
#

menu "BCD: Unpacked BCD and Packed BCD"

config DEBUG_DATA_BCD
	bool "BCD: Unpacked BCD and Packed BCD"
	help
	  Debug Unpacked BCD and Packed BCD.

if DEBUG_DATA_BCD

config DEBUG_UNPACKED_BCD
	bool "BCD: Unpacked BCD integers"
	help
	  Debug Unpacked BCD integer.

if DEBUG_UNPACKED_BCD

config DEBUG_UNPACKED_BCD_ADD
	bool "BCD: Addition with Unpacked BCD"
	help
	  Debug addition with Unpacked BCD.

config DEBUG_UNPACKED_BCD_SUB
	bool "BCD: Subtraction with Unpacked BCD"
	help
	  Debug subtraction with Unpacked BCD.

endif

config DEBUG_PACKED_BCD
	bool "BCD: Packed BCD integers"
	help
	  Debug Packed BCD integers.

endif

endmenu
```

## tools/demo/Data/Base/Kconfig
```kconfig
#
# Base Data Type
#

menu "Base Data Types: BCD, int, float, pointer, and so on"

config DEBUG_BASE_DATA
	bool "Debug Base Data types: BCD, int, float, pointer, and so on"
	help
	  Debug Base Data types: BCD, int, float, pointer, and so on

if DEBUG_BASE_DATA

# BCD
source "tools/demo/Data/Base/BCD/Kconfig"

endif

endmenu
```

## tools/demo/Data/Kconfig
```kconfig
#
# Data Type
#

menu "Data Types: list, tree, BCD, and so on"

config DEBUG_DATA
	bool "Debug Data types: list, tree, BCD, and so on."
	help
	  Debug Data types: list, tree, BCD, and so on.

if DEBUG_DATA

# BASE Date Type
source "tools/demo/Data/Base/Kconfig"

endif

endmenu
```

## tools/demo/Kconfig
```kconfig
#
# Debug tools configuration
# 

menu "Demo Code for variable subsystem mechanism"

config DEMO_CODE
	bool "Demo Code for variable subsystem mechanism"
	select DEBUG_DEBUGCALL
	help
	  Test basic kernel function on specify envirnoment

if DEMO_CODE

config DEBUG_DEBUGCALL
	bool "Debug call in different stage."
	help
	  Debug call in different stage. see include/test/init.h

# MMU 
source "tools/demo/mmu/Kconfig"

# VFS
source "tools/demo/vfs/Kconfig"

# POSIX
source "tools/demo/posix/Kconfig"

# Drivers
source "tools/demo/drivers/Kconfig"

endif

endmenu
```

## tools/demo/drivers/Kconfig
```kconfig
#
# Device Driver
#

menu "Device Driver Common Layer"

config DEBUG_DDL
	bool "Debug Device Driver"
	help
	  Debug Device Driver.

if DEBUG_DDL

# Block device
source tools/demo/drivers/block/Kconfig

endif

endmenu
```

## tools/demo/drivers/block/Kconfig
```kconfig
#
# Block Device Driver
#

menu "Block Device Driver"

config DEBUG_BLOCK
	bool "Debug Block Device Driver"
	help
	  Debug BLOCK Device Driver.

if DEBUG_BLOCK

# General HD
source tools/demo/drivers/block/genhd/Kconfig

# Hard Disk (HDD)
source tools/demo/drivers/block/hd/Kconfig

endif

endmenu
```

## tools/demo/drivers/block/genhd/Kconfig
```kconfig
#
# General block device driver layer
#

menu "General block device driver layer."

config DEBUG_BLOCK_GENHD
	bool "Debug Block Device Driver"
	help
	  Debug BLOCK Device Driver.

endmenu
```

## tools/demo/drivers/block/hd/Kconfig
```kconfig
#
# Hard-Disk
#

menu "hard disk drive (HDD)"

config DEBUG_BLOCK_HD
	bool "Debug hard disk drive (HDD)"
	help
	  Debug hard disk drive (HDD).

if DEBUG_BLOCK_HD

config DEBUG_HD_INIT
	bool "Initialize Hard-Disk (HDD)"
	help
	  Initialize Hard-Disk (HDD)

endif

endmenu
```

## tools/demo/mmu/Kconfig
```kconfig
#
# Memeory Manager Unit
#

menu "MMU(Memory Manager Unit) on X86 Architecture"

config DEBUG_MMU
	bool "Debug MMU(Memory Manager Unit) mechanism on X86 Architecture"
	help
	  Debug Memory Manager Unit(MMU).

if DEBUG_MMU

# Memory allocator
source "tools/demo/mmu/allocator/Kconfig"

# Data Storage
source "tools/demo/mmu/storage/Kconfig"

# Addressing
source "tools/demo/mmu/addressing/Kconfig"

endif

endmenu
```

## tools/demo/mmu/addressing/Kconfig
```kconfig
#
# Addressing Mechanism
#

menu "Addressing Mechanism"

config DEBUG_ADDRESSING
	bool "Memory addressing mechanism"
	help
	  Debug Memory addressing mechanism.

if DEBUG_ADDRESSING

# Virtual address
source "tools/demo/mmu/addressing/virtual_address/Kconfig"

# Logical address
source "tools/demo/mmu/addressing/logical_address/Kconfig"

# Linear address
source "tools/demo/mmu/addressing/linear_address/Kconfig"

# Physical address
source "tools/demo/mmu/addressing/physical_address/Kconfig"

# Segmentation
source "tools/demo/mmu/addressing/segment/Kconfig"

# Paging
source "tools/demo/mmu/addressing/paging/Kconfig"

endif

endmenu
```

## tools/demo/mmu/addressing/logical_address/Kconfig
```kconfig
#
# Logical-address Mechanism
#

menu "logical-address addressable/addresssing"

config DEBUG_MMU_LA
	bool "Logical-address"
	help
	  Debug logical address mechanism.

if DEBUG_MMU_LA

comment "Kernel or Userland space"

choice
	prompt "Logical-address on kernel/userland space"
	default DEBUG_LA_KERNEL

config DEBUG_LA_KERNEL
	bool "Logical-address on kernel space"
	help
	  Logical-address on kernel space.

config DEBUG_LA_USERLAND
	bool "Logical-address on userland space"
	help
	  Logical-address on userland space.

endchoice

comment "Segment Selector: Code, Data, and Stack"

config DEBUG_LA_SEL_DS
	bool "DS: Data selector"
	help
	  Data selector for logical-address.

config DEBUG_LA_SEL_CS
	bool "CS: Code selector"
	help
	  Code selector for logical-address.

config DEBUG_LA_SEL_SS
	bool "SS: Stack selector"
	help
	  Stack selector for logical-address.

config DEBUG_LA_SEL_FS
	bool "FS: userland data selector"
	help
	  Userland data selector for logical-address.

comment "Various logical-address: local/global/stack variable"

config DEBUG_LA_LOCAL
	bool "local variable"
	help
	  Local variable for logical-address

config DEBUG_LA_GLOBAL
	bool "Global variable"
	help
	  Global variable for logical-address

config DEBUG_LA_STACK
	bool "Stack variable"
	help
	  Stack variable for logical-address

config DEBUG_LA_CODE
	bool "Instruction"
	help
	  Instruction for logical-address

comment "Translation for logical, virtual, and linear address"

config DEBUG_LA_2_VA
	bool "Logical-address to virtual-address"
	select DEBUG_VA_2_LA
	help
	  Translate logical-address to virtual-address.

config DEBUG_VA_2_LA
	bool "Virtual-address to logical-address"
	help
	  Translate virtual-adderss to logical-address.

config DEBUG_LA_2_LNA
	bool "Logical-address to linear-address"
	select DEBUG_VA_2_LA
	help
	  Translate logical-address to linear-address.

endif ## DEBUG_MMU_LA

endmenu
```

## tools/demo/mmu/addressing/paging/Kconfig
```kconfig
menu "Paging"

config DEBUG_MMU_PAGING
	bool "X86 Paging mechanism"
	help
	  X86 architecture paging mechanism.

if DEBUG_MMU_PAGING

config DEBUG_PAGING_MODE
	bool "Paging modes"
	help
	  Paging modes

if DEBUG_PAGING_MODE

config DEBUG_PAGING_MODE_DETECT
	bool "Detect Paging modes"
	help
	  Detect Paging modes.

endif # DEBUG_PAGING_MODE

config DEBUG_32BIT_PAGING
	bool "32-bit Paging on kernel space"
	help
	  32-bit Paging.

if DEBUG_32BIT_PAGING

choice
	prompt "Kernel/User virtual address"

config DEBUG_32BIT_PAGING_KER
	bool "Kernel space virtual address"
	help
	  Kernel space virtual address.

config DEBUG_32BIT_PAGING_USER
	bool "User space virtual address"
	help
	  User space virtual address.

endchoice

config DEBUG_PDE_BITMAP_4K
	bool "PDE bitmap of 4-KByte Page"
	help
	  PDE Bitmap of 4-KByte Page.

if DEBUG_PDE_BITMAP_4K

comment "32-Bit 4-KByte Page-Directory Entry Bitmap"

config DEBUG_PDE_4KBP_P
	bool "P flag (bit 0 on PDEs)"
	help
	  Present flag on PDE.

config DEBUG_PDE_4KBP_RW
	bool "R/W flag (bit 1 on PDEs)"
	help
	  Read/Write flag.

config DEBUG_PDE_4KBP_US
	bool "U/S flag (bit 2 on PDEs)"
	help
	  User/Supervisor flag.

config DEBUG_PDE_4KBP_PWT
	bool "PWT flag (bit 3 on PDEs)"
	help
	  Page-level write-through;

config DEBUG_PDE_4KBP_PCD
	bool "PCD flag (bit 4 on PDEs)"
	help
	  Page-level cache disable.

config DEBUG_PDE_4KBP_A
	bool "A flag (bit 5 on PDEs)"
	help
	  Accessed flag.

config DEBUG_PDE_4KBP_PS
	bool "PS flag (bit 7 on PDEs)"
	help
	  Page Size.

config DEBUG_PDE_4KBP_AD
	bool "Physical address field (bit 12 throug 31 on PDEs)"
	help
	  Physical address field.

endif # DEBUG_PDE_BITMAP_4K

config DEBUG_PDE_BITMAP_4M
	bool "PDE bitmap of 4-MByte Page"
	help
	  PDE Bitmap of 4-MByte Page.

if DEBUG_PDE_BITMAP_4M

comment "32-Bit 4-MByte Page-Directory Entry Bitmap"

config DEBUG_PDE_4MBP_P
	bool "P flag (bit 0 on PDEs)"
	help
	  Present flag on PDE.

config DEBUG_PDE_4MBP_RW
	bool "R/W flag (bit 1 on PDEs)"
	help
	  Read/Write flag.

config DEBUG_PDE_4MBP_US
	bool "U/S flag (bit 2 on PDEs)"
	help
	  User/Supervisor flag.

config DEBUG_PDE_4MBP_PWT
	bool "PWT flag (bit 3 on PDEs)"
	help
	  Page-level write-through;

config DEBUG_PDE_4MBP_PCD
	bool "PCD flag (bit 4 on PDEs)"
	help
	  Page-level cache disable.

config DEBUG_PDE_4MBP_A
	bool "A flag (bit 5 on PDEs)"
	help
	  Accessed flag.

config DEBUG_PDE_4MBP_D
	bool "D flag (bit 6 on PDEs)"
	help
	  Dirty flag.

config DEBUG_PDE_4MBP_PS
	bool "PS flag (bit 7 on PDEs)"
	help
	  Page Size.

config DEBUG_PDE_4MBP_G
	bool "G flag (bit 8 on PDEs)"
	help
	  Global flag.

config DEBUG_PDE_4MBP_PAT
	bool "PAT flag (bit 12 on PDEs)"
	help
	  PAT support flag.

config DEBUG_PDE_4MBP_AD
	bool "Physical address field"
	help
	  Physical address field.

endif # DEBUG_PDE_BITMAP_4M

config DEBUG_PTE_BITMAP
	bool "PTE bitmap"
	help
	  PTE Bitmap.

if DEBUG_PTE_BITMAP

comment "32-Bit Page-Table Entry maps a 4-KByte Page"

config DEBUG_PTE_BP_P
	bool "P flag (bit 0 on PTE)"
	help
	  Present flag.

config DEBUG_PTE_BP_RW
	bool "R/W flag (bit 1 on PTE)"
	help
	  Read/Write flag.

config DEBUG_PTE_BP_US
	bool "U/S flag (bit 2 on PTE)"
	help
	  User/Supervisor flag.

config DEBUG_PTE_BP_PWT
	bool "PWT flag (bit 3 on PTE)"
	help
	  Page-level write-through.

config DEBUG_PTE_BP_PCD
	bool "PCD flag (bit 4 on PTE)"
	help
	  Page-level cache disable.

config DEBUG_PTE_BP_A
	bool "A flag (bit 5 on PTE)"
	help
	  Accessed flag.

config DEBUG_PTE_BP_D
	bool "D flag (bit 6 on PTE)"
	help
	  Dirty flag.

config DEBUG_PTE_BP_PAT
	bool "PAT flag (bit 7 on PTE)"
	help
	  PAT support.

config DEBUG_PTE_BP_G
	bool "G flag (bit 8 on PTE)"
	help
	  Global flag.

config DEBUG_PTE_BP_AD
	bool "Phy address field (bits 12 through 31)"
	help
	  Physical address of the 4-KByte page.

endif # DEBUG_PTE_BITMAP

endif # DEBUG_32BIT_PAGING

config DEBUG_PAE_PAGING
	bool "PAE paging"
	help
	  PAE paging.

config DEBUG_4LEVEL_PAGING
	bool "4-level Paging"
	help
	  4-level Pageing.

config DEBUG_PGT_BASE
	bool "Page Table"
	help
	  Page Table routine.

if DEBUG_PGT_BASE

config DEBUG_MEM_ESTABLISH
	bool "Basic Memory Mapping and Page Table establish"
	help
	  Establish 

if DEBUG_MEM_ESTABLISH

config DEBUG_MEM_PAGING_FIRST
	bool "Establish first Paging Table in assembly"
	help
	  Establish first Paging Table in assembly.

config DEBUG_MEM_PAGING_TABLE
	bool "Establish Paging Table: 1M through 16M"
	help
	  Establish Paging Table 1M - 16M.

config DEBUG_MEM_MAPPING
	bool "Memory mapping"
	select DEBUG_MEM_PAGING_TABLE
	help
	  Memory mapping.

endif # DEBUG_MEM_ESTABLISH

config DEBUG_PAGE_TABLE_COPY
	bool "Copy Page Table from father task."
	help
	  Copy page table from father task.

config DEBUG_PAGE_TABLE_CLONE
	bool "Clone Page Table from father task."
	help
	  Clone page table from father task.

config DEBUG_PAGE_TABLE_CLEAR
	bool "Clear user-level Page Table."
	help
	  Clear page table from current task.

config DEBUG_PAGE_TABLE_FREE
	bool "Free or Release all Page Table."
	help
	  Free or Release one Page Table.

endif # DEBUG_PGT_BASE

# page-fault
source "tools/demo/mmu/addressing/paging/page-fault/Kconfig"

# paging right
source "tools/demo/mmu/addressing/paging/right/Kconfig"

# TLB
source "tools/demo/mmu/addressing/paging/TLB/Kconfig"

endif # DEBUG_MMU_PAGING


endmenu
```

## tools/demo/mmu/addressing/paging/TLB/Kconfig
```kconfig
menu "Translation lookaside Buffers (TLBs)"

config DEBUG_MMU_TLB
	bool "Translation lookaside buffer (TLB)"
	help
	  Translation lookaside buffer (TLB).

if DEBUG_MMU_TLB


config DEBUG_TLB_PCID
	bool "Process-Context Identifies (PCIDs)"
	help
	  The PCIDs.

endif # DEBUG_MMU_TLB


endmenu
```

## tools/demo/mmu/addressing/paging/page-fault/Kconfig
```kconfig
menu "page-fault exception"

config DEBUG_MMU_PAGE_FAULT
	bool "page-fault mechanism"
	help
	  Page-Fault mechanism.

if DEBUG_MMU_PAGE_FAULT

comment "Linear address trigger Page-fault exception"

config DEBUG_TRIGGER_PF_ADDR
	hex "Setup #PF linear address <================>"
	default 0xFFFFFFFF
	help
	  The page-fault linear address.

comment "Choice trigger #PF condition"

choice
	prompt "Page-Fault Condition"

config DEBUG_PF_NP_USR_PD
	bool "User linear address: Page directory is not present."
	help
	  User linear address no translation which page directory P flag
	  was cleared.

config DEBUG_PF_NP_USR_PT
	bool "User linear address: Page Table is not present."
	help
	  User linear address no translation which page table P flag was
	  cleared.

config DEBUG_PF_NP_KERN_PD
	bool "Kernel linear address: Page directory is not present."
	help
	  Kernel linear address no translation which page directory P flag
	  was cleared.

config DEBUG_PF_NP_KERN_PT
	bool "Kernel linear address: Page Table is not present."
	help
	  Kernel linear address no translation which page table P flag was
	  cleared.

endchoice # Trigger #PF conditions

config DEBUG_MMU_PF_ERROR
	bool "Page-Fault Exception Error Code"
	help
	  Page-Fault Exception Error Code.

if DEBUG_MMU_PF_ERROR

comment "#PF Error Code BitMap"

config DEBUG_PF_ERROR_P
	bool "P flag (bit 0)"
	help
	  Indicate Present causing #PF.

config DEBUG_PF_ERROR_WR
	bool "W/R flag (bit 1)"
	help
	  Indicate access causing #PF.

config DEBUG_PF_ERROR_US
	bool "U/S flag (bit 2)"
	help
	  Indicate access on user-mode/supervisor-mode.

config DEBUG_PF_ERROR_RSVD
	bool "RSVD flag (bit 3)"
	help
	  Set reserved bit on paging-structure.

config DEBUG_PF_ERROR_ID
	bool "I/D flag (bit 4)"
	help
	  Instruction fetch trigger #PF.

config DEBUG_PF_ERROR_PK
	bool "PK flag (bit 5)"
	help
	  Protection Key.

config DEBUG_PF_ERROR_SGX
	bool "SGX flag (bit 15)"
	help
	  SGX trigger #PF.

endif # DEBUG_MMU_PF_ERROR

endif # DEBUG_MMU_PAGE_FAULT

endmenu
```
