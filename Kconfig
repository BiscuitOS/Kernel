## Kconfig
```kconfig
#
# For a description of the syntax of this configuration file,
# see Documentation/kbuild/kconfig-language.txt.
#
mainmenu "BiscuitOS/$ARCH $KERNELVERSION Kernel Configuration"

config SRCARCH
	string
	option env="SRCARCH"

source "arch/$SRCARCH/Kconfig"
```

## arch/x86/Kconfig
```kconfig
#### Arch settings
config X86
	def_bool y

config OUTPUT_FORMAT
        string
        default "elf32-i386" if X86

source "init/Kconfig"

source "arch/x86/boot/Kconfig"

source "drivers/Kconfig"

source "tools/Kconfig"

source "fs/Kconfig"

source "mm/Kconfig"
```

## arch/x86/boot/Kconfig
```kconfig
#
# Simulate X86 Architecuture
#
menu "boot option"

config BOOTLOADER
	bool "Simulate bootloader for X86 Architecture"
	default y
	help
	  Simulate bootloader to load system image into
	  ram on X86 Architecture.

if BOOTLOADER

config DEBUG_BOOTLOADER
	bool "debug bootloade utilize gdb"
	help
	  Debug bootloader with gdb

config BOOT_LOGO
	string "Logo message"
	default "Loading BiscuitOS"
	help
	  Output logo information on bootloader.

config BOOT_INITSEG
	hex "INITSEG load address"
	default 0x9000
	help
	  Setup load address for INIT segment.

config BOOT_SYSSEG
	hex "SYSSEG load address"
	default 0x1000
	help
	  Setup load address for SYSTEM segment.

config BOOT_SETUPSEG
	hex "SETUPSEG load address"
	default 0x9020
	help
	  Setup load address for SETUP segment.

config SYSTEM_SIZE
	hex "System image size"
	default 0x8000
	help
	  Setup system image size.

config ROOT_DEV
	hex "Root-device partition number"
	default 0x301
	help
	  Setup Root-device partition number. (default 0x301,
	  First hard-disk partition)

config SWAP_DEV
	hex "SWAP-device partition number"
	default 0x302
	help
	  Setup SWAP-device partition number. (default 0x302,
	  Second hard-disk partition)

endif

config KERNEL_CS
	hex "Kernel code segment selector"
	default 0x10
	help
	  In computing, a code segment, also known as a text 
	  segment or simply as text, is a portion of an object
	  file or the corresponding section of the program's 
	  virtual address space that contains executable 
	  instructions. The term "segment" comes from the memory 
	  segment, which is a historical approach to memory 
	  management that has been succeeded by paging. 
	  KERNEL_CS used to store kernel code segment selector.

config KERNEL_DS
	hex "Kernel data segment selector"
	default 0x18
	help
	  In computing, a data segment (often denoted .data) 
	  is a portion of an object file or the corresponding 
	  virtual address space of a program that contains 
	  initialized static variables, that is, global variables
	  and static local variables. The size of this segment is
	  determined by the size of the values in the program's 
	  source code, and does not change at run time. KERNEL_DS
	  is used to specil data segment selector.

config USER_CS
        hex "Userland code segment selector"
        default 0x23
        help
          In computing, a code segment, also known as a text
          segment or simply as text, is a portion of an object
          file or the corresponding section of the program's
          virtual address space that contains executable
          instructions. The term "segment" comes from the memory
          segment, which is a historical approach to memory
          management that has been succeeded by paging.
          USER_CS used to store user code segment selector.

config USER_DS
        hex "Userland data segment selector"
        default 0x2B
        help
          In computing, a data segment (often denoted .data)
          is a portion of an object file or the corresponding
          virtual address space of a program that contains
          initialized static variables, that is, global variables
          and static local variables. The size of this segment is
          determined by the size of the values in the program's
          source code, and does not change at run time. USER_DS
          is used to specil data segment selector.

endmenu # "General setup"
```

## arch/x86/configs/defconfig
```kconfig
CONFIG_X86=y
CONFIG_OUTPUT_FORMAT="elf32-i386"
CONFIG_CROSS_COMPILE=""
CONFIG_LOCALVERSION=""
CONFIG_BOOT_KERNEL_DELAY=0
CONFIG_BOOTLOADER=y
CONFIG_DEBUG_BOOTLOADER=y
CONFIG_BOOT_LOGO="Loading BiscuitOS"
CONFIG_BOOT_INITSEG=0x9000
CONFIG_BOOT_SYSSEG=0x1000
CONFIG_BOOT_SETUPSEG=0x9020
CONFIG_SYSTEM_SIZE=0x8000
CONFIG_ROOT_DEV=0x301
CONFIG_SWAP_DEV=0x302
CONFIG_KERNEL_CS=0x10
CONFIG_KERNEL_DS=0x18
CONFIG_USER_CS=0x23
CONFIG_USER_DS=0x2B
CONFIG_HARDDISK=y
CONFIG_DEBUG_KERNEL=y
CONFIG_GDB=y
CONFIG_EMULATE_RUNNING_SYSTEM=y
CONFIG_QEMU=y
CONFIG_QEMU_BOOT_BIOS=y
CONFIG_QEMU_BOOT_BIOS_NAME="SeaBIOS.bin"
CONFIG_QEMU_BOOT_FLOPPY=y
CONFIG_QEMU_MEMORY_SIZE=32
CONFIG_QEMU_VGA=y
CONFIG_QEMU_ROOTFS_NAME="BiscuitOS.img"
CONFIG_QEMU_VGA_CIRRUS=y
CONFIG_DEMO_CODE=y
CONFIG_DEBUG_DEBUGCALL=y
CONFIG_DEBUG_MMU=y
CONFIG_DEBUG_ADDRESSING=y
CONFIG_DEBUG_MMU_VA=y
CONFIG_DEBUG_VA_KERN_LEG=y
CONFIG_EXT2_FS=y
CONFIG_MMU=y
CONFIG_MEMORY_SIZE=32
```

## arch/x86/configs/linux_ext2_defconfig
```kconfig
CONFIG_DEBUG_BOOTLOADER=y
CONFIG_HARDDISK=y
CONFIG_DEBUG_KERNEL=y
CONFIG_GDB=y
CONFIG_EMULATE_RUNNING_SYSTEM=y
CONFIG_QEMU_BOOT_BIOS=y
CONFIG_QEMU_BOOT_BIOS_NAME="SeaBIOS.bin"
CONFIG_QEMU_BOOT_FLOPPY=y
CONFIG_QEMU_MEMORY_SIZE=32
CONFIG_QEMU_VGA=y
CONFIG_QEMU_ROOTFS_NAME="BiscuitOS-ext2_0-1.0.1.2.img"
CONFIG_QEMU_VGA_CIRRUS=y
CONFIG_DEMO_CODE=y
CONFIG_DEBUG_MMU=y
CONFIG_DEBUG_STORAGE=y
CONFIG_DEBUG_REGISTER=y
CONFIG_DEBUG_REGISTER_EFLAGS=y
CONFIG_DEBUG_EFLAGS_ZF=y
CONFIG_DEBUG_ZF_SCASB=y
CONFIG_DEBUG_VFS=y
CONFIG_DEBUG_VFS_EXT2=y
CONFIG_EXT2_FS=y
CONFIG_MMU=y
```

## arch/x86/configs/linux_minix_defconfig
```kconfig
CONFIG_DEBUG_BOOTLOADER=y
CONFIG_HARDDISK=y
CONFIG_DEBUG_KERNEL=y
CONFIG_GDB=y
CONFIG_EMULATE_RUNNING_SYSTEM=y
CONFIG_QEMU_BOOT_BIOS=y
CONFIG_QEMU_BOOT_BIOS_NAME="SeaBIOS.bin"
CONFIG_QEMU_BOOT_FLOPPY=y
CONFIG_QEMU_MEMORY_SIZE=32
CONFIG_QEMU_VGA=y
CONFIG_QEMU_ROOTFS_NAME="BiscuitOS-minix_V1-1.0.1.2.img"
CONFIG_QEMU_VGA_CIRRUS=y
CONFIG_DEMO_CODE=y
CONFIG_DEBUG_VFS=y
CONFIG_DEBUG_VFS_EXT2=y
CONFIG_MINIX_FS=y
CONFIG_MMU=y
```

## arch/x86/rese/Kconfig
```kconfig
#
# Bootloader configure for x86
#
menu "Bootloader configure"

config DEBUG_BOOTLOADER
	bool "debug bootloade utilize gdb"
	help
	  Debug bootloader with gdb

endmenu # "General setup"
```

## drivers/Kconfig
```kconfig
menu "Device Driver"

source "drivers/char/Kconfig"

source "drivers/block/Kconfig"

endmenu
```

## drivers/blk_drv/Kconfig
```kconfig
#
# Block device drivers
#
menu "Block Device Drivers"

config RAMDISK
	bool "Ramdisk"
	help
	  Virtual hard-disk on RAM.

config FLOPPY
	bool "Floppy"
	help
	  Floppy disk.

config HARDDISK
	bool "Hard-disk"
	help
	  Hard disk

config HD_TYPE
	bool "Support multi disk type"
	help
	  Disk type.

endmenu
 
```

## drivers/chr_drv/Kconfig
```kconfig
#
# Character device 
#
menu "Character device driver"

source "drivers/chr_drv/sound/Kconfig"

endmenu
```

## drivers/chr_drv/sound/Kconfig
```kconfig
#
# Sound
#

menu "Sound"

config SOUND
	bool "Sound generate device driver"
	help
	  Sound stub

endmenu # "Sound"
```

## fs/Kconfig
```kconfig
#
# File system configure
#

menu "File systems"

source "fs/minix/Kconfig"

source "fs/ext/Kconfig"

source "fs/msdos/Kconfig"

source "fs/proc/Kconfig"

source "fs/ext2/Kconfig"

endmenu # "File systems"
```

## fs/ext/Kconfig
```kconfig
#
# EXT
#

menu "ext (Extended file system)"

config FS_EXT
	bool "Extended file system (ext)"
	help
	  The extended file system, or ext, was implemented in April 
	  1992 as the first file system created specifically for the 
	  Linux kernel. It has metadata structure inspired by the 
	  traditional Unix File System (UFS) and was designed by Rémy 
	  Card to overcome certain limitations of the MINIX file system.
	  It was the first implementation that used the virtual file 
	  system (VFS), for which support was added in the Linux 
	  kernel in version 0.96c, and it could handle file systems 
	  up to 2 gigabytes (GB) in size.

endmenu # "File systems"
```

## fs/ext2/Kconfig
```kconfig
#
# EXT2-FS
#

menu "Ext2 Filesystem"

config EXT2_FS
	bool "Ext2 Filesystem"
	help
	  Ext2 Filesystem

endmenu # "File systems"
```

## fs/msdos/Kconfig
```kconfig
#
# MS-DOS
#

menu "MS-DOS/FAT Filesystem"

config FS_MSDOS
	bool "MS-DOS/FAT Filesystem"
	help
	  File Allocation Table (FAT) is a computer file system
	  architecture and a family of industry-standard file 
	  systems utilizing it. The FAT file system is a continuing
	  standard which borrows source code from the original, 
	  legacy file system and proves to be simple and robust.
	  It offers useful performance even in lightweight 
	  implementations, but cannot deliver the same performance,
	  reliability and scalability as some modern file systems.
	  It is, however, supported for compatibility reasons by 
	  nearly all currently developed operating systems for 
	  personal computers and many mobile devices and embedded 
	  systems, and thus is a well-suited format for data exchange
	  between computers and devices of almost any type and age 
	  from 1981 up to the present.

endmenu # "File systems"
```

## fs/proc/Kconfig
```kconfig
#
# PROC
#

menu "procfs (proc filesystem)"

config FS_PROC
	bool "The proc filesystem (procfs)"
	help
	  The proc filesystem (procfs) is a special filesystem in
	  Unix-like operating systems that presents information 
	  about processes and other system information in a 
	  hierarchical file-like structure, providing a more 
	  convenient and standardized method for dynamically 
	  accessing process data held in the kernel than traditional
	  tracing methods or direct access to kernel memory. 
	  Typically, it is mapped to a mount point named /proc 
	  at boot time. The proc file system acts as an interface
	  to internal data structures in the kernel. It can be used
	  to obtain information about the system and to change 
	  certain kernel parameters at runtime (sysctl).

endmenu # "File systems"
```

## init/Kconfig
```kconfig
config ARCH
	string
	option env="ARCH"

menu "General setup"

config CROSS_COMPILE
	string "Cross-compiler tool prefix"
	help
	  Same as running 'make CROSS_COMPILE=prefix-' but stored for
	  default make runs in this kernel build directory. You don't
	  need to set this unless you want the configure kernel build
	  directory to select the cross-compiler automativally.

config LOCALVERSION
	string "Local version - append to kernel release"
	help
	  Append an extra string to the end of your kernel version.
	  This will show up when you type uname, for example.
	  The string you set here will be appended after the contents of
	  any files with a filename matching localversion* in your
	  object and source tree, in that order. Your total string can
	  be a maximum of 64 characters.

endmenu # "General setup"
```

## kernel/Kconfig
```kconfig
#
# Kernel core configure
#

menu "Kernel core"

config BISCUITOS_KERNEL_SUPPORT
	bool "support biscuitos kernel"
	help
	 This is used to support kernel of biscuitos.

endmenu
```

## lib/Kconfig
```kconfig
#
# Kernel library
#

menu "library configure"

config MATH
	bool "Support Math processor"
	help
	  Support math corprocessor

endmenu # "library configure"
```

## mm/Kconfig
```kconfig
#
# Memory configure
# 

menu "Memory settings"

config MMU
	bool "MMU suport"
	help
	  Support paging and segmenting on MMU.

config MEMORY_SIZE
	int
	default QEMU_MEMORY_SIZE
	help
	  System memory size.

endmenu
```

## tools/Kconfig
```kconfig
#
# Kernel hacking configure
#

menu "kernel hacking"

config DEBUG_KERNEL
	bool "Debug/Running kernel"
	help
	  Utilize mainstream debug tools to debug kernel or
	  Running kernel with emulater tools.

if DEBUG_KERNEL

source "tools/debug/Kconfig"

source "tools/demo/Kconfig"

endif

endmenu
```

## tools/debug/Kconfig
```kconfig
#
# Debug tools configuration
# 

menu "Debug tools configuration"

config GDB
	bool "GDB to debug c and assembly source code"
	depends on DEBUG_KERNEL
	help
	  * Start your program, specifying anything that might affect its 
          * behavior. Make your program stop on specified conditions.
	  * Examine what has happened, when your program has stopped.
	  * Change things in your program, so you can experiment with correcting 
	    the effects of one bug and go on to learn about another. 
	
config EMULATE_RUNNING_SYSTEM
	bool "Emulate running system"
	depends on DEBUG_KERNEL
	help
	  Running or Debug linux on emulate tools.

if EMULATE_RUNNING_SYSTEM

source "tools/debug/qemu/Kconfig"

endif

endmenu
```
